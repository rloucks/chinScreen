/*******************************************************************************
 * Size: 18 px
 * Bpp: 2
 ******************************************************************************/


#ifdef __has_include

    #if __has_include("lvgl.h")
         #ifndef LV_LVGL_H_INCLUDE_SIMPLE
             #define LV_LVGL_H_INCLUDE_SIMPLE
         #endif
     #endif
 #endif

 #ifdef LV_LVGL_H_INCLUDE_SIMPLE
     #include "lvgl.h"
 #else
     #include "../lvgl-8.3.11/lvgl.h"
 #endif

 #ifndef PEN_24
 #define PEN_24 1
 #endif

 #if PEN_24

/*-----------------
 *    BITMAPS
 *----------------*/
/*Store the image of the glyphs*/
static LV_ATTRIBUTE_LARGE_CONST const uint8_t glyph_bitmap[] = {
    /* U+0020 " " */
    /* U+0021 "!" */
    0x21, 0x86, 0x18, 0x61, 0x86, 0x18, 0x70, 0xc2,
    0x0, 0x20, 0x0,
    /* U+0022 "\"" */
    0x5, 0x96, 0x96, 0x96, 0x91,
    /* U+0023 "#" */
    0x4, 0x0, 0x0, 0x24, 0x30, 0x0, 0x90, 0xc0,
    0x2, 0x43, 0x0, 0xa, 0x1f, 0xc0, 0x2f, 0xf8,
    0xb, 0xe0, 0x90, 0x1, 0x82, 0x94, 0x7, 0x6f,
    0xe2, 0xfe, 0x5c, 0x5, 0x60, 0x30, 0x1, 0x80,
    0x80,
    /* U+0024 "$" */
    0x0, 0x40, 0x0, 0x30, 0x0, 0xc, 0x0, 0x1a,
    0x40, 0x1d, 0x74, 0xd, 0x7, 0x1, 0xc0, 0x80,
    0x1e, 0x0, 0x0, 0xf0, 0x0, 0xb, 0x2, 0x0,
    0x71, 0xc0, 0xc, 0x30, 0x3, 0x47, 0x41, 0xc0,
    0x2f, 0xc0, 0x1, 0x0, 0x0, 0xd0, 0x0, 0x30,
    0x0, 0x4, 0x0,
    /* U+0025 "%" */
    0x0, 0x0, 0x0, 0x0, 0x60, 0x0, 0x30, 0x0,
    0x34, 0x0, 0x2c, 0x8, 0xc, 0x0, 0xd, 0x0,
    0x7, 0x0, 0x3, 0x40, 0x1, 0xc0, 0x0, 0xd0,
    0x0, 0x70, 0x0, 0x24, 0x14, 0xc, 0x0, 0x0,
    0x0, 0x0,
    /* U+0026 "&" */
    0x0, 0xa0, 0x0, 0x7b, 0x40, 0xd, 0x18, 0x2,
    0x80, 0x0, 0x30, 0x0, 0x3, 0xb, 0x0, 0x2f,
    0x80, 0x0, 0xe0, 0x0, 0x1c, 0x1f, 0xc3, 0x1,
    0xe0, 0x70, 0x2c, 0x7, 0xb, 0x0, 0x2f, 0x80,
    0x0, 0x0, 0x0,
    /* U+0027 "'" */
    0x4d, 0xd8,
    /* U+0028 "(" */
    0x14, 0x34, 0x30, 0x60, 0xa0, 0x90, 0xd0, 0xc0,
    0xd0, 0x90, 0xa0, 0x70, 0x34, 0x1c, 0x8,
    /* U+0029 ")" */
    0x60, 0x30, 0x28, 0x1c, 0xc, 0xc, 0xc, 0xc,
    0xc, 0xc, 0x18, 0x24, 0x30, 0x70, 0x40,
    /* U+002A "*" */
    0x0, 0x0, 0x12, 0x40, 0x3b, 0xb4, 0xf, 0xd0,
    0x2f, 0xf4, 0x63, 0x1c, 0x2, 0x0,
    /* U+002B "+" */
    0x0, 0x0, 0x2, 0x40, 0x2, 0x40, 0x7, 0xfc,
    0x3f, 0x80, 0x1, 0x80, 0x0, 0xc0, 0x0, 0x0,
    /* U+002C "," */
    0x2, 0xa, 0x1c, 0x70, 0x0,
    /* U+002D "-" */
    0x0, 0x50, 0xff, 0x80, 0x0, 0x0,
    /* U+002E "." */
    0xc,
    /* U+002F "/" */
    0x0, 0x0, 0x40, 0x0, 0xc, 0x0, 0x3, 0x40,
    0x0, 0x70, 0x0, 0xc, 0x0, 0x2, 0x80, 0x0,
    0x70, 0x0, 0xd, 0x0, 0x2, 0xc0, 0x0, 0x30,
    0x0, 0xd, 0x0, 0x1, 0xc0, 0x0, 0x30, 0x0,
    0x0, 0x0, 0x0,
    /* U+0030 "0" */
    0x0, 0x0, 0x0, 0xf8, 0x0, 0xd2, 0xc0, 0xa0,
    0x24, 0x30, 0x7, 0x1c, 0x0, 0xc6, 0x0, 0x32,
    0x40, 0xd, 0x90, 0x3, 0x68, 0x0, 0xc7, 0x0,
    0x30, 0xc0, 0x28, 0x1d, 0x1c, 0x1, 0xfc, 0x0,
    /* U+0031 "1" */
    0x66, 0x67, 0x77, 0x77, 0x33, 0x33,
    /* U+0032 "2" */
    0x0, 0x68, 0x0, 0xf6, 0xc0, 0xe0, 0x34, 0x10,
    0xc, 0x0, 0x7, 0x0, 0x3, 0x40, 0x2, 0xc0,
    0x1, 0xc0, 0x0, 0xd0, 0x0, 0xe0, 0x0, 0xa0,
    0x0, 0xb0, 0x0, 0x3f, 0xff, 0x80,
    /* U+0033 "3" */
    0x0, 0xb8, 0x0, 0x79, 0xd0, 0x8, 0x6, 0x0,
    0x0, 0x60, 0x0, 0x1c, 0x0, 0xf, 0x80, 0x0,
    0x6f, 0x0, 0x0, 0x28, 0x0, 0x0, 0xc0, 0x0,
    0xd, 0x30, 0x0, 0xd1, 0xd0, 0x1c, 0x7, 0xeb,
    0x40, 0x5, 0x40,
    /* U+0034 "4" */
    0x0, 0x0, 0x24, 0x6, 0x9, 0x1, 0x82, 0x40,
    0x60, 0x90, 0x18, 0x24, 0x7, 0x9, 0x1, 0xc2,
    0x40, 0x30, 0x90, 0xc, 0x1f, 0xff, 0xe0, 0x0,
    0xc0, 0x0, 0x30, 0x0, 0xd, 0x0, 0x2, 0x40,
    0x0, 0x0,
    /* U+0035 "5" */
    0x0, 0x0, 0x7, 0xff, 0x83, 0x40, 0x0, 0xc5,
    0x0, 0x3e, 0xb8, 0x8, 0x2, 0x80, 0x0, 0x30,
    0x0, 0xa, 0x0, 0x1, 0x80, 0x0, 0x60, 0x0,
    0x27, 0x80, 0x2c, 0x2f, 0xf8, 0x0, 0x0, 0x0,
    /* U+0036 "6" */
    0x0, 0x0, 0x0, 0xbc, 0x0, 0xb1, 0xc0, 0x30,
    0x10, 0x28, 0x0, 0xc, 0x0, 0x3, 0x1, 0x41,
    0x83, 0xfc, 0x63, 0x43, 0x6a, 0x80, 0x96, 0xc0,
    0x34, 0xf0, 0x1c, 0x38, 0xd, 0x3, 0xad, 0x0,
    0x28, 0x0, 0x0, 0x0,
    /* U+0037 "7" */
    0x7f, 0xfd, 0x0, 0xd, 0x0, 0x1c, 0x0, 0x34,
    0x0, 0x70, 0x0, 0x90, 0x0, 0xc0, 0x2, 0x80,
    0x3, 0x0, 0x3, 0x0, 0x6, 0x0, 0x9, 0x0,
    0xc, 0x0,
    /* U+0038 "8" */
    0x7, 0xf4, 0xc, 0x1c, 0xc, 0x38, 0xa, 0xd0,
    0x2, 0x80, 0xc, 0x30, 0x24, 0x18, 0x30, 0xc,
    0x60, 0x9, 0x60, 0xd, 0x38, 0x1c, 0xb, 0xf4,
    /* U+0039 "9" */
    0x0, 0x0, 0x1, 0xf8, 0xb, 0x4d, 0x1c, 0x9,
    0x30, 0xe, 0x70, 0x1e, 0x60, 0x3e, 0x70, 0x7a,
    0x3a, 0xca, 0xa, 0x9, 0x0, 0x9, 0x0, 0x9,
    0x0, 0x9, 0x0, 0x9,
    /* U+003A ":" */
    0x80, 0x0, 0x0, 0x80,
    /* U+003B ";" */
    0x14, 0x0, 0x0, 0x0, 0x0, 0x9, 0x36, 0x80,
    0x0,
    /* U+003C "<" */
    0x0, 0x0, 0x0, 0xd0, 0x1e, 0x2, 0xd0, 0x3c,
    0x0, 0xe0, 0x0, 0xb4, 0x0, 0x7d, 0x0, 0x14,
    /* U+003D "=" */
    0x0, 0x7, 0xfe, 0x0, 0xb, 0xfc, 0x0, 0x0,
    /* U+003E ">" */
    0x0, 0x0, 0xb4, 0x0, 0x78, 0x0, 0x2c, 0x0,
    0x28, 0x2, 0xc0, 0x78, 0xb, 0x40, 0x10, 0x0,
    /* U+003F "?" */
    0x0, 0x68, 0x2, 0xda, 0xe, 0x3, 0x38, 0xa,
    0x10, 0xc, 0x0, 0x34, 0x0, 0xe0, 0x2, 0x80,
    0x3, 0x0, 0x3, 0x0, 0x2, 0x0, 0x0, 0x0,
    0x2, 0x0,
    /* U+0040 "@" */
    0x0, 0x0, 0x0, 0x0, 0xb, 0xfe, 0x0, 0x3,
    0x80, 0x2d, 0x0, 0xd0, 0x0, 0x30, 0x18, 0x2f,
    0x81, 0x83, 0x4b, 0xc, 0xc, 0x30, 0xc0, 0xc0,
    0xc3, 0xc, 0x2d, 0x18, 0x30, 0xc7, 0xb7, 0x3,
    0x47, 0xc2, 0x90, 0x1c, 0x0, 0x0, 0x0, 0xa0,
    0x0, 0x1c, 0x2, 0xe0, 0x1b, 0x40, 0x2, 0xff,
    0x80,
    /* U+0041 "A" */
    0x0, 0x60, 0x0, 0x2, 0xc0, 0x0, 0xf, 0x0,
    0x0, 0x79, 0x0, 0x2, 0x58, 0x0, 0xc, 0x30,
    0x0, 0x70, 0xd0, 0x2, 0x41, 0x80, 0x1e, 0xff,
    0xd0, 0xf5, 0xa, 0x2, 0x40, 0xc, 0xc, 0x0,
    0x28, 0x30, 0x0, 0x34, 0x40, 0x0, 0x50,
    /* U+0042 "B" */
    0x40, 0xa0, 0x29, 0xeb, 0xb, 0xc0, 0xc1, 0xd0,
    0x70, 0x60, 0x74, 0x19, 0xf4, 0x7, 0xeb, 0x81,
    0xc0, 0x28, 0x70, 0x3, 0x5c, 0x0, 0xa7, 0x0,
    0x29, 0xd0, 0xc, 0x7b, 0xfd, 0x18, 0x0, 0x0,
    /* U+0043 "C" */
    0x0, 0xa0, 0x0, 0xe, 0x70, 0x0, 0xa0, 0x60,
    0x3, 0x0, 0x0, 0x28, 0x0, 0x0, 0xd0, 0x0,
    0x3, 0x0, 0x0, 0xc, 0x0, 0x0, 0x30, 0x0,
    0x30, 0xd0, 0x1, 0xc2, 0x80, 0xd, 0x3, 0x40,
    0xa0, 0x7, 0xee, 0x0, 0x1, 0x40, 0x0,
    /* U+0044 "D" */
    0x0, 0x0, 0x7, 0xf8, 0x0, 0x60, 0xb4, 0x7,
    0x0, 0xe0, 0x70, 0x3, 0x3, 0x0, 0x28, 0x30,
    0x0, 0xc3, 0x0, 0xc, 0x30, 0x0, 0xc7, 0x0,
    0xc, 0x70, 0x3, 0x47, 0x6, 0xd0, 0x7f, 0x90,
    0x0, 0x0, 0x0,
    /* U+0045 "E" */
    0x0, 0x0, 0x2f, 0xff, 0xa, 0x40, 0x2, 0x40,
    0x0, 0x90, 0x0, 0x2e, 0xfc, 0xb, 0x50, 0x2,
    0x40, 0x0, 0x90, 0x0, 0x24, 0x0, 0x9, 0x0,
    0x2, 0x40, 0x69, 0x7f, 0xe9, 0x0,
    /* U+0046 "F" */
    0x0, 0x2, 0xff, 0xfa, 0x40, 0x28, 0x0, 0x60,
    0x1, 0xef, 0xc7, 0x50, 0x18, 0x0, 0x70, 0x1,
    0xc0, 0x7, 0x0, 0x1c, 0x0, 0x20, 0x0,
    /* U+0047 "G" */
    0x0, 0x0, 0x0, 0x1f, 0x0, 0x7, 0x1c, 0x0,
    0xd0, 0x90, 0x1c, 0x7, 0x2, 0x40, 0x10, 0x30,
    0x0, 0x3, 0x0, 0x0, 0x30, 0x7f, 0xe3, 0x0,
    0x6, 0x34, 0x0, 0xa1, 0x80, 0xd, 0xe, 0x2,
    0x80, 0x2f, 0xe0, 0x0, 0x0, 0x0,
    /* U+0048 "H" */
    0x0, 0x0, 0x0, 0x80, 0x30, 0x1c, 0x3, 0x1,
    0xc0, 0x30, 0xc, 0x3, 0x0, 0xc0, 0x30, 0xc,
    0x3, 0x0, 0xdb, 0xfc, 0x3e, 0x43, 0x1, 0xc0,
    0x30, 0xc, 0x3, 0x1, 0xc0, 0x34, 0x18, 0x2,
    0x81, 0x80, 0x1c, 0x4, 0x0, 0x80,
    /* U+0049 "I" */
    0x0, 0x4, 0x3f, 0xfc, 0x2, 0x40, 0x2, 0x40,
    0x2, 0x40, 0x2, 0x40, 0x2, 0x40, 0x2, 0x40,
    0x2, 0x40, 0x2, 0x40, 0x2, 0x40, 0x2, 0x40,
    0x2f, 0xff, 0x14, 0x0,
    /* U+004A "J" */
    0x0, 0x0, 0x0, 0x7f, 0xfd, 0x0, 0xc, 0x0,
    0x0, 0xc0, 0x0, 0xc, 0x0, 0x0, 0xc0, 0x0,
    0xc, 0x2, 0x0, 0xc0, 0x30, 0xc, 0x3, 0x0,
    0xc0, 0x30, 0xc, 0x2, 0x41, 0x80, 0xd, 0x34,
    0x0, 0x7e, 0x0,
    /* U+004B "K" */
    0x60, 0x10, 0x18, 0x1c, 0x6, 0x1c, 0x1, 0x8d,
    0x0, 0x7d, 0x0, 0x1d, 0x0, 0x7, 0x80, 0x1,
    0xec, 0x0, 0x61, 0xc0, 0x18, 0x1d, 0x6, 0x0,
    0xe2, 0x80, 0xd, 0x0, 0x0, 0x0,
    /* U+004C "L" */
    0x50, 0x0, 0x28, 0x0, 0xa, 0x0, 0x2, 0x80,
    0x0, 0x60, 0x0, 0x18, 0x0, 0x6, 0x0, 0x1,
    0x80, 0x0, 0x60, 0x0, 0x18, 0x0, 0x6, 0x0,
    0x0, 0xff, 0xfc,
    /* U+004D "M" */
    0x20, 0x0, 0x60, 0xd, 0x0, 0x3c, 0x3, 0xc0,
    0x1f, 0x0, 0xf4, 0xd, 0xc0, 0x3b, 0x3, 0x30,
    0xc, 0xd2, 0x89, 0x3, 0xd, 0xc2, 0x40, 0xd1,
    0xd0, 0x60, 0x34, 0x0, 0xc, 0xd, 0x0, 0x3,
    0x3, 0x40, 0x0, 0xd0, 0xd0, 0x0, 0x18, 0x20,
    0x0, 0x3, 0x0, 0x0, 0x0, 0x90, 0x0, 0x0,
    0x0,
    /* U+004E "N" */
    0x0, 0x0, 0x42, 0x0, 0xc, 0x34, 0x0, 0xc3,
    0x80, 0x18, 0x3c, 0x1, 0x83, 0xa0, 0x28, 0x33,
    0x2, 0x83, 0x28, 0x18, 0x30, 0xc1, 0x83, 0x7,
    0x1c, 0x30, 0x28, 0xc3, 0x0, 0xdc, 0x30, 0x3,
    0xd3, 0x0, 0xd, 0x0, 0x0, 0x0,
    /* U+004F "O" */
    0x0, 0x0, 0x0, 0xf8, 0x0, 0xd2, 0xc0, 0xa0,
    0x24, 0x30, 0x7, 0x1c, 0x0, 0xc6, 0x0, 0x32,
    0x40, 0xd, 0x90, 0x3, 0x68, 0x0, 0xc7, 0x0,
    0x30, 0xc0, 0x28, 0x1d, 0x1c, 0x1, 0xfc, 0x0,
    /* U+0050 "P" */
    0x0, 0x50, 0xc, 0xfb, 0x83, 0xd0, 0x30, 0xd0,
    0x9, 0x30, 0x3, 0xc, 0x3, 0x83, 0x7, 0x80,
    0xfe, 0x40, 0x30, 0x0, 0xc, 0x0, 0x3, 0x0,
    0x0, 0xc0, 0x0, 0x30, 0x0, 0xc, 0x0, 0x0,
    /* U+0051 "Q" */
    0x0, 0x0, 0x0, 0x3d, 0x0, 0xd, 0x78, 0x3,
    0x40, 0xd0, 0x30, 0x7, 0x6, 0x0, 0x30, 0x90,
    0x3, 0x4d, 0x0, 0x24, 0xc0, 0x2, 0x8d, 0x0,
    0x24, 0x90, 0x83, 0x7, 0xe, 0x70, 0x34, 0x3d,
    0x0, 0xfb, 0xf0, 0x1, 0x41, 0xd0, 0x0, 0x0,
    /* U+0052 "R" */
    0x22, 0xf4, 0x3, 0xe1, 0xe0, 0x30, 0x3, 0x3,
    0x0, 0x70, 0x30, 0x1d, 0x3, 0xb, 0x40, 0x3b,
    0x80, 0x3, 0xb4, 0x0, 0x31, 0xd0, 0x3, 0x3,
    0x80, 0x30, 0xe, 0x3, 0x0, 0x2c, 0x30, 0x0,
    0xa0, 0x0, 0x0,
    /* U+0053 "S" */
    0x6, 0xa0, 0x1d, 0x6c, 0x34, 0xd, 0x28, 0x5,
    0xe, 0x0, 0x2, 0xd0, 0x0, 0x74, 0x0, 0xc,
    0x50, 0xa, 0x60, 0x7, 0x70, 0x6, 0x38, 0xd,
    0xf, 0xf8, 0x0, 0x40,
    /* U+0054 "T" */
    0x0, 0x0, 0x47, 0xff, 0xf8, 0x0, 0xd0, 0x0,
    0x9, 0x0, 0x0, 0x90, 0x0, 0x9, 0x0, 0x0,
    0x90, 0x0, 0x9, 0x0, 0x0, 0x90, 0x0, 0x9,
    0x0, 0x0, 0x90, 0x0, 0x9, 0x0, 0x0, 0x90,
    0x0,
    /* U+0055 "U" */
    0x60, 0x3, 0x18, 0x0, 0xc6, 0x0, 0x31, 0x80,
    0xc, 0x60, 0x7, 0x1c, 0x1, 0x83, 0x0, 0x60,
    0xc0, 0x24, 0x34, 0xc, 0xa, 0x3, 0x0, 0xc2,
    0x80, 0x2e, 0xc0, 0x1, 0x40, 0x0,
    /* U+0056 "V" */
    0x0, 0x0, 0x74, 0x0, 0xaa, 0x0, 0x31, 0xc0,
    0x28, 0x30, 0xc, 0xd, 0x6, 0x2, 0x83, 0x40,
    0x70, 0xc0, 0xc, 0x60, 0x2, 0x74, 0x0, 0x7c,
    0x0, 0xf, 0x0, 0x3, 0x80, 0x0, 0x0, 0x0,
    /* U+0057 "W" */
    0x0, 0x0, 0x0, 0x0, 0xc0, 0x0, 0x0, 0xc3,
    0x0, 0x0, 0x3, 0xa, 0x0, 0x80, 0x28, 0x1c,
    0x7, 0x40, 0xd0, 0x30, 0x3a, 0x3, 0x0, 0xc1,
    0xcc, 0x1c, 0x2, 0x4d, 0x34, 0xa0, 0x6, 0x30,
    0xa3, 0x40, 0xe, 0x80, 0xcc, 0x0, 0x3d, 0x3,
    0x70, 0x0, 0xf0, 0xb, 0xc0, 0x2, 0x80, 0xe,
    0x0, 0x0, 0x0, 0x20, 0x0,
    /* U+0058 "X" */
    0x10, 0x1, 0x9, 0x1, 0xc1, 0xc0, 0xd0, 0x34,
    0xa0, 0x7, 0x30, 0x0, 0xf4, 0x0, 0x1c, 0x0,
    0xf, 0x40, 0x6, 0x30, 0x3, 0xa, 0x2, 0x80,
    0xd0, 0xc0, 0x1c, 0xa0, 0x3, 0x50, 0x0, 0x20,
    /* U+0059 "Y" */
    0x0, 0x0, 0x90, 0x7, 0x60, 0xa, 0x70, 0xc,
    0x30, 0xc, 0x34, 0x28, 0x18, 0x30, 0xd, 0xa0,
    0x7, 0xc0, 0x2, 0x40, 0x3, 0x40, 0x3, 0x40,
    0x3, 0x0, 0x3, 0x0,
    /* U+005A "Z" */
    0xf, 0xff, 0xc0, 0x0, 0x34, 0x0, 0xa, 0x0,
    0x2, 0x80, 0xf, 0xff, 0x80, 0x1d, 0x0, 0x2,
    0x80, 0x0, 0x30, 0x0, 0xd, 0x0, 0x1, 0xc0,
    0x0, 0x39, 0x6a, 0x57, 0xea, 0xaa,
    /* U+005B "[" */
    0x2f, 0x4a, 0x0, 0xd0, 0x9, 0x0, 0x90, 0x9,
    0x0, 0x90, 0xa, 0x0, 0x60, 0x6, 0x0, 0x60,
    0x6, 0x0, 0x70, 0x7, 0x0, 0x2f, 0xe0, 0x0,
    /* U+005C "\\" */
    0x50, 0x0, 0x1c, 0x0, 0x3, 0x40, 0x0, 0x70,
    0x0, 0xd, 0x0, 0x0, 0xc0, 0x0, 0x28, 0x0,
    0x3, 0x0, 0x0, 0xa0, 0x0, 0xc, 0x0, 0x1,
    0xc0, 0x0, 0x34, 0x0, 0x7, 0x0, 0x0, 0x40,
    /* U+005D "]" */
    0xbf, 0x80, 0xc, 0x0, 0xd0, 0xd, 0x0, 0x90,
    0x9, 0x0, 0x90, 0xa, 0x0, 0x60, 0x6, 0x0,
    0x60, 0x7, 0x0, 0x70, 0x7, 0x1f, 0xd0, 0x0,
    /* U+005E "^" */
    0x0, 0x0, 0x2c, 0x1, 0xdc, 0xd, 0x28, 0x30,
    0x30, 0x0, 0x0,
    /* U+005F "_" */
    0x6b, 0xfc, 0x55, 0x0,
    /* U+0061 "a" */
    0x2, 0xe0, 0xe, 0x6c, 0x4, 0xd, 0x7, 0xda,
    0x1d, 0x7e, 0x30, 0xf, 0x30, 0xf, 0x30, 0x3f,
    0x3f, 0xfb, 0xa, 0x42, 0x0, 0x0,
    /* U+0062 "b" */
    0x40, 0x0, 0xd0, 0x0, 0x90, 0x0, 0x90, 0x0,
    0x92, 0xf4, 0x97, 0x1c, 0xac, 0xc, 0xb8, 0xc,
    0xb0, 0x28, 0xb0, 0x30, 0xa0, 0xa0, 0xa7, 0xc0,
    0xbd, 0x0,
    /* U+0063 "c" */
    0x0, 0x0, 0x2e, 0x3, 0x8c, 0x1c, 0x10, 0xa0,
    0x2, 0x40, 0x9, 0x0, 0x28, 0xa, 0x30, 0x70,
    0x7f, 0x0, 0x10, 0x0,
    /* U+0064 "d" */
    0x0, 0x0, 0x0, 0x7, 0x0, 0x6, 0x0, 0x6,
    0x6, 0x46, 0x1d, 0xd6, 0x34, 0x3a, 0x30, 0x2e,
    0x34, 0x1e, 0x28, 0xe, 0xc, 0xa, 0xb, 0xb,
    0x2, 0xff, 0x0, 0x0,
    /* U+0065 "e" */
    0x7, 0xd0, 0x75, 0x83, 0x46, 0x1c, 0x34, 0x92,
    0x83, 0xb8, 0xa, 0x2, 0x4d, 0x1c, 0x1f, 0x80,
    /* U+0066 "f" */
    0x0, 0x0, 0x0, 0x2f, 0x0, 0x1c, 0x70, 0xa,
    0xc, 0x2, 0x40, 0x0, 0x90, 0x3, 0xff, 0xc0,
    0xa, 0x0, 0x1, 0x80, 0x0, 0x60, 0x0, 0x18,
    0x0, 0x6, 0x0, 0x1, 0xc0, 0x0, 0x30, 0x0,
    0x0, 0x0,
    /* U+0067 "g" */
    0x0, 0x0, 0xb, 0xc0, 0xa2, 0x87, 0xe, 0x30,
    0x39, 0x81, 0xe9, 0xf, 0xa4, 0x7a, 0x7b, 0x24,
    0x50, 0xd0, 0x3, 0x0, 0x28, 0x1f, 0x80,
    /* U+0068 "h" */
    0xc0, 0x3, 0x0, 0xd, 0x0, 0x24, 0x0, 0x90,
    0x92, 0x4e, 0xd9, 0xa1, 0xaf, 0x7, 0xb4, 0xe,
    0xc0, 0x3a, 0x1, 0xe8, 0x6, 0x60, 0x18, 0x0,
    0x0,
    /* U+0069 "i" */
    0x50, 0x9, 0x9d, 0x99, 0xa6, 0x71,
    /* U+006A "j" */
    0x0, 0x80, 0x0, 0x0, 0x0, 0xc, 0x0, 0xc0,
    0xd, 0x0, 0xd0, 0xd, 0x0, 0xc0, 0xc, 0x0,
    0xc0, 0xc, 0x1, 0x80, 0x74, 0x3d, 0x0,
    /* U+006B "k" */
    0x50, 0x0, 0xa0, 0x0, 0xa0, 0x0, 0xa0, 0x0,
    0xa0, 0xe0, 0xa2, 0x80, 0xab, 0x0, 0xbc, 0x0,
    0xb0, 0x0, 0xb4, 0x0, 0xae, 0x40, 0x91, 0xf4,
    0x80, 0x18,
    /* U+006C "l" */
    0x21, 0xc6, 0x28, 0x92, 0x49, 0x24, 0x92, 0x86,
    0xc, 0x30, 0x40,
    /* U+006D "m" */
    0x0, 0x0, 0x3, 0x0, 0xb, 0x8c, 0xf4, 0xa3,
    0x3b, 0x73, 0x9, 0xf4, 0xf4, 0x2b, 0xc3, 0xc0,
    0xaa, 0xe, 0x2, 0xa4, 0x34, 0xa, 0x90, 0x90,
    0x2a, 0x40, 0x0, 0xa0, 0x0, 0x0, 0x0,
    /* U+006E "n" */
    0x0, 0x0, 0xc0, 0xa0, 0xd3, 0xb4, 0x9a, 0x18,
    0xac, 0xc, 0xb4, 0xc, 0xb0, 0xc, 0xa0, 0xc,
    0x90, 0xc, 0x90, 0xc, 0x0, 0x0,
    /* U+006F "o" */
    0x0, 0x0, 0x3, 0xc0, 0xe, 0x70, 0x1c, 0x1c,
    0x24, 0xc, 0x30, 0xd, 0x30, 0xd, 0x30, 0xc,
    0x28, 0x1c, 0xf, 0xf0, 0x0, 0x0,
    /* U+0070 "p" */
    0x0, 0x1, 0x9e, 0x7, 0xd7, 0x1d, 0xd, 0x70,
    0x25, 0x80, 0x96, 0x3, 0x58, 0xc, 0xa0, 0xd2,
    0xfd, 0x6, 0x0, 0x18, 0x0, 0x60, 0x0, 0x0,
    0x0,
    /* U+0071 "q" */
    0x0, 0x0, 0x1, 0xd9, 0xb, 0x7d, 0xc, 0x1c,
    0x28, 0xc, 0x34, 0xc, 0x30, 0xc, 0x34, 0x1c,
    0x28, 0x3c, 0xb, 0xec, 0x0, 0xc, 0x0, 0xc,
    0x0, 0xc, 0x0, 0x0,
    /* U+0072 "r" */
    0x0, 0x0, 0xd, 0xd3, 0x89, 0xa0, 0xac, 0xb,
    0x40, 0xb0, 0xb, 0x0, 0xa0, 0xa, 0x0, 0x0,
    0x0,
    /* U+0073 "s" */
    0x6, 0x80, 0x76, 0x81, 0x83, 0x3, 0x80, 0x3,
    0x80, 0x3, 0x43, 0x3, 0xc, 0xc, 0x1e, 0xb0,
    0xa, 0x0,
    /* U+0074 "t" */
    0x0, 0x0, 0x9, 0x0, 0x34, 0x0, 0xc0, 0x7f,
    0xf8, 0xc, 0x0, 0x30, 0x0, 0xc0, 0x3, 0x0,
    0xc, 0x0, 0x30, 0x0, 0x90, 0x1, 0x80, 0x2,
    0x0,
    /* U+0075 "u" */
    0x60, 0x10, 0xa0, 0x30, 0x90, 0x30, 0x90, 0x70,
    0x90, 0x74, 0x90, 0xb4, 0x60, 0xe8, 0x31, 0xdc,
    0x2f, 0x4c, 0x4, 0x0,
    /* U+0076 "v" */
    0x20, 0x2, 0x4c, 0x0, 0xc2, 0x80, 0xa0, 0x30,
    0x34, 0xd, 0x1c, 0x1, 0xc9, 0x0, 0x33, 0x0,
    0xb, 0x80, 0x1, 0xd0, 0x0, 0x10, 0x0,
    /* U+0077 "w" */
    0x0, 0x0, 0x0, 0x8, 0x0, 0x0, 0xc3, 0x0,
    0x0, 0x70, 0x90, 0x80, 0x24, 0x18, 0x78, 0xc,
    0x3, 0x37, 0x6, 0x0, 0xdc, 0x93, 0x40, 0x2e,
    0x1c, 0xc0, 0x7, 0x43, 0xe0, 0x0, 0xc0, 0x74,
    0x0, 0x0, 0x4, 0x0,
    /* U+0078 "x" */
    0x24, 0x8, 0x70, 0xd0, 0xc7, 0x1, 0xf0, 0x3,
    0x80, 0xf, 0x0, 0xdd, 0x7, 0xc, 0x30, 0x28,
    0x40, 0x10,
    /* U+0079 "y" */
    0x0, 0x2, 0x0, 0x3a, 0x2, 0x9c, 0xd, 0x30,
    0x30, 0xa1, 0x80, 0xcd, 0x3, 0xb0, 0x7, 0x80,
    0xc, 0x0, 0xa0, 0x7, 0x0, 0x34, 0x0, 0x40,
    0x0,
    /* U+007A "z" */
    0x1f, 0xfc, 0x0, 0x28, 0x0, 0x70, 0x5, 0xe0,
    0xb, 0xe4, 0x7, 0x0, 0xd, 0x0, 0x28, 0x0,
    0x3f, 0xfd,
    /* U+007B "{" */
    0x0, 0x14, 0x0, 0xfd, 0x3, 0x40, 0x3, 0x0,
    0x3, 0x0, 0x3, 0x0, 0x7, 0x0, 0x2c, 0x0,
    0x2c, 0x0, 0x6, 0x0, 0x7, 0x0, 0x7, 0x0,
    0x3, 0x0, 0x2, 0xd5, 0x0, 0x69,
    /* U+007C "|" */
    0x0, 0x1, 0x80, 0x10, 0x1f, 0xc2, 0xf4, 0xff,
    0x4f, 0xfb, 0xfc, 0x2f, 0xff, 0xf0, 0x3f, 0xff,
    0x40, 0x3f, 0xf8, 0x0, 0x3f, 0xc0, 0x0, 0x3d,
    0x0, 0x0, 0x10, 0x0,
    /* U+007D "}" */
    0x29, 0x0, 0x27, 0xc0, 0x0, 0xd0, 0x0, 0x60,
    0x0, 0x60, 0x0, 0x70, 0x0, 0x3c, 0x0, 0x2d,
    0x0, 0x70, 0x0, 0x90, 0x0, 0x90, 0x0, 0xa0,
    0x0, 0xd0, 0x2b, 0x80, 0x19, 0x0,
    /* U+007E "~" */
    0x1, 0x0, 0x7, 0xe0, 0x83, 0xe, 0xe0, 0x0,
    0x90,
    /* U+00C0 "À" */
    0x0, 0x0, 0x0, 0x7, 0x40, 0x0, 0x7, 0x80,
    0x0, 0x18, 0x0, 0x0, 0xb0, 0x0, 0x3, 0xc0,
    0x0, 0x1e, 0x40, 0x0, 0x96, 0x0, 0x3, 0xc,
    0x0, 0x1c, 0x34, 0x0, 0x90, 0x60, 0x7, 0xbf,
    0xf4, 0x3d, 0x42, 0x80, 0x90, 0x3, 0x3, 0x0,
    0xa, 0xc, 0x0, 0xd, 0x10, 0x0, 0x14,
    /* U+00C2 "Â" */
    0x0, 0x10, 0x0, 0x3, 0xe0, 0x0, 0x38, 0xd0,
    0x0, 0x18, 0x40, 0x0, 0xb0, 0x0, 0x3, 0xc0,
    0x0, 0x1e, 0x40, 0x0, 0x96, 0x0, 0x3, 0xc,
    0x0, 0x1c, 0x34, 0x0, 0x90, 0x60, 0x7, 0xbf,
    0xf4, 0x3d, 0x42, 0x80, 0x90, 0x3, 0x3, 0x0,
    0xa, 0xc, 0x0, 0xd, 0x10, 0x0, 0x14,
    /* U+00C4 "Ä" */
    0x0, 0x88, 0x0, 0x0, 0x0, 0x0, 0x6, 0x0,
    0x0, 0x2c, 0x0, 0x0, 0xf0, 0x0, 0x7, 0x90,
    0x0, 0x25, 0x80, 0x0, 0xc3, 0x0, 0x6, 0x9,
    0x0, 0x24, 0x18, 0x1, 0xef, 0xfd, 0xf, 0x50,
    0xa0, 0x24, 0x0, 0xc0, 0xc0, 0x2, 0x83, 0x0,
    0x3, 0x44, 0x0, 0x5,
    /* U+00C6 "Æ" */
    0x0, 0x0, 0x0, 0x0, 0x0, 0x1f, 0xfe, 0x0,
    0x0, 0xb, 0x0, 0x0, 0x0, 0x3, 0x90, 0x0,
    0x0, 0x2, 0x58, 0x0, 0x0, 0x0, 0xc3, 0x0,
    0x0, 0x0, 0x60, 0xa0, 0x18, 0x0, 0x7f, 0xff,
    0xf9, 0x0, 0x1c, 0x3, 0x40, 0x0, 0xa, 0x0,
    0x70, 0x0, 0x3, 0x0, 0xd, 0x0, 0x0, 0xc0,
    0x0, 0xc0, 0x0, 0x10, 0x0, 0x1f, 0xff, 0x0,
    /* U+00C7 "Ç" */
    0x0, 0x0, 0x0, 0x7, 0xe0, 0x0, 0x70, 0xd0,
    0x3, 0x40, 0x80, 0x1c, 0x0, 0x0, 0x90, 0x0,
    0x3, 0x40, 0x0, 0xc, 0x0, 0x0, 0x30, 0x0,
    0x10, 0xc0, 0x0, 0xc2, 0x40, 0xa, 0x7, 0x0,
    0x70, 0xa, 0x7, 0x40, 0xb, 0xe0, 0x0, 0xd,
    0x0, 0x0, 0x2c, 0x0, 0x3, 0xd0, 0x0,
    /* U+00C8 "È" */
    0x0, 0x0, 0x7, 0x40, 0x0, 0x7c, 0x0, 0x0,
    0x0, 0xbf, 0xfc, 0x29, 0x0, 0x9, 0x0, 0x2,
    0x40, 0x0, 0xbb, 0xf0, 0x2d, 0x40, 0x9, 0x0,
    0x2, 0x40, 0x0, 0x90, 0x0, 0x24, 0x0, 0x9,
    0x1, 0xa5, 0xff, 0xa4,
    /* U+00C9 "É" */
    0x0, 0x0, 0x0, 0xa0, 0x0, 0xe0, 0x0, 0x0,
    0x0, 0xbf, 0xfc, 0x29, 0x0, 0x9, 0x0, 0x2,
    0x40, 0x0, 0xbb, 0xf0, 0x2d, 0x40, 0x9, 0x0,
    0x2, 0x40, 0x0, 0x90, 0x0, 0x24, 0x0, 0x9,
    0x1, 0xa5, 0xff, 0xa4,
    /* U+00CA "Ê" */
    0x7, 0x40, 0x3, 0xb4, 0x3, 0x47, 0x0, 0x0,
    0x0, 0xbf, 0xfc, 0x29, 0x0, 0x9, 0x0, 0x2,
    0x40, 0x0, 0xbb, 0xf0, 0x2d, 0x40, 0x9, 0x0,
    0x2, 0x40, 0x0, 0x90, 0x0, 0x24, 0x0, 0x9,
    0x1, 0xa5, 0xff, 0xa4,
    /* U+00CB "Ë" */
    0x8, 0x80, 0x0, 0x0, 0x0, 0x0, 0x2, 0xff,
    0xf0, 0xa4, 0x0, 0x24, 0x0, 0x9, 0x0, 0x2,
    0xef, 0xc0, 0xb5, 0x0, 0x24, 0x0, 0x9, 0x0,
    0x2, 0x40, 0x0, 0x90, 0x0, 0x24, 0x6, 0x97,
    0xfe, 0x90,
    /* U+00CE "Î" */
    0x7, 0x40, 0xe, 0xd0, 0x24, 0x70, 0x0, 0x4,
    0x3f, 0xfc, 0x2, 0x40, 0x2, 0x40, 0x2, 0x40,
    0x2, 0x40, 0x2, 0x40, 0x2, 0x40, 0x2, 0x40,
    0x2, 0x40, 0x2, 0x40, 0x2, 0x40, 0x2f, 0xff,
    0x14, 0x0,
    /* U+00CF "Ï" */
    0x8, 0x80, 0x0, 0x0, 0x0, 0x4, 0x3f, 0xfc,
    0x2, 0x40, 0x2, 0x40, 0x2, 0x40, 0x2, 0x40,
    0x2, 0x40, 0x2, 0x40, 0x2, 0x40, 0x2, 0x40,
    0x2, 0x40, 0x2, 0x40, 0x2f, 0xff, 0x14, 0x0,
    /* U+00D4 "Ô" */
    0x0, 0x40, 0x0, 0xf8, 0x0, 0xa3, 0x40, 0x1f,
    0xd0, 0xe, 0x2c, 0xa, 0x3, 0x43, 0x0, 0x71,
    0xc0, 0xc, 0x60, 0x3, 0x24, 0x0, 0xd9, 0x0,
    0x36, 0x80, 0xc, 0x70, 0x3, 0xc, 0x2, 0x81,
    0xd1, 0xc0, 0x1f, 0xc0,
    /* U+00D6 "Ö" */
    0x2, 0x20, 0x0, 0x0, 0x0, 0x3e, 0x0, 0x30,
    0x70, 0x24, 0x9, 0xc, 0x1, 0xc7, 0x0, 0x31,
    0x80, 0xc, 0x90, 0x3, 0x64, 0x0, 0xda, 0x0,
    0x31, 0xc0, 0xc, 0x30, 0xa, 0x7, 0x47, 0x0,
    0x7f, 0x0,
    /* U+00DB "Û" */
    0x1, 0x80, 0x1, 0xf8, 0x0, 0xd3, 0x1, 0x80,
    0xc, 0x60, 0x3, 0x18, 0x0, 0xc6, 0x0, 0x31,
    0x80, 0x1c, 0x70, 0x6, 0xc, 0x1, 0x83, 0x0,
    0x90, 0xd0, 0x30, 0x28, 0xc, 0x3, 0xa, 0x0,
    0xbb, 0x0, 0x5, 0x0,
    /* U+00DC "Ü" */
    0x2, 0x20, 0x0, 0x0, 0x6, 0x0, 0x31, 0x80,
    0xc, 0x60, 0x3, 0x18, 0x0, 0xc6, 0x0, 0x71,
    0xc0, 0x18, 0x30, 0x6, 0xc, 0x2, 0x43, 0x40,
    0xc0, 0xa0, 0x30, 0xc, 0x28, 0x2, 0xec, 0x0,
    0x14, 0x0,
    /* U+00E0 "à" */
    0x1, 0x0, 0x2, 0x80, 0x0, 0xd0, 0x2, 0xf0,
    0xe, 0x6c, 0x4, 0xd, 0x7, 0xda, 0x1d, 0x7e,
    0x30, 0xf, 0x30, 0xf, 0x30, 0x3f, 0x3f, 0xfb,
    0xa, 0x42, 0x0, 0x0,
    /* U+00E2 "â" */
    0x0, 0x40, 0x3, 0xe0, 0xe, 0x38, 0x6, 0xe0,
    0xe, 0x6c, 0x4, 0xd, 0x7, 0xda, 0x1d, 0x7e,
    0x30, 0xf, 0x30, 0xf, 0x30, 0x3f, 0x3f, 0xfb,
    0xa, 0x42, 0x0, 0x0,
    /* U+00E4 "ä" */
    0x3, 0x20, 0x0, 0x0, 0x2, 0xe0, 0xe, 0x6c,
    0x4, 0xd, 0x7, 0xda, 0x1d, 0x7e, 0x30, 0xf,
    0x30, 0xf, 0x30, 0x3f, 0x3f, 0xfb, 0xa, 0x42,
    0x0, 0x0,
    /* U+00E6 "æ" */
    0x2, 0xf8, 0xbc, 0x2, 0xc3, 0xf2, 0xc0, 0x0,
    0x70, 0x30, 0x1f, 0xdc, 0x1c, 0xd, 0x1f, 0x5d,
    0xa, 0x2, 0xf9, 0x3, 0x40, 0xb4, 0x14, 0xa0,
    0xbd, 0x2c, 0xb, 0xe1, 0xf8, 0x0, 0x0, 0x0,
    0x0,
    /* U+00E7 "ç" */
    0x0, 0x0, 0x2e, 0x3, 0x8c, 0x1c, 0x10, 0xa0,
    0x2, 0x40, 0x9, 0x0, 0x28, 0xa, 0x30, 0x70,
    0x7f, 0x0, 0x30, 0x1, 0xd0, 0x9, 0x0,
    /* U+00E8 "è" */
    0x0, 0x0, 0x30, 0x0, 0x70, 0x0, 0x90, 0x0,
    0x0, 0x1f, 0x41, 0xd6, 0xd, 0x18, 0x70, 0xd2,
    0x4a, 0xe, 0xe0, 0x28, 0x9, 0x34, 0x70, 0x7e,
    0x0,
    /* U+00E9 "é" */
    0x0, 0xa0, 0xb, 0x0, 0x20, 0x1, 0xf4, 0x1d,
    0x60, 0xd1, 0x87, 0xd, 0x24, 0xa0, 0xee, 0x2,
    0x80, 0x93, 0x47, 0x7, 0xe0,
    /* U+00EA "ê" */
    0x2, 0x80, 0x1f, 0x81, 0xc3, 0x0, 0x0, 0x7,
    0xd0, 0x75, 0x83, 0x46, 0x1c, 0x34, 0x92, 0x83,
    0xb8, 0xa, 0x2, 0x4d, 0x1c, 0x1f, 0x80,
    /* U+00EB "ë" */
    0x5, 0x50, 0x0, 0x0, 0x0, 0x1, 0xf4, 0x1d,
    0x60, 0xd1, 0x87, 0xd, 0x24, 0xa0, 0xee, 0x2,
    0x80, 0x93, 0x47, 0x7, 0xe0,
    /* U+00EE "î" */
    0xa, 0x3, 0xb4, 0x20, 0xc0, 0x0, 0x9, 0x0,
    0x90, 0xd, 0x0, 0x90, 0x9, 0x0, 0xa0, 0x6,
    0x0, 0x70, 0x1, 0x0,
    /* U+00EF "ï" */
    0x28, 0x0, 0x0, 0x24, 0x24, 0x34, 0x24, 0x24,
    0x28, 0x18, 0x1c, 0x4,
    /* U+00F4 "ô" */
    0x0, 0x0, 0x2, 0xd0, 0x7, 0x70, 0xc, 0x24,
    0x3, 0xc0, 0xe, 0x70, 0x1c, 0x1c, 0x24, 0xc,
    0x30, 0xd, 0x30, 0xd, 0x30, 0xc, 0x28, 0x1c,
    0xf, 0xf0, 0x0, 0x0,
    /* U+00F6 "ö" */
    0x2, 0x50, 0x0, 0x0, 0x3, 0xc0, 0xe, 0x70,
    0x1c, 0x1c, 0x24, 0xc, 0x30, 0xd, 0x30, 0xd,
    0x30, 0xc, 0x28, 0x1c, 0xf, 0xf0, 0x0, 0x0,
    /* U+00FB "û" */
    0x7, 0x80, 0xd, 0xd0, 0x14, 0x60, 0x10, 0x0,
    0xa0, 0x30, 0x90, 0x30, 0x90, 0x70, 0x90, 0x74,
    0x90, 0xb4, 0xa0, 0xf8, 0x70, 0xd8, 0x3b, 0x4c,
    0x9, 0x4,
    /* U+00FC "ü" */
    0x8, 0x80, 0x0, 0x0, 0x60, 0x20, 0xa0, 0x30,
    0x90, 0x70, 0x90, 0x70, 0x90, 0xb4, 0x90, 0xb4,
    0x60, 0xe8, 0x31, 0xdc, 0x2f, 0xc, 0x0, 0x0,
    /* U+00FF "ÿ" */
    0xc, 0x80, 0x0, 0xc, 0x1, 0xe8, 0xa, 0x30,
    0x34, 0xd0, 0xc1, 0x8a, 0x3, 0x30, 0xe, 0xc0,
    0x1d, 0x0, 0x70, 0x3, 0x40, 0x1c, 0x0, 0xc0,
    0x0, 0x0, 0x0,
    /* U+0152 "Œ" */
    0x0, 0x40, 0x10, 0xb, 0xbf, 0xe4, 0x1c, 0xc,
    0x0, 0x34, 0xa, 0x0, 0x30, 0x3, 0x0, 0x60,
    0x3, 0x0, 0xa0, 0x3, 0x40, 0x90, 0x3, 0xf8,
    0xa0, 0x3, 0x40, 0x60, 0x3, 0x0, 0x30, 0xa,
    0x0, 0x2c, 0x1d, 0x4, 0x7, 0xff, 0xfd,
    /* U+0153 "œ" */
    0x0, 0x0, 0x0, 0x7, 0xd2, 0xf4, 0xe, 0x7f,
    0x1c, 0x1c, 0x1c, 0xc, 0x34, 0xc, 0xc, 0x30,
    0xd, 0x34, 0x30, 0xf, 0xe0, 0x30, 0xe, 0x6,
    0x18, 0x1c, 0x1c, 0xb, 0xeb, 0xf0, 0x0, 0x0,
    0x0
};
/*---------------------
 *  GLYPH DESCRIPTION
 *--------------------*/
static const lv_font_fmt_txt_glyph_dsc_t glyph_dsc[] = {
    {.bitmap_index = 0, .adv_w = 0, .box_w = 0, .box_h = 0, .ofs_x = 0, .ofs_y = 0} /* id = 0 reserved */,
    {.bitmap_index = 0, .adv_w = 86, .box_w = 0, .box_h = 0, .ofs_x = 0, .ofs_y = 0},
    {.bitmap_index = 0, .adv_w = 46, .box_w = 3, .box_h = 14, .ofs_x = 0, .ofs_y = -1},
    {.bitmap_index = 11, .adv_w = 70, .box_w = 4, .box_h = 5, .ofs_x = 0, .ofs_y = 8},
    {.bitmap_index = 16, .adv_w = 173, .box_w = 11, .box_h = 12, .ofs_x = 0, .ofs_y = 1},
    {.bitmap_index = 49, .adv_w = 141, .box_w = 9, .box_h = 19, .ofs_x = 0, .ofs_y = -4},
    {.bitmap_index = 92, .adv_w = 181, .box_w = 9, .box_h = 15, .ofs_x = 2, .ofs_y = -1},
    {.bitmap_index = 126, .adv_w = 158, .box_w = 10, .box_h = 14, .ofs_x = 0, .ofs_y = -1},
    {.bitmap_index = 161, .adv_w = 31, .box_w = 2, .box_h = 4, .ofs_x = 0, .ofs_y = 10},
    {.bitmap_index = 163, .adv_w = 60, .box_w = 4, .box_h = 15, .ofs_x = 0, .ofs_y = -1},
    {.bitmap_index = 178, .adv_w = 60, .box_w = 4, .box_h = 15, .ofs_x = 0, .ofs_y = -1},
    {.bitmap_index = 193, .adv_w = 123, .box_w = 8, .box_h = 7, .ofs_x = 0, .ofs_y = 6},
    {.bitmap_index = 207, .adv_w = 111, .box_w = 8, .box_h = 8, .ofs_x = -1, .ofs_y = 4},
    {.bitmap_index = 223, .adv_w = 54, .box_w = 4, .box_h = 5, .ofs_x = -1, .ofs_y = -3},
    {.bitmap_index = 228, .adv_w = 91, .box_w = 7, .box_h = 3, .ofs_x = -1, .ofs_y = 4},
    {.bitmap_index = 234, .adv_w = 28, .box_w = 2, .box_h = 2, .ofs_x = 0, .ofs_y = 0},
    {.bitmap_index = 235, .adv_w = 144, .box_w = 10, .box_h = 14, .ofs_x = -1, .ofs_y = -1},
    {.bitmap_index = 270, .adv_w = 142, .box_w = 9, .box_h = 14, .ofs_x = 0, .ofs_y = 0},
    {.bitmap_index = 302, .adv_w = 88, .box_w = 2, .box_h = 12, .ofs_x = 3, .ofs_y = 0},
    {.bitmap_index = 308, .adv_w = 149, .box_w = 9, .box_h = 13, .ofs_x = 0, .ofs_y = 0},
    {.bitmap_index = 338, .adv_w = 160, .box_w = 10, .box_h = 14, .ofs_x = 0, .ofs_y = -1},
    {.bitmap_index = 373, .adv_w = 169, .box_w = 9, .box_h = 15, .ofs_x = 1, .ofs_y = -2},
    {.bitmap_index = 407, .adv_w = 149, .box_w = 9, .box_h = 14, .ofs_x = 0, .ofs_y = -1},
    {.bitmap_index = 439, .adv_w = 143, .box_w = 9, .box_h = 16, .ofs_x = 0, .ofs_y = -2},
    {.bitmap_index = 475, .adv_w = 129, .box_w = 8, .box_h = 13, .ofs_x = 0, .ofs_y = -1},
    {.bitmap_index = 501, .adv_w = 128, .box_w = 8, .box_h = 12, .ofs_x = 0, .ofs_y = 0},
    {.bitmap_index = 525, .adv_w = 128, .box_w = 8, .box_h = 14, .ofs_x = 0, .ofs_y = 0},
    {.bitmap_index = 553, .adv_w = 46, .box_w = 2, .box_h = 8, .ofs_x = 1, .ofs_y = 1},
    {.bitmap_index = 557, .adv_w = 36, .box_w = 3, .box_h = 11, .ofs_x = -1, .ofs_y = -3},
    {.bitmap_index = 566, .adv_w = 102, .box_w = 7, .box_h = 9, .ofs_x = -1, .ofs_y = 0},
    {.bitmap_index = 582, .adv_w = 104, .box_w = 6, .box_h = 5, .ofs_x = 0, .ofs_y = 5},
    {.bitmap_index = 590, .adv_w = 103, .box_w = 7, .box_h = 9, .ofs_x = -1, .ofs_y = 0},
    {.bitmap_index = 606, .adv_w = 120, .box_w = 8, .box_h = 13, .ofs_x = -1, .ofs_y = 0},
    {.bitmap_index = 632, .adv_w = 221, .box_w = 14, .box_h = 14, .ofs_x = 0, .ofs_y = 0},
    {.bitmap_index = 681, .adv_w = 180, .box_w = 11, .box_h = 14, .ofs_x = 0, .ofs_y = -1},
    {.bitmap_index = 720, .adv_w = 147, .box_w = 9, .box_h = 14, .ofs_x = 0, .ofs_y = -1},
    {.bitmap_index = 752, .adv_w = 155, .box_w = 11, .box_h = 14, .ofs_x = -1, .ofs_y = -1},
    {.bitmap_index = 791, .adv_w = 156, .box_w = 10, .box_h = 14, .ofs_x = 0, .ofs_y = -1},
    {.bitmap_index = 826, .adv_w = 150, .box_w = 9, .box_h = 13, .ofs_x = 0, .ofs_y = 0},
    {.bitmap_index = 856, .adv_w = 108, .box_w = 7, .box_h = 13, .ofs_x = 0, .ofs_y = 0},
    {.bitmap_index = 879, .adv_w = 144, .box_w = 10, .box_h = 15, .ofs_x = -1, .ofs_y = -1},
    {.bitmap_index = 917, .adv_w = 138, .box_w = 10, .box_h = 15, .ofs_x = -1, .ofs_y = -2},
    {.bitmap_index = 955, .adv_w = 121, .box_w = 8, .box_h = 14, .ofs_x = -1, .ofs_y = -1},
    {.bitmap_index = 983, .adv_w = 146, .box_w = 10, .box_h = 14, .ofs_x = -1, .ofs_y = 0},
    {.bitmap_index = 1018, .adv_w = 145, .box_w = 9, .box_h = 13, .ofs_x = 0, .ofs_y = -1},
    {.bitmap_index = 1048, .adv_w = 141, .box_w = 9, .box_h = 12, .ofs_x = 0, .ofs_y = 0},
    {.bitmap_index = 1075, .adv_w = 210, .box_w = 13, .box_h = 15, .ofs_x = 0, .ofs_y = -2},
    {.bitmap_index = 1124, .adv_w = 160, .box_w = 10, .box_h = 15, .ofs_x = 0, .ofs_y = -1},
    {.bitmap_index = 1162, .adv_w = 142, .box_w = 9, .box_h = 14, .ofs_x = 0, .ofs_y = 0},
    {.bitmap_index = 1194, .adv_w = 144, .box_w = 9, .box_h = 14, .ofs_x = 0, .ofs_y = 0},
    {.bitmap_index = 1226, .adv_w = 164, .box_w = 10, .box_h = 16, .ofs_x = 0, .ofs_y = -2},
    {.bitmap_index = 1266, .adv_w = 166, .box_w = 10, .box_h = 14, .ofs_x = 0, .ofs_y = -1},
    {.bitmap_index = 1301, .adv_w = 136, .box_w = 8, .box_h = 14, .ofs_x = 0, .ofs_y = -1},
    {.bitmap_index = 1329, .adv_w = 136, .box_w = 10, .box_h = 13, .ofs_x = -1, .ofs_y = 0},
    {.bitmap_index = 1362, .adv_w = 138, .box_w = 9, .box_h = 13, .ofs_x = 0, .ofs_y = -1},
    {.bitmap_index = 1392, .adv_w = 144, .box_w = 9, .box_h = 14, .ofs_x = 0, .ofs_y = -1},
    {.bitmap_index = 1424, .adv_w = 217, .box_w = 15, .box_h = 14, .ofs_x = -1, .ofs_y = -1},
    {.bitmap_index = 1477, .adv_w = 151, .box_w = 9, .box_h = 14, .ofs_x = 0, .ofs_y = -1},
    {.bitmap_index = 1509, .adv_w = 131, .box_w = 8, .box_h = 14, .ofs_x = 0, .ofs_y = 0},
    {.bitmap_index = 1537, .adv_w = 166, .box_w = 10, .box_h = 12, .ofs_x = 0, .ofs_y = 0},
    {.bitmap_index = 1567, .adv_w = 103, .box_w = 6, .box_h = 16, .ofs_x = 0, .ofs_y = -2},
    {.bitmap_index = 1591, .adv_w = 139, .box_w = 9, .box_h = 14, .ofs_x = 0, .ofs_y = -1},
    {.bitmap_index = 1623, .adv_w = 103, .box_w = 6, .box_h = 16, .ofs_x = 0, .ofs_y = -2},
    {.bitmap_index = 1647, .adv_w = 94, .box_w = 7, .box_h = 6, .ofs_x = -1, .ofs_y = 8},
    {.bitmap_index = 1658, .adv_w = 128, .box_w = 8, .box_h = 2, .ofs_x = 0, .ofs_y = -3},
    {.bitmap_index = 1662, .adv_w = 120, .box_w = 8, .box_h = 11, .ofs_x = -1, .ofs_y = -1},
    {.bitmap_index = 1684, .adv_w = 122, .box_w = 8, .box_h = 13, .ofs_x = 0, .ofs_y = 0},
    {.bitmap_index = 1710, .adv_w = 112, .box_w = 7, .box_h = 11, .ofs_x = 0, .ofs_y = -1},
    {.bitmap_index = 1730, .adv_w = 116, .box_w = 8, .box_h = 14, .ofs_x = -1, .ofs_y = -1},
    {.bitmap_index = 1758, .adv_w = 112, .box_w = 7, .box_h = 9, .ofs_x = 0, .ofs_y = 0},
    {.bitmap_index = 1774, .adv_w = 115, .box_w = 9, .box_h = 15, .ofs_x = -1, .ofs_y = -1},
    {.bitmap_index = 1808, .adv_w = 110, .box_w = 7, .box_h = 13, .ofs_x = 0, .ofs_y = -3},
    {.bitmap_index = 1831, .adv_w = 120, .box_w = 7, .box_h = 14, .ofs_x = 0, .ofs_y = -2},
    {.bitmap_index = 1856, .adv_w = 39, .box_w = 2, .box_h = 12, .ofs_x = 0, .ofs_y = -1},
    {.bitmap_index = 1862, .adv_w = 44, .box_w = 6, .box_h = 15, .ofs_x = -3, .ofs_y = -3},
    {.bitmap_index = 1885, .adv_w = 128, .box_w = 8, .box_h = 13, .ofs_x = 0, .ofs_y = -1},
    {.bitmap_index = 1911, .adv_w = 45, .box_w = 3, .box_h = 14, .ofs_x = 0, .ofs_y = -1},
    {.bitmap_index = 1922, .adv_w = 179, .box_w = 11, .box_h = 11, .ofs_x = 0, .ofs_y = -1},
    {.bitmap_index = 1953, .adv_w = 123, .box_w = 8, .box_h = 11, .ofs_x = 0, .ofs_y = -1},
    {.bitmap_index = 1975, .adv_w = 108, .box_w = 8, .box_h = 11, .ofs_x = -1, .ofs_y = -1},
    {.bitmap_index = 1997, .adv_w = 114, .box_w = 7, .box_h = 14, .ofs_x = 0, .ofs_y = -4},
    {.bitmap_index = 2022, .adv_w = 107, .box_w = 8, .box_h = 14, .ofs_x = -1, .ofs_y = -4},
    {.bitmap_index = 2050, .adv_w = 97, .box_w = 6, .box_h = 11, .ofs_x = 0, .ofs_y = -1},
    {.bitmap_index = 2067, .adv_w = 93, .box_w = 7, .box_h = 10, .ofs_x = -1, .ofs_y = -1},
    {.bitmap_index = 2085, .adv_w = 97, .box_w = 7, .box_h = 14, .ofs_x = -1, .ofs_y = -1},
    {.bitmap_index = 2110, .adv_w = 120, .box_w = 8, .box_h = 10, .ofs_x = 0, .ofs_y = -1},
    {.bitmap_index = 2130, .adv_w = 123, .box_w = 9, .box_h = 10, .ofs_x = -1, .ofs_y = -1},
    {.bitmap_index = 2153, .adv_w = 189, .box_w = 13, .box_h = 11, .ofs_x = -1, .ofs_y = -1},
    {.bitmap_index = 2189, .adv_w = 104, .box_w = 7, .box_h = 10, .ofs_x = -1, .ofs_y = -1},
    {.bitmap_index = 2207, .adv_w = 115, .box_w = 7, .box_h = 14, .ofs_x = 0, .ofs_y = -4},
    {.bitmap_index = 2232, .adv_w = 114, .box_w = 8, .box_h = 9, .ofs_x = -1, .ofs_y = 0},
    {.bitmap_index = 2250, .adv_w = 115, .box_w = 8, .box_h = 15, .ofs_x = -1, .ofs_y = -1},
    {.bitmap_index = 2280, .adv_w = 170, .box_w = 11, .box_h = 10, .ofs_x = 0, .ofs_y = 0},
    {.bitmap_index = 2308, .adv_w = 113, .box_w = 8, .box_h = 15, .ofs_x = -1, .ofs_y = -1},
    {.bitmap_index = 2338, .adv_w = 125, .box_w = 9, .box_h = 4, .ofs_x = -1, .ofs_y = 8},
    {.bitmap_index = 2347, .adv_w = 180, .box_w = 11, .box_h = 17, .ofs_x = 0, .ofs_y = -1},
    {.bitmap_index = 2394, .adv_w = 180, .box_w = 11, .box_h = 17, .ofs_x = 0, .ofs_y = -1},
    {.bitmap_index = 2441, .adv_w = 180, .box_w = 11, .box_h = 16, .ofs_x = 0, .ofs_y = -1},
    {.bitmap_index = 2485, .adv_w = 269, .box_w = 17, .box_h = 13, .ofs_x = 0, .ofs_y = 0},
    {.bitmap_index = 2541, .adv_w = 155, .box_w = 11, .box_h = 17, .ofs_x = -1, .ofs_y = -3},
    {.bitmap_index = 2588, .adv_w = 150, .box_w = 9, .box_h = 16, .ofs_x = 0, .ofs_y = 0},
    {.bitmap_index = 2624, .adv_w = 150, .box_w = 9, .box_h = 16, .ofs_x = 0, .ofs_y = 0},
    {.bitmap_index = 2660, .adv_w = 150, .box_w = 9, .box_h = 16, .ofs_x = 0, .ofs_y = 0},
    {.bitmap_index = 2696, .adv_w = 150, .box_w = 9, .box_h = 15, .ofs_x = 0, .ofs_y = 0},
    {.bitmap_index = 2730, .adv_w = 121, .box_w = 8, .box_h = 17, .ofs_x = -1, .ofs_y = -1},
    {.bitmap_index = 2764, .adv_w = 121, .box_w = 8, .box_h = 16, .ofs_x = -1, .ofs_y = -1},
    {.bitmap_index = 2796, .adv_w = 142, .box_w = 9, .box_h = 16, .ofs_x = 0, .ofs_y = 0},
    {.bitmap_index = 2832, .adv_w = 142, .box_w = 9, .box_h = 15, .ofs_x = 0, .ofs_y = 0},
    {.bitmap_index = 2866, .adv_w = 138, .box_w = 9, .box_h = 16, .ofs_x = 0, .ofs_y = -1},
    {.bitmap_index = 2902, .adv_w = 138, .box_w = 9, .box_h = 15, .ofs_x = 0, .ofs_y = -1},
    {.bitmap_index = 2936, .adv_w = 120, .box_w = 8, .box_h = 14, .ofs_x = -1, .ofs_y = -1},
    {.bitmap_index = 2964, .adv_w = 120, .box_w = 8, .box_h = 14, .ofs_x = -1, .ofs_y = -1},
    {.bitmap_index = 2992, .adv_w = 120, .box_w = 8, .box_h = 13, .ofs_x = -1, .ofs_y = -1},
    {.bitmap_index = 3018, .adv_w = 188, .box_w = 13, .box_h = 10, .ofs_x = -1, .ofs_y = -1},
    {.bitmap_index = 3051, .adv_w = 112, .box_w = 7, .box_h = 13, .ofs_x = 0, .ofs_y = -3},
    {.bitmap_index = 3074, .adv_w = 112, .box_w = 7, .box_h = 14, .ofs_x = 0, .ofs_y = 0},
    {.bitmap_index = 3099, .adv_w = 112, .box_w = 7, .box_h = 12, .ofs_x = 0, .ofs_y = 0},
    {.bitmap_index = 3120, .adv_w = 112, .box_w = 7, .box_h = 13, .ofs_x = 0, .ofs_y = 0},
    {.bitmap_index = 3143, .adv_w = 112, .box_w = 7, .box_h = 12, .ofs_x = 0, .ofs_y = 0},
    {.bitmap_index = 3164, .adv_w = 59, .box_w = 6, .box_h = 13, .ofs_x = -2, .ofs_y = -1},
    {.bitmap_index = 3184, .adv_w = 45, .box_w = 4, .box_h = 12, .ofs_x = -1, .ofs_y = -1},
    {.bitmap_index = 3196, .adv_w = 111, .box_w = 8, .box_h = 14, .ofs_x = -1, .ofs_y = -1},
    {.bitmap_index = 3224, .adv_w = 111, .box_w = 8, .box_h = 12, .ofs_x = -1, .ofs_y = -1},
    {.bitmap_index = 3248, .adv_w = 120, .box_w = 8, .box_h = 13, .ofs_x = 0, .ofs_y = -1},
    {.bitmap_index = 3274, .adv_w = 120, .box_w = 8, .box_h = 12, .ofs_x = 0, .ofs_y = -1},
    {.bitmap_index = 3298, .adv_w = 119, .box_w = 7, .box_h = 15, .ofs_x = 0, .ofs_y = -4},
    {.bitmap_index = 3325, .adv_w = 195, .box_w = 12, .box_h = 13, .ofs_x = 0, .ofs_y = 0},
    {.bitmap_index = 3364, .adv_w = 181, .box_w = 12, .box_h = 11, .ofs_x = -1, .ofs_y = -1}
};
/*---------------------
 *  CHARACTER MAPPING
 *--------------------*/
static const uint16_t unicode_list_2[] = {
    0x0, 0x2, 0x4, 0x6, 0x7, 0x8, 0x9, 0xa,
    0xb, 0xe, 0xf, 0x14, 0x16, 0x1b, 0x1c, 0x20,
    0x22, 0x24, 0x26, 0x27, 0x28, 0x29, 0x2a, 0x2b,
    0x2e, 0x2f, 0x34, 0x36, 0x3b, 0x3c, 0x3f, 0x92,
    0x93
};
/*Collect the unicode lists and glyph_id offsets*/
static const lv_font_fmt_txt_cmap_t cmaps[] =
{
    {
        .range_start = 32, .range_length = 64, .glyph_id_start = 1,
        .unicode_list = NULL, .glyph_id_ofs_list = NULL, .list_length = 0, .type = LV_FONT_FMT_TXT_CMAP_FORMAT0_TINY
    },
    {
        .range_start = 97, .range_length = 30, .glyph_id_start = 65,
        .unicode_list = NULL, .glyph_id_ofs_list = NULL, .list_length = 0, .type = LV_FONT_FMT_TXT_CMAP_FORMAT0_TINY
    },
    {
        .range_start = 192, .range_length = 148, .glyph_id_start = 95,
        .unicode_list = unicode_list_2, .glyph_id_ofs_list = NULL, .list_length = 33, .type = LV_FONT_FMT_TXT_CMAP_SPARSE_TINY
    }
};
/*--------------------
 *  ALL CUSTOM DATA
 *--------------------*/
/*Store all the custom data of the font*/
static lv_font_fmt_txt_glyph_cache_t cache;
static const lv_font_fmt_txt_dsc_t font_dsc = {
    .glyph_bitmap = glyph_bitmap,
    .glyph_dsc = glyph_dsc,
    .cmaps = cmaps,
    .kern_dsc = NULL,
    .kern_scale = 0,
    .cmap_num = 3,
    .bpp = 2,
    .kern_classes = 0,
    .bitmap_format = 0,
    .cache = &cache
};
/*-----------------
 *  PUBLIC FONT
 *----------------*/
/*Initialize a public general font descriptor*/
const lv_font_t pen_24 = {
    .get_glyph_dsc = lv_font_get_glyph_dsc_fmt_txt,    /*Function pointer to get glyph's data*/
    .get_glyph_bitmap = lv_font_get_bitmap_fmt_txt,    /*Function pointer to get glyph's bitmap*/
    .line_height = 20,          /*The maximum line height required by the font*/
    .base_line = 4,             /*Baseline measured from the bottom of the line*/

    .subpx = LV_FONT_SUBPX_NONE,
    .underline_position = -1,
    .underline_thickness = 1,
    .dsc = &font_dsc,          /*The custom font data. Will be accessed by `get_glyph_bitmap/dsc` */
};
#endif

/*******************************************************************************
 * Size: 17 px
 * Bpp: 2
 ******************************************************************************/


#ifdef __has_include

    #if __has_include("lvgl.h")
         #ifndef LV_LVGL_H_INCLUDE_SIMPLE
             #define LV_LVGL_H_INCLUDE_SIMPLE
         #endif
     #endif
 #endif

 #ifdef LV_LVGL_H_INCLUDE_SIMPLE
     #include "lvgl.h"
 #else
     #include "../lvgl-8.3.11/lvgl.h"
 #endif

 #ifndef TYPEWRITER
 #define TYPEWRITER 1
 #endif

 #if TYPEWRITER

/*-----------------
 *    BITMAPS
 *----------------*/
/*Store the image of the glyphs*/
static LV_ATTRIBUTE_LARGE_CONST const uint8_t glyph_bitmap[] = {
    /* U+0020 " " */
    /* U+0021 "!" */
    0xb2, 0xcb, 0x1c, 0x71, 0xc7, 0x1c, 0x20, 0x0,
    0x1c, 0x70,
    /* U+0022 "\"" */
    0xe3, 0xb8, 0xee, 0x2a, 0x4a, 0x0, 0x0,
    /* U+0023 "#" */
    0x7, 0x1, 0xc0, 0x7, 0x1, 0xc0, 0x7, 0x1,
    0xc0, 0xff, 0xff, 0xff, 0x5b, 0x56, 0xe5, 0x7,
    0x1, 0xc0, 0x7, 0x1, 0xc0, 0x7, 0x1, 0xc0,
    0xb, 0x1, 0xd0, 0xff, 0xff, 0xff, 0x5b, 0x55,
    0xd5, 0x7, 0x1, 0xc0, 0x7, 0x1, 0xc0,
    /* U+0024 "$" */
    0x0, 0x0, 0x0, 0xe, 0x0, 0x0, 0xf0, 0x3,
    0xff, 0xfc, 0xe5, 0x55, 0x4e, 0x0, 0x0, 0xe0,
    0x0, 0xf, 0xff, 0xfc, 0x55, 0x56, 0xc0, 0x0,
    0x1c, 0x0, 0x1, 0xc0, 0x0, 0x1c, 0xff, 0xff,
    0x45, 0x6d, 0x50, 0x1, 0xc0, 0x0, 0x4, 0x0,
    /* U+0025 "%" */
    0x70, 0x1, 0xd7, 0x0, 0x3c, 0x0, 0x7, 0x0,
    0x0, 0xe0, 0x0, 0x2c, 0x0, 0x3, 0x80, 0x0,
    0xb0, 0x0, 0x1d, 0x0, 0x3, 0xc0, 0x0, 0x70,
    0x0, 0xe, 0x0, 0x2, 0xc0, 0xe, 0x34, 0x0,
    0xe0,
    /* U+0026 "&" */
    0x3, 0xff, 0xf0, 0x1, 0xe5, 0x54, 0x0, 0x3c,
    0x0, 0x0, 0x3, 0x80, 0x0, 0x0, 0xb4, 0x0,
    0x7, 0xff, 0x3, 0x83, 0x95, 0xe2, 0xc0, 0xd0,
    0x1e, 0xd0, 0x34, 0x2, 0xf0, 0xd, 0x0, 0x78,
    0x3, 0x40, 0x3f, 0x40, 0xe5, 0x6c, 0xb0, 0xf,
    0xfd, 0xe, 0x0,
    /* U+0027 "'" */
    0xee, 0xe9, 0x0,
    /* U+0028 "(" */
    0x0, 0x1f, 0xde, 0x53, 0x80, 0xe0, 0x38, 0xe,
    0x3, 0x80, 0xe0, 0x38, 0xe, 0x3, 0x80, 0xe0,
    0x38, 0xe, 0x3, 0x94, 0x3f, 0x40,
    /* U+0029 ")" */
    0x0, 0x2f, 0xc1, 0x78, 0xf, 0x3, 0xc0, 0xf0,
    0x3c, 0xf, 0x3, 0xc0, 0xf0, 0x3c, 0xf, 0x3,
    0xc0, 0xf0, 0x3d, 0x5e, 0xbf, 0x0,
    /* U+002A "*" */
    0x0, 0xc0, 0x8, 0x30, 0x83, 0xdd, 0xf0, 0x2f,
    0xe0, 0x7, 0xf4, 0xf, 0xbb, 0x82, 0xc, 0x20,
    0x3, 0x0, 0x0, 0x0, 0x0,
    /* U+002B "+" */
    0x0, 0xb0, 0x0, 0xb, 0x0, 0x0, 0xb0, 0x0,
    0xb, 0x0, 0x7f, 0xff, 0xe1, 0x5f, 0x54, 0x0,
    0xb0, 0x0, 0xb, 0x0, 0x0, 0xb0, 0x0, 0x5,
    0x0,
    /* U+002C "," */
    0x1c, 0x1c, 0x1c, 0x30,
    /* U+002D "-" */
    0x2a, 0x87, 0xfc,
    /* U+002E "." */
    0xab,
    /* U+002F "/" */
    0x0, 0x1c, 0x0, 0x38, 0x0, 0x70, 0x0, 0xf0,
    0x0, 0xd0, 0x2, 0xc0, 0x3, 0x80, 0x7, 0x0,
    0xe, 0x0, 0x1c, 0x0, 0x3c, 0x0, 0x34, 0x0,
    0xb0, 0x0,
    /* U+0030 "0" */
    0x3f, 0xff, 0xe, 0x55, 0x6c, 0xe0, 0x2, 0xce,
    0x0, 0x2c, 0xe0, 0x2, 0xce, 0x0, 0x2c, 0xe0,
    0x2, 0xce, 0x0, 0x2c, 0xe0, 0x2, 0xce, 0x0,
    0x2c, 0xe0, 0x2, 0xce, 0x55, 0x6c, 0x3f, 0xff,
    0x0,
    /* U+0031 "1" */
    0x1, 0x40, 0xfe, 0x2, 0x78, 0x0, 0xe0, 0x3,
    0x80, 0xe, 0x0, 0x38, 0x0, 0xe0, 0x3, 0x80,
    0xe, 0x0, 0x38, 0x5, 0xf4, 0x3f, 0xf8,
    /* U+0032 "2" */
    0xff, 0xff, 0x45, 0x55, 0x6c, 0x0, 0x1, 0xc0,
    0x0, 0x1c, 0x0, 0x1, 0xc0, 0x0, 0x6c, 0xaf,
    0xff, 0xcf, 0x94, 0x0, 0xe0, 0x0, 0xe, 0x0,
    0x0, 0xe0, 0x0, 0xe, 0x55, 0x54, 0xff, 0xff,
    0xc0,
    /* U+0033 "3" */
    0x7f, 0xff, 0x41, 0x55, 0x6d, 0x0, 0x0, 0xd0,
    0x0, 0xd, 0x0, 0x0, 0xd0, 0x0, 0x1d, 0x1f,
    0xff, 0x80, 0x55, 0x5e, 0x0, 0x0, 0xe0, 0x0,
    0xe, 0x0, 0x0, 0xe1, 0x55, 0x5e, 0x7f, 0xff,
    0xc0,
    /* U+0034 "4" */
    0x38, 0x0, 0xb3, 0x80, 0xb, 0x38, 0x0, 0xb3,
    0x40, 0xb, 0x34, 0x0, 0xb3, 0x40, 0xb, 0x34,
    0x0, 0xb3, 0x40, 0xb, 0x7f, 0xff, 0xf1, 0x55,
    0x5f, 0x0, 0x0, 0xb0, 0x0, 0xb, 0x0, 0x0,
    0xb0,
    /* U+0035 "5" */
    0xff, 0xff, 0xce, 0x55, 0x54, 0xe0, 0x0, 0xe,
    0x0, 0x0, 0xe0, 0x0, 0xe, 0x0, 0x0, 0xff,
    0xff, 0xc0, 0x0, 0x1c, 0x0, 0x1, 0xc0, 0x0,
    0x1c, 0x0, 0x1, 0xc5, 0x55, 0x6c, 0xff, 0xff,
    0x40,
    /* U+0036 "6" */
    0x3f, 0xff, 0x4e, 0x55, 0x50, 0xe0, 0x0, 0xe,
    0x0, 0x0, 0xe0, 0x0, 0xf, 0xff, 0xf4, 0xe5,
    0x56, 0xce, 0x0, 0x2c, 0xe0, 0x2, 0xce, 0x0,
    0x2c, 0xe0, 0x2, 0xce, 0x55, 0x6c, 0x3f, 0xff,
    0x0,
    /* U+0037 "7" */
    0x7f, 0xff, 0xf7, 0x95, 0x5f, 0x70, 0x0, 0xb7,
    0x0, 0xb, 0x10, 0x0, 0xf0, 0x0, 0x1d, 0x0,
    0x3, 0x80, 0x0, 0xf0, 0x0, 0x1d, 0x0, 0x3,
    0x80, 0x0, 0xf0, 0x0, 0x1d, 0x0, 0x3, 0x80,
    0x0,
    /* U+0038 "8" */
    0xf, 0xff, 0xd0, 0xb5, 0x56, 0xc3, 0x80, 0x7,
    0xe, 0x0, 0x1c, 0x38, 0x0, 0x70, 0xf0, 0x1,
    0xc0, 0xff, 0xfe, 0xe, 0x55, 0x5d, 0x34, 0x0,
    0x38, 0xd0, 0x0, 0xe3, 0x40, 0x3, 0x8e, 0x55,
    0x5d, 0x1f, 0xff, 0xe0,
    /* U+0039 "9" */
    0x3f, 0xff, 0xe, 0x55, 0x6c, 0xe0, 0x2, 0xce,
    0x0, 0x2c, 0xe0, 0x2, 0xce, 0x0, 0x2c, 0xe0,
    0x2, 0xcb, 0xff, 0xfc, 0x15, 0x56, 0xc0, 0x0,
    0x2c, 0x0, 0x2, 0xc1, 0x55, 0x6c, 0x7f, 0xff,
    0x0,
    /* U+003A ":" */
    0xba, 0x0, 0x0, 0xab,
    /* U+003B ";" */
    0x28, 0xe0, 0x0, 0x0, 0x0, 0xa, 0x2c, 0xa7,
    0x0,
    /* U+003C "<" */
    0x0, 0x0, 0x90, 0x0, 0xbd, 0x0, 0xbe, 0x1,
    0xbd, 0x0, 0x7d, 0x0, 0x7, 0xd0, 0x0, 0x1b,
    0xd0, 0x0, 0xb, 0xe0, 0x0, 0xb, 0xd0, 0x0,
    0x9,
    /* U+003D "=" */
    0x0, 0x0, 0x7, 0xff, 0xfe, 0x15, 0x55, 0x40,
    0x0, 0x0, 0x0, 0x0, 0x7, 0xff, 0xfe, 0x15,
    0x55, 0x40,
    /* U+003E ">" */
    0x60, 0x0, 0x3, 0xe0, 0x0, 0x7, 0xf4, 0x0,
    0x7, 0xf4, 0x0, 0x6, 0xe0, 0x0, 0x6e, 0x0,
    0x7f, 0x40, 0x7f, 0x40, 0x3e, 0x0, 0x6, 0x0,
    0x0,
    /* U+003F "?" */
    0xff, 0xff, 0x5, 0x55, 0x6c, 0x0, 0x1, 0xc0,
    0x0, 0x1c, 0x0, 0x1, 0xc0, 0x1, 0xbc, 0x7,
    0xfe, 0x40, 0xb4, 0x0, 0xb, 0x0, 0x0, 0x0,
    0x0, 0x0, 0x0, 0x0, 0x60, 0x0, 0xb, 0x0,
    0x0,
    /* U+0040 "@" */
    0x3f, 0xff, 0xf8, 0xe5, 0x55, 0x5d, 0xe0, 0x0,
    0xe, 0xe0, 0x0, 0xe, 0xe0, 0xaa, 0xae, 0xe0,
    0xfa, 0x9e, 0xe0, 0xe0, 0xe, 0xe0, 0xe0, 0xe,
    0xe0, 0xe0, 0xe, 0xe0, 0x3f, 0xfc, 0xe0, 0x5,
    0x50, 0xe0, 0x0, 0x0, 0xe0, 0x0, 0x0, 0xe5,
    0x55, 0x54, 0x3f, 0xff, 0xfe,
    /* U+0041 "A" */
    0x2, 0xfe, 0x0, 0xe, 0x6c, 0x0, 0x34, 0x70,
    0x1, 0xc0, 0xd0, 0xb, 0x3, 0x80, 0x38, 0xb,
    0x0, 0xd0, 0x1c, 0x7, 0x0, 0x34, 0x2f, 0xff,
    0xe0, 0xe5, 0x56, 0xc3, 0x40, 0x7, 0x1c, 0x0,
    0xd, 0xb0, 0x0, 0x38,
    /* U+0042 "B" */
    0xff, 0xff, 0xe, 0x55, 0x7c, 0xe0, 0x2, 0xce,
    0x0, 0x2c, 0xe0, 0x2, 0xce, 0x0, 0x2c, 0xff,
    0xff, 0x4e, 0x55, 0x6c, 0xe0, 0x1, 0xce, 0x0,
    0x1c, 0xe0, 0x1, 0xce, 0x55, 0x6c, 0xff, 0xff,
    0x40,
    /* U+0043 "C" */
    0x3f, 0xfe, 0xf5, 0x55, 0xe0, 0x0, 0xe0, 0x0,
    0xe0, 0x0, 0xe0, 0x0, 0xe0, 0x0, 0xe0, 0x0,
    0xe0, 0x0, 0xe0, 0x0, 0xe0, 0x0, 0xf5, 0x55,
    0x3f, 0xff,
    /* U+0044 "D" */
    0xff, 0xff, 0x39, 0x55, 0xee, 0x0, 0x3f, 0x80,
    0xf, 0xe0, 0x3, 0xf8, 0x0, 0xfe, 0x0, 0x3f,
    0x80, 0xf, 0xe0, 0x3, 0xf8, 0x0, 0xfe, 0x0,
    0x3f, 0x95, 0x5e, 0xff, 0xff, 0x0,
    /* U+0045 "E" */
    0xff, 0xff, 0x39, 0x55, 0x4e, 0x0, 0x3, 0x80,
    0x0, 0xe0, 0x0, 0x38, 0x0, 0xf, 0xff, 0xd3,
    0x95, 0x50, 0xe0, 0x0, 0x38, 0x0, 0xe, 0x0,
    0x3, 0x95, 0x54, 0xff, 0xff, 0x40,
    /* U+0046 "F" */
    0xff, 0xff, 0x39, 0x55, 0x4e, 0x0, 0x3, 0x80,
    0x0, 0xe0, 0x0, 0x38, 0x0, 0xe, 0x0, 0x3,
    0xff, 0xfc, 0xe5, 0x55, 0x38, 0x0, 0xe, 0x0,
    0x3, 0x80, 0x0, 0xe0, 0x0, 0x0,
    /* U+0047 "G" */
    0x3f, 0xff, 0x8e, 0x55, 0x50, 0xe0, 0x0, 0xe,
    0x0, 0x0, 0xe0, 0x0, 0xe, 0x0, 0x0, 0xe0,
    0xff, 0xce, 0x5, 0x6c, 0xe0, 0x1, 0xce, 0x0,
    0x1c, 0xe0, 0x1, 0xce, 0x55, 0x6c, 0x3f, 0xff,
    0xc0,
    /* U+0048 "H" */
    0xe0, 0x0, 0xde, 0x0, 0xd, 0xe0, 0x0, 0xde,
    0x0, 0xd, 0xe0, 0x0, 0xde, 0x0, 0x1d, 0xff,
    0xff, 0xde, 0x55, 0x5d, 0xe0, 0x0, 0xde, 0x0,
    0xd, 0xe0, 0x0, 0xde, 0x0, 0xd, 0xe0, 0x0,
    0xd0,
    /* U+0049 "I" */
    0x3f, 0xf8, 0x5e, 0x40, 0x34, 0x0, 0xd0, 0x3,
    0x40, 0xd, 0x0, 0x34, 0x0, 0xd0, 0x3, 0x40,
    0xd, 0x0, 0x34, 0x5, 0xe4, 0x3f, 0xf8,
    /* U+004A "J" */
    0x3f, 0xff, 0xc1, 0x55, 0x6c, 0x0, 0x1, 0xc0,
    0x0, 0x1c, 0x0, 0x1, 0xc0, 0x0, 0x1c, 0x0,
    0x1, 0xc2, 0x0, 0x1c, 0x70, 0x1, 0xc7, 0x0,
    0x1c, 0x70, 0x1, 0xc3, 0x95, 0x6c, 0x1f, 0xff,
    0x0,
    /* U+004B "K" */
    0xe0, 0x2, 0xce, 0x0, 0x78, 0xe0, 0xf, 0xe,
    0x1, 0xd0, 0xe0, 0x3c, 0xe, 0x7, 0x40, 0xff,
    0xf0, 0xe, 0x57, 0x40, 0xe0, 0x2c, 0xe, 0x0,
    0xe0, 0xe0, 0xb, 0xe, 0x0, 0x38, 0xe0, 0x1,
    0xd0,
    /* U+004C "L" */
    0xe0, 0x0, 0x38, 0x0, 0xe, 0x0, 0x3, 0x80,
    0x0, 0xe0, 0x0, 0x38, 0x0, 0xe, 0x0, 0x3,
    0x80, 0x0, 0xe0, 0x3, 0xb8, 0x0, 0xee, 0x0,
    0x3b, 0x95, 0x5e, 0xff, 0xff, 0x80,
    /* U+004D "M" */
    0xf0, 0x0, 0x3c, 0xf8, 0x0, 0x7c, 0xfd, 0x0,
    0xfc, 0xeb, 0x2, 0xdc, 0xe3, 0x43, 0x5c, 0xe2,
    0xcb, 0x1c, 0xe0, 0xdd, 0x1c, 0xe0, 0xbc, 0x1c,
    0xe0, 0x34, 0x1c, 0xe0, 0x0, 0x1c, 0xe0, 0x0,
    0x1c, 0xe0, 0x0, 0x1c, 0xe0, 0x0, 0x1c,
    /* U+004E "N" */
    0xf4, 0x0, 0xef, 0xc0, 0xe, 0xee, 0x0, 0xee,
    0xb0, 0xe, 0xe3, 0x80, 0xee, 0x2c, 0xe, 0xe0,
    0xe0, 0xee, 0xb, 0xe, 0xe0, 0x38, 0xee, 0x1,
    0xce, 0xe0, 0xe, 0xee, 0x0, 0x7e, 0xe0, 0x3,
    0xe0,
    /* U+004F "O" */
    0x3f, 0xff, 0x8e, 0x55, 0x5d, 0xe0, 0x0, 0xee,
    0x0, 0xe, 0xe0, 0x0, 0xee, 0x0, 0xe, 0xe0,
    0x0, 0xee, 0x0, 0xe, 0xe0, 0x0, 0xee, 0x0,
    0xe, 0xe0, 0x0, 0xee, 0x55, 0x5d, 0x3f, 0xff,
    0x80,
    /* U+0050 "P" */
    0xff, 0xff, 0x39, 0x55, 0xfe, 0x0, 0x2f, 0x80,
    0xb, 0xe0, 0x2, 0xf8, 0x0, 0xbe, 0x0, 0x2f,
    0x80, 0xb, 0xe0, 0x2, 0xff, 0xff, 0xde, 0x55,
    0x43, 0x80, 0x0, 0xe0, 0x0, 0x0,
    /* U+0051 "Q" */
    0x3f, 0xff, 0x83, 0x95, 0x57, 0x4e, 0x0, 0xe,
    0x38, 0x0, 0x38, 0xe0, 0x0, 0xe3, 0x80, 0x3,
    0x8e, 0x0, 0xe, 0x38, 0x0, 0x38, 0xe0, 0x0,
    0xe3, 0x80, 0x3, 0x8e, 0x0, 0xe, 0x2e, 0x90,
    0x34, 0x1b, 0xff, 0xd0, 0x0, 0x5b, 0xc0, 0x0,
    0x0, 0x0,
    /* U+0052 "R" */
    0xff, 0xff, 0xe, 0x55, 0x6c, 0xe0, 0x2, 0xce,
    0x0, 0x2c, 0xe0, 0x2, 0xce, 0x0, 0x2c, 0xe0,
    0x2, 0xcf, 0xff, 0xf4, 0xe5, 0x5b, 0xe, 0x0,
    0x34, 0xe0, 0x2, 0xce, 0x0, 0x1d, 0xe0, 0x0,
    0xf0,
    /* U+0053 "S" */
    0x3f, 0xff, 0xb9, 0x55, 0x5e, 0x0, 0x3, 0x80,
    0x0, 0xe0, 0x0, 0x3d, 0x50, 0xf, 0xff, 0xfc,
    0x0, 0x1f, 0x0, 0x2, 0xc0, 0x0, 0xb0, 0x0,
    0x2d, 0x55, 0x5f, 0xff, 0xff, 0x0,
    /* U+0054 "T" */
    0xbf, 0xff, 0xc5, 0x5e, 0x54, 0x0, 0xe0, 0x0,
    0xe, 0x0, 0x0, 0xe0, 0x0, 0xe, 0x0, 0x0,
    0xe0, 0x0, 0xe, 0x0, 0x0, 0xe0, 0x0, 0xe,
    0x0, 0x0, 0xe0, 0x0, 0xe, 0x0, 0x0, 0xe0,
    0x0,
    /* U+0055 "U" */
    0xe0, 0x2, 0xce, 0x0, 0x2c, 0xe0, 0x2, 0xce,
    0x0, 0x2c, 0xe0, 0x2, 0xce, 0x0, 0x2c, 0xe0,
    0x2, 0xce, 0x0, 0x2c, 0xe0, 0x2, 0xce, 0x0,
    0x2c, 0xe0, 0x2, 0xce, 0x55, 0x6c, 0x3f, 0xff,
    0x0,
    /* U+0056 "V" */
    0xb0, 0x0, 0x39, 0xd0, 0x0, 0xd3, 0x40, 0x7,
    0xe, 0x0, 0x2c, 0x2c, 0x0, 0xe0, 0x70, 0x3,
    0x40, 0xd0, 0x1c, 0x3, 0x80, 0xb0, 0xb, 0x3,
    0x80, 0x1c, 0xd, 0x0, 0x34, 0x70, 0x0, 0xe6,
    0xc0, 0x2, 0xfe, 0x0,
    /* U+0057 "W" */
    0xb0, 0x0, 0x0, 0x71, 0xc0, 0x0, 0x1, 0xc7,
    0x0, 0xf4, 0xb, 0xd, 0x3, 0xe0, 0x2c, 0x34,
    0xf, 0xc0, 0xe0, 0xe0, 0x77, 0x3, 0x42, 0xc2,
    0xdc, 0xd, 0xb, 0xa, 0x34, 0x70, 0x1c, 0x38,
    0xd1, 0xc0, 0x70, 0xd2, 0x8b, 0x0, 0xd3, 0xb,
    0x28, 0x3, 0xac, 0x1d, 0xe0, 0xf, 0xf0, 0x3f,
    0x40,
    /* U+0058 "X" */
    0x34, 0x0, 0x74, 0xf0, 0x2, 0xc1, 0xd0, 0xe,
    0x3, 0xc0, 0xb0, 0x7, 0x3, 0x80, 0xe, 0x1c,
    0x0, 0x2f, 0xf0, 0x0, 0xe5, 0xd0, 0xb, 0x3,
    0xc0, 0x38, 0x7, 0x1, 0xc0, 0xe, 0xe, 0x0,
    0x1c, 0x70, 0x0, 0x38,
    /* U+0059 "Y" */
    0x70, 0x0, 0x74, 0xd0, 0x2, 0xc3, 0x80, 0xe,
    0xb, 0x0, 0x34, 0xd, 0x1, 0xc0, 0x38, 0xb,
    0x0, 0xb0, 0x38, 0x1, 0xc1, 0xc0, 0x3, 0xff,
    0x0, 0x2, 0xd0, 0x0, 0x7, 0x0, 0x0, 0x1c,
    0x0, 0x0, 0x70, 0x0,
    /* U+005A "Z" */
    0x3f, 0xff, 0x85, 0x56, 0xe0, 0x0, 0xb0, 0x0,
    0x74, 0x0, 0x3c, 0x0, 0x1c, 0x0, 0xe, 0x0,
    0xb, 0x0, 0x7, 0x40, 0x3, 0xc0, 0x1, 0xd0,
    0x0, 0xf5, 0x55, 0x3f, 0xff, 0x80,
    /* U+005B "[" */
    0x0, 0x3f, 0xde, 0x53, 0x80, 0xe0, 0x38, 0xe,
    0x3, 0x80, 0xe0, 0x38, 0xe, 0x3, 0x80, 0xe0,
    0x38, 0xe, 0x3, 0x94, 0xff, 0x40,
    /* U+005C "\\" */
    0xb0, 0x0, 0x34, 0x0, 0x3c, 0x0, 0x1c, 0x0,
    0xe, 0x0, 0x7, 0x0, 0x3, 0x80, 0x2, 0xc0,
    0x0, 0xd0, 0x0, 0xf0, 0x0, 0x70, 0x0, 0x38,
    0x0, 0x1c,
    /* U+005D "]" */
    0x0, 0x2f, 0xf1, 0x7c, 0xf, 0x3, 0xc0, 0xf0,
    0x3c, 0xf, 0x3, 0xc0, 0xf0, 0x3c, 0xf, 0x3,
    0xc0, 0xf0, 0x3d, 0x5f, 0xbf, 0xc0,
    /* U+005E "^" */
    0x1, 0x80, 0x0, 0xf8, 0x0, 0xbb, 0x0, 0x34,
    0xe0, 0x2c, 0x1c, 0xe, 0x3, 0x8b, 0x0, 0xb0,
    /* U+005F "_" */
    0x0, 0x0, 0x7, 0xff, 0xfe, 0x15, 0x55, 0x40,
    /* U+0061 "a" */
    0x3f, 0xff, 0x1, 0x55, 0x6c, 0x0, 0x1, 0xc0,
    0x0, 0x1c, 0x3f, 0xff, 0xc3, 0x95, 0x6c, 0x34,
    0x1, 0xc3, 0x40, 0x1c, 0x39, 0x56, 0xc0, 0xff,
    0xfc,
    /* U+0062 "b" */
    0xe0, 0x0, 0x38, 0x0, 0xe, 0x0, 0x3, 0xff,
    0xf8, 0xe5, 0x57, 0x78, 0x0, 0xee, 0x0, 0x3b,
    0x80, 0xe, 0xe0, 0x3, 0xb8, 0x0, 0xee, 0x0,
    0x3b, 0x95, 0x5d, 0xff, 0xfe, 0x0,
    /* U+0063 "c" */
    0xf, 0xff, 0xce, 0x55, 0x53, 0x40, 0x0, 0xd0,
    0x0, 0x34, 0x0, 0xd, 0x0, 0x3, 0x40, 0x0,
    0xd0, 0x0, 0x39, 0x55, 0x43, 0xff, 0xf0,
    /* U+0064 "d" */
    0x0, 0x0, 0xe0, 0x0, 0xe, 0x0, 0x0, 0xe0,
    0xff, 0xfe, 0x39, 0x55, 0xe3, 0x40, 0xe, 0x34,
    0x0, 0xe3, 0x40, 0xe, 0x34, 0x0, 0xe3, 0x40,
    0xe, 0x34, 0x0, 0xe3, 0x95, 0x5e, 0xf, 0xff,
    0xe0,
    /* U+0065 "e" */
    0xf, 0xff, 0xc3, 0x95, 0x6c, 0x34, 0x1, 0xc3,
    0x80, 0x1c, 0x3f, 0xff, 0xc3, 0x95, 0x54, 0x34,
    0x0, 0x3, 0x40, 0x0, 0x39, 0x55, 0x40, 0xff,
    0xfc,
    /* U+0066 "f" */
    0x3f, 0xee, 0x55, 0xe0, 0xe, 0x0, 0xe0, 0xf,
    0xfe, 0xe5, 0x4e, 0x0, 0xe0, 0xe, 0x0, 0xe0,
    0xe, 0x0, 0xe0, 0x0,
    /* U+0067 "g" */
    0xf, 0xff, 0xd3, 0x95, 0x6d, 0x34, 0x0, 0xd3,
    0x40, 0xd, 0x34, 0x0, 0xd3, 0x40, 0xd, 0x38,
    0x1, 0xd1, 0xff, 0xfd, 0x1, 0x55, 0xd0, 0x0,
    0xd, 0x5, 0x56, 0xc1, 0xff, 0xf4,
    /* U+0068 "h" */
    0xe0, 0x0, 0x38, 0x0, 0xe, 0x0, 0x3, 0xff,
    0xf4, 0xe5, 0x57, 0x78, 0x0, 0xee, 0x0, 0x3b,
    0x80, 0xe, 0xe0, 0x3, 0xb8, 0x0, 0xee, 0x0,
    0x3b, 0x80, 0xe, 0xe0, 0x3, 0x80,
    /* U+0069 "i" */
    0xe4, 0xe, 0xee, 0xee, 0xee, 0xee, 0xe0,
    /* U+006A "j" */
    0xe4, 0xe, 0xee, 0xee, 0xee, 0xee, 0xee, 0xe0,
    /* U+006B "k" */
    0xe0, 0x0, 0xe, 0x0, 0x0, 0xe0, 0x0, 0xe,
    0x0, 0x38, 0xe0, 0xf, 0xe, 0x2, 0xc0, 0xe0,
    0x38, 0xf, 0xff, 0x0, 0xe5, 0x78, 0xe, 0x2,
    0xc0, 0xe0, 0xe, 0xe, 0x0, 0xb0, 0xe0, 0x3,
    0xc0,
    /* U+006C "l" */
    0xee, 0xee, 0xee, 0xee, 0xee, 0xee, 0xe0,
    /* U+006D "m" */
    0xff, 0xff, 0xff, 0x4e, 0x55, 0xf5, 0x5d, 0xe0,
    0xe, 0x0, 0xee, 0x0, 0xe0, 0xe, 0xe0, 0xe,
    0x0, 0xee, 0x0, 0xe0, 0xe, 0xe0, 0xe, 0x0,
    0xee, 0x0, 0xe0, 0xe, 0xe0, 0xe, 0x0, 0xee,
    0x0, 0xe0, 0xe,
    /* U+006E "n" */
    0xff, 0xfd, 0x39, 0x55, 0xde, 0x0, 0x3b, 0x80,
    0xe, 0xe0, 0x3, 0xb8, 0x0, 0xee, 0x0, 0x3b,
    0x80, 0xe, 0xe0, 0x3, 0xb8, 0x0, 0xe0,
    /* U+006F "o" */
    0xf, 0xff, 0x43, 0x95, 0x6c, 0x34, 0x1, 0xd3,
    0x40, 0x1d, 0x34, 0x1, 0xd3, 0x40, 0x1d, 0x34,
    0x1, 0xd3, 0x40, 0x1d, 0x39, 0x56, 0xc0, 0xff,
    0xf4,
    /* U+0070 "p" */
    0xff, 0xfe, 0x39, 0x55, 0xde, 0x0, 0x3b, 0x80,
    0xe, 0xe0, 0x3, 0xb8, 0x0, 0xee, 0x0, 0x3b,
    0x80, 0xe, 0xe5, 0x57, 0x7f, 0xff, 0x8e, 0x0,
    0x3, 0x80, 0x0,
    /* U+0071 "q" */
    0xf, 0xff, 0xe3, 0x95, 0x5e, 0x34, 0x0, 0xe3,
    0x40, 0xe, 0x34, 0x0, 0xe3, 0x40, 0xe, 0x34,
    0x0, 0xe3, 0x40, 0xe, 0x39, 0x55, 0xe0, 0xff,
    0xfe, 0x0, 0x0, 0xe0, 0x0, 0xe,
    /* U+0072 "r" */
    0x3f, 0xfb, 0x95, 0x5e, 0x0, 0x38, 0x0, 0xe0,
    0x3, 0x80, 0xe, 0x0, 0x38, 0x0, 0xe0, 0x3,
    0x80, 0x0,
    /* U+0073 "s" */
    0xf, 0xff, 0xd3, 0x95, 0x54, 0x34, 0x0, 0x3,
    0x80, 0x0, 0x3f, 0xff, 0xd1, 0x55, 0x5d, 0x0,
    0x1, 0xd0, 0x0, 0x1d, 0x15, 0x56, 0xc3, 0xff,
    0xf4,
    /* U+0074 "t" */
    0x50, 0xe, 0x0, 0xe0, 0xf, 0xff, 0xe5, 0x5e,
    0x0, 0xe0, 0xe, 0x0, 0xe0, 0xe, 0x0, 0xe0,
    0xe, 0x55, 0x3f, 0xf0,
    /* U+0075 "u" */
    0xe0, 0x3, 0xb8, 0x0, 0xee, 0x0, 0x3b, 0x80,
    0xe, 0xe0, 0x3, 0xb8, 0x0, 0xee, 0x0, 0x3b,
    0x80, 0xe, 0xe5, 0x57, 0x8f, 0xff, 0xe0,
    /* U+0076 "v" */
    0xb0, 0x0, 0xe7, 0x0, 0x1d, 0x34, 0x2, 0xc3,
    0x80, 0x38, 0x2c, 0x3, 0x41, 0xc0, 0x70, 0xd,
    0xb, 0x0, 0xe0, 0xe0, 0xb, 0x5d, 0x0, 0x7f,
    0xc0,
    /* U+0077 "w" */
    0x34, 0x0, 0x0, 0xe3, 0x40, 0xf4, 0xd, 0x38,
    0x1f, 0x81, 0xc3, 0x81, 0xec, 0x1c, 0x2c, 0x2d,
    0xc2, 0xc1, 0xc3, 0x9c, 0x38, 0x1c, 0x34, 0xd3,
    0x80, 0xd7, 0xe, 0x34, 0xe, 0xb0, 0xbb, 0x40,
    0xfe, 0x7, 0xf0,
    /* U+0078 "x" */
    0x38, 0x0, 0xf0, 0x70, 0xb, 0x0, 0xe0, 0x38,
    0x1, 0xd2, 0xc0, 0x3, 0xfe, 0x0, 0x1d, 0x6c,
    0x0, 0xf0, 0x38, 0x7, 0x40, 0xb0, 0x3c, 0x0,
    0xe1, 0xd0, 0x2, 0xc0,
    /* U+0079 "y" */
    0xb0, 0x0, 0xb1, 0xc0, 0x3, 0x83, 0x80, 0x1c,
    0xb, 0x0, 0xb0, 0x1d, 0x3, 0x80, 0x38, 0x1d,
    0x0, 0xb0, 0xb0, 0x1, 0xff, 0x80, 0x1, 0x5d,
    0x0, 0x0, 0xb0, 0x1, 0x57, 0x80, 0x1f, 0xfd,
    0x0,
    /* U+007A "z" */
    0x7f, 0xff, 0x45, 0x57, 0xc0, 0x1, 0xd0, 0x0,
    0xd0, 0x0, 0xe0, 0x0, 0xb0, 0x0, 0xb0, 0x0,
    0x74, 0x0, 0x3d, 0x55, 0x1f, 0xff, 0xe0,
    /* U+007B "{" */
    0x0, 0x0, 0xf, 0xd0, 0xe5, 0x3, 0x80, 0xe,
    0x0, 0x38, 0x0, 0xe0, 0x3, 0x40, 0xbc, 0x0,
    0x74, 0x0, 0xe0, 0x3, 0x80, 0xe, 0x0, 0x38,
    0x0, 0xe0, 0x3, 0x94, 0x3, 0xf4,
    /* U+007C "|" */
    0xee, 0xee, 0xee, 0xee, 0xee, 0xee, 0xee, 0xee,
    /* U+007D "}" */
    0x0, 0x2, 0xfc, 0x1, 0x78, 0x0, 0xf0, 0x3,
    0xc0, 0xf, 0x0, 0x3c, 0x0, 0xb0, 0x0, 0xf4,
    0xb, 0x40, 0x3c, 0x0, 0xf0, 0x3, 0xc0, 0xf,
    0x0, 0x3c, 0x15, 0xe0, 0xbf, 0x0,
    /* U+007E "~" */
    0x9, 0x0, 0x3, 0xfe, 0x6, 0xb0, 0xbf, 0xd0,
    0x0, 0xb4, 0x0, 0x0, 0x0,
    /* U+00C0 "À" */
    0x5, 0x50, 0x0, 0x2f, 0xf8, 0x0, 0x0, 0x0,
    0x0, 0xbf, 0x80, 0x3, 0x9b, 0x0, 0xd, 0x1c,
    0x0, 0x70, 0x34, 0x2, 0xc0, 0xe0, 0xe, 0x2,
    0xc0, 0x34, 0x7, 0x1, 0xc0, 0xd, 0xb, 0xff,
    0xf8, 0x39, 0x55, 0xb0, 0xd0, 0x1, 0xc7, 0x0,
    0x3, 0x6c, 0x0, 0xe,
    /* U+00C2 "Â" */
    0x0, 0x64, 0x0, 0x1f, 0xfd, 0x0, 0xa0, 0x28,
    0x0, 0x0, 0x0, 0x2, 0xfe, 0x0, 0xe, 0x6c,
    0x0, 0x34, 0x70, 0x1, 0xc0, 0xd0, 0xb, 0x3,
    0x80, 0x38, 0xb, 0x0, 0xd0, 0x1c, 0x7, 0x0,
    0x34, 0x2f, 0xff, 0xe0, 0xe5, 0x56, 0xc3, 0x40,
    0x7, 0x1c, 0x0, 0xd, 0xb0, 0x0, 0x38,
    /* U+00C4 "Ä" */
    0x0, 0x0, 0x0, 0xd, 0x1c, 0x0, 0x10, 0x10,
    0x0, 0xbf, 0x80, 0x3, 0x9b, 0x0, 0xd, 0x1c,
    0x0, 0x70, 0x34, 0x2, 0xc0, 0xe0, 0xe, 0x2,
    0xc0, 0x34, 0x7, 0x1, 0xc0, 0xd, 0xb, 0xff,
    0xf8, 0x39, 0x55, 0xb0, 0xd0, 0x1, 0xc7, 0x0,
    0x3, 0x6c, 0x0, 0xe,
    /* U+00C6 "Æ" */
    0x0, 0xff, 0xff, 0xfd, 0x1, 0xd5, 0xe5, 0x54,
    0x2, 0xc0, 0xe0, 0x0, 0x3, 0x80, 0xe0, 0x0,
    0x3, 0x40, 0xe0, 0x0, 0x7, 0x0, 0xe0, 0x0,
    0xe, 0x0, 0xff, 0xf4, 0xd, 0x0, 0xe5, 0x50,
    0x1f, 0xff, 0xe0, 0x0, 0x2d, 0x55, 0xe0, 0x0,
    0x38, 0x0, 0xe0, 0x0, 0x34, 0x0, 0xe5, 0x54,
    0xb0, 0x0, 0xff, 0xfd,
    /* U+00C7 "Ç" */
    0x3f, 0xfe, 0xf5, 0x55, 0xe0, 0x0, 0xe0, 0x0,
    0xe0, 0x0, 0xe0, 0x0, 0xe0, 0x0, 0xe0, 0x0,
    0xe0, 0x0, 0xe0, 0x0, 0xe0, 0x0, 0xf5, 0x55,
    0x3f, 0xff, 0x0, 0x0, 0x1, 0xc0, 0x2, 0xc0,
    0x1, 0x0,
    /* U+00C8 "È" */
    0x15, 0x0, 0xf, 0xfd, 0x0, 0x0, 0x3, 0xff,
    0xfc, 0xe5, 0x55, 0x38, 0x0, 0xe, 0x0, 0x3,
    0x80, 0x0, 0xe0, 0x0, 0x3f, 0xff, 0x4e, 0x55,
    0x43, 0x80, 0x0, 0xe0, 0x0, 0x38, 0x0, 0xe,
    0x55, 0x53, 0xff, 0xfd,
    /* U+00C9 "É" */
    0x0, 0x54, 0x3, 0xff, 0x40, 0x0, 0x3, 0xff,
    0xfc, 0xe5, 0x55, 0x38, 0x0, 0xe, 0x0, 0x3,
    0x80, 0x0, 0xe0, 0x0, 0x3f, 0xff, 0x4e, 0x55,
    0x43, 0x80, 0x0, 0xe0, 0x0, 0x38, 0x0, 0xe,
    0x55, 0x53, 0xff, 0xfd,
    /* U+00CA "Ê" */
    0x1, 0x80, 0xb, 0xff, 0x3, 0x41, 0x90, 0x0,
    0x0, 0xff, 0xff, 0x39, 0x55, 0x4e, 0x0, 0x3,
    0x80, 0x0, 0xe0, 0x0, 0x38, 0x0, 0xf, 0xff,
    0xd3, 0x95, 0x50, 0xe0, 0x0, 0x38, 0x0, 0xe,
    0x0, 0x3, 0x95, 0x54, 0xff, 0xff, 0x40,
    /* U+00CB "Ë" */
    0x0, 0x0, 0x7, 0xb, 0x0, 0x40, 0x43, 0xff,
    0xfc, 0xe5, 0x55, 0x38, 0x0, 0xe, 0x0, 0x3,
    0x80, 0x0, 0xe0, 0x0, 0x3f, 0xff, 0x4e, 0x55,
    0x43, 0x80, 0x0, 0xe0, 0x0, 0x38, 0x0, 0xe,
    0x55, 0x53, 0xff, 0xfd,
    /* U+00CE "Î" */
    0x2, 0x41, 0xff, 0xea, 0x1, 0xc0, 0x0, 0x3f,
    0xf8, 0x5e, 0x40, 0x34, 0x0, 0xd0, 0x3, 0x40,
    0xd, 0x0, 0x34, 0x0, 0xd0, 0x3, 0x40, 0xd,
    0x0, 0x34, 0x5, 0xe4, 0x3f, 0xf8,
    /* U+00CF "Ï" */
    0x0, 0x0, 0xe0, 0xd1, 0x1, 0xf, 0xfe, 0x17,
    0x90, 0xd, 0x0, 0x34, 0x0, 0xd0, 0x3, 0x40,
    0xd, 0x0, 0x34, 0x0, 0xd0, 0x3, 0x40, 0xd,
    0x1, 0x79, 0xf, 0xfe,
    /* U+00D4 "Ô" */
    0x0, 0x90, 0x0, 0xff, 0xe0, 0x19, 0x7, 0x0,
    0x0, 0x0, 0x3f, 0xff, 0x8e, 0x55, 0x5d, 0xe0,
    0x0, 0xee, 0x0, 0xe, 0xe0, 0x0, 0xee, 0x0,
    0xe, 0xe0, 0x0, 0xee, 0x0, 0xe, 0xe0, 0x0,
    0xee, 0x0, 0xe, 0xe0, 0x0, 0xee, 0x55, 0x5d,
    0x3f, 0xff, 0x80,
    /* U+00D6 "Ö" */
    0x0, 0x0, 0x0, 0xe0, 0xd0, 0x4, 0x4, 0x3,
    0xff, 0xf8, 0xe5, 0x55, 0xde, 0x0, 0xe, 0xe0,
    0x0, 0xee, 0x0, 0xe, 0xe0, 0x0, 0xee, 0x0,
    0xe, 0xe0, 0x0, 0xee, 0x0, 0xe, 0xe0, 0x0,
    0xee, 0x0, 0xe, 0xe5, 0x55, 0xd3, 0xff, 0xf8,
    /* U+00DB "Û" */
    0x1, 0x90, 0x1, 0xff, 0xd0, 0x28, 0xa, 0x0,
    0x0, 0x0, 0xe0, 0x2, 0xce, 0x0, 0x2c, 0xe0,
    0x2, 0xce, 0x0, 0x2c, 0xe0, 0x2, 0xce, 0x0,
    0x2c, 0xe0, 0x2, 0xce, 0x0, 0x2c, 0xe0, 0x2,
    0xce, 0x0, 0x2c, 0xe0, 0x2, 0xce, 0x55, 0x6c,
    0x3f, 0xff, 0x0,
    /* U+00DC "Ü" */
    0x0, 0x0, 0x0, 0xd1, 0xc0, 0x4, 0x4, 0xe,
    0x0, 0x2c, 0xe0, 0x2, 0xce, 0x0, 0x2c, 0xe0,
    0x2, 0xce, 0x0, 0x2c, 0xe0, 0x2, 0xce, 0x0,
    0x2c, 0xe0, 0x2, 0xce, 0x0, 0x2c, 0xe0, 0x2,
    0xce, 0x0, 0x2c, 0xe5, 0x56, 0xc3, 0xff, 0xf0,
    /* U+00E0 "à" */
    0x0, 0x0, 0x1, 0xfe, 0x80, 0xa, 0xa8, 0x0,
    0x0, 0x0, 0x3f, 0xff, 0x1, 0x55, 0x6c, 0x0,
    0x1, 0xc0, 0x0, 0x1c, 0x3f, 0xff, 0xc3, 0x95,
    0x6c, 0x34, 0x1, 0xc3, 0x40, 0x1c, 0x39, 0x56,
    0xc0, 0xff, 0xfc,
    /* U+00E2 "â" */
    0x0, 0x90, 0x0, 0xff, 0xe0, 0x19, 0x7, 0x0,
    0x0, 0x0, 0x3f, 0xff, 0x1, 0x55, 0x6c, 0x0,
    0x1, 0xc0, 0x0, 0x1c, 0x3f, 0xff, 0xc3, 0x95,
    0x6c, 0x34, 0x1, 0xc3, 0x40, 0x1c, 0x39, 0x56,
    0xc0, 0xff, 0xfc,
    /* U+00E4 "ä" */
    0xe, 0xd, 0x0, 0x50, 0x40, 0x0, 0x0, 0x3,
    0xff, 0xf0, 0x15, 0x56, 0xc0, 0x0, 0x1c, 0x0,
    0x1, 0xc3, 0xff, 0xfc, 0x39, 0x56, 0xc3, 0x40,
    0x1c, 0x34, 0x1, 0xc3, 0x95, 0x6c, 0xf, 0xff,
    0xc0,
    /* U+00E6 "æ" */
    0x3f, 0xfd, 0xbf, 0xfc, 0x55, 0x5f, 0x55, 0xf0,
    0x0, 0x38, 0x2, 0xc0, 0x0, 0xe0, 0xf, 0x3f,
    0xff, 0xff, 0xfc, 0xe5, 0xf, 0x55, 0x43, 0x40,
    0x38, 0x0, 0xd, 0x0, 0xe0, 0x0, 0x39, 0x57,
    0xd5, 0x50, 0x3f, 0xff, 0xff, 0xd0,
    /* U+00E7 "ç" */
    0xf, 0xff, 0xce, 0x55, 0x53, 0x40, 0x0, 0xd0,
    0x0, 0x34, 0x0, 0xd, 0x0, 0x3, 0x40, 0x0,
    0xd0, 0x0, 0x39, 0x55, 0x43, 0xff, 0xf0, 0x0,
    0x0, 0x0, 0xd0, 0x0, 0x70, 0x0, 0x14, 0x0,
    /* U+00E8 "è" */
    0x0, 0x0, 0x0, 0xfe, 0x90, 0x6, 0xa8, 0x0,
    0x0, 0x0, 0xf, 0xff, 0xc3, 0x95, 0x6c, 0x34,
    0x1, 0xc3, 0x80, 0x1c, 0x3f, 0xff, 0xc3, 0x95,
    0x54, 0x34, 0x0, 0x3, 0x40, 0x0, 0x39, 0x55,
    0x40, 0xff, 0xfc,
    /* U+00E9 "é" */
    0x0, 0x0, 0x0, 0x2b, 0xf4, 0x1, 0xaa, 0x40,
    0x0, 0x0, 0xf, 0xff, 0xc3, 0x95, 0x6c, 0x34,
    0x1, 0xc3, 0x80, 0x1c, 0x3f, 0xff, 0xc3, 0x95,
    0x54, 0x34, 0x0, 0x3, 0x40, 0x0, 0x39, 0x55,
    0x40, 0xff, 0xfc,
    /* U+00EA "ê" */
    0x0, 0x60, 0x0, 0xbf, 0xf4, 0xd, 0x2, 0x40,
    0x0, 0x0, 0xf, 0xff, 0xc3, 0x95, 0x6c, 0x34,
    0x1, 0xc3, 0x80, 0x1c, 0x3f, 0xff, 0xc3, 0x95,
    0x54, 0x34, 0x0, 0x3, 0x40, 0x0, 0x39, 0x55,
    0x40, 0xff, 0xfc,
    /* U+00EB "ë" */
    0x7, 0xb, 0x0, 0x10, 0x50, 0x0, 0x0, 0x0,
    0xff, 0xfc, 0x39, 0x56, 0xc3, 0x40, 0x1c, 0x38,
    0x1, 0xc3, 0xff, 0xfc, 0x39, 0x55, 0x43, 0x40,
    0x0, 0x34, 0x0, 0x3, 0x95, 0x54, 0xf, 0xff,
    0xc0,
    /* U+00EE "î" */
    0x2, 0x40, 0x3f, 0xf8, 0x64, 0x1c, 0x0, 0x0,
    0x3, 0x80, 0x3, 0x80, 0x3, 0x80, 0x3, 0x80,
    0x3, 0x80, 0x3, 0x80, 0x3, 0x80, 0x3, 0x80,
    0x3, 0x80, 0x3, 0x80,
    /* U+00EF "ï" */
    0x72, 0xc4, 0x50, 0x0, 0x38, 0xe, 0x3, 0x80,
    0xe0, 0x38, 0xe, 0x3, 0x80, 0xe0, 0x38, 0xe,
    0x0,
    /* U+00F4 "ô" */
    0x0, 0x60, 0x0, 0xbf, 0xe0, 0xd, 0x6, 0x40,
    0x0, 0x0, 0xf, 0xff, 0x43, 0x95, 0x6c, 0x34,
    0x1, 0xd3, 0x40, 0x1d, 0x34, 0x1, 0xd3, 0x40,
    0x1d, 0x34, 0x1, 0xd3, 0x40, 0x1d, 0x39, 0x56,
    0xc0, 0xff, 0xf4,
    /* U+00F6 "ö" */
    0xb, 0xe, 0x0, 0x10, 0x50, 0x0, 0x0, 0x0,
    0xff, 0xf4, 0x39, 0x56, 0xc3, 0x40, 0x1d, 0x34,
    0x1, 0xd3, 0x40, 0x1d, 0x34, 0x1, 0xd3, 0x40,
    0x1d, 0x34, 0x1, 0xd3, 0x95, 0x6c, 0xf, 0xff,
    0x40,
    /* U+00FB "û" */
    0x1, 0x80, 0xb, 0xff, 0x43, 0x40, 0x90, 0x0,
    0x0, 0xe0, 0x3, 0xb8, 0x0, 0xee, 0x0, 0x3b,
    0x80, 0xe, 0xe0, 0x3, 0xb8, 0x0, 0xee, 0x0,
    0x3b, 0x80, 0xe, 0xe5, 0x57, 0x8f, 0xff, 0xe0,
    /* U+00FC "ü" */
    0x1c, 0x2c, 0x1, 0x5, 0x0, 0x0, 0x3, 0x80,
    0xe, 0xe0, 0x3, 0xb8, 0x0, 0xee, 0x0, 0x3b,
    0x80, 0xe, 0xe0, 0x3, 0xb8, 0x0, 0xee, 0x0,
    0x3b, 0x95, 0x5e, 0x3f, 0xff, 0x80,
    /* U+00FF "ÿ" */
    0xb, 0xe, 0x0, 0x4, 0x14, 0x0, 0x0, 0x0,
    0x2c, 0x0, 0x2c, 0x70, 0x0, 0xe0, 0xe0, 0x7,
    0x2, 0xc0, 0x2c, 0x7, 0x40, 0xe0, 0xe, 0x7,
    0x40, 0x2c, 0x2c, 0x0, 0x7f, 0xe0, 0x0, 0x57,
    0x40, 0x0, 0x2c, 0x0, 0x55, 0xe0, 0x7, 0xff,
    0x40, 0x0,
    /* U+0152 "Œ" */
    0x3f, 0xff, 0xff, 0xf3, 0x95, 0x6e, 0x55, 0x4e,
    0x0, 0x70, 0x0, 0x38, 0x1, 0xc0, 0x0, 0xe0,
    0x7, 0x0, 0x3, 0x80, 0x1d, 0x0, 0xe, 0x0,
    0x7f, 0xfc, 0x38, 0x1, 0xd5, 0x50, 0xe0, 0x7,
    0x0, 0x3, 0x80, 0x1c, 0x0, 0xe, 0x0, 0x70,
    0x0, 0x39, 0x56, 0xe5, 0x54, 0x3f, 0xff, 0xff,
    0xf0,
    /* U+0153 "œ" */
    0xf, 0xfe, 0xbf, 0xfc, 0xe5, 0x5f, 0x55, 0xf3,
    0x40, 0x3c, 0x2, 0xcd, 0x0, 0xf0, 0xb, 0x34,
    0x3, 0xff, 0xfc, 0xd0, 0xf, 0x55, 0x43, 0x40,
    0x3c, 0x0, 0xd, 0x0, 0xf0, 0x0, 0x39, 0x57,
    0xd5, 0x50, 0x3f, 0xfa, 0xff, 0xe0,
    /* U+0178 "Ÿ" */
    0x0, 0x0, 0x0, 0xd, 0x1c, 0x0, 0x10, 0x10,
    0x1c, 0x0, 0x1d, 0x34, 0x0, 0xb0, 0xe0, 0x3,
    0x82, 0xc0, 0xd, 0x3, 0x40, 0x70, 0xe, 0x2,
    0xc0, 0x2c, 0xe, 0x0, 0x70, 0x70, 0x0, 0xff,
    0xc0, 0x0, 0xb4, 0x0, 0x1, 0xc0, 0x0, 0x7,
    0x0, 0x0, 0x1c, 0x0
};
/*---------------------
 *  GLYPH DESCRIPTION
 *--------------------*/
static const lv_font_fmt_txt_glyph_dsc_t glyph_dsc[] = {
    {.bitmap_index = 0, .adv_w = 0, .box_w = 0, .box_h = 0, .ofs_x = 0, .ofs_y = 0} /* id = 0 reserved */,
    {.bitmap_index = 0, .adv_w = 71, .box_w = 0, .box_h = 0, .ofs_x = 0, .ofs_y = 0},
    {.bitmap_index = 0, .adv_w = 73, .box_w = 3, .box_h = 13, .ofs_x = 1, .ofs_y = 0},
    {.bitmap_index = 10, .adv_w = 109, .box_w = 5, .box_h = 5, .ofs_x = 1, .ofs_y = 8},
    {.bitmap_index = 17, .adv_w = 223, .box_w = 12, .box_h = 13, .ofs_x = 1, .ofs_y = 0},
    {.bitmap_index = 56, .adv_w = 180, .box_w = 10, .box_h = 16, .ofs_x = 1, .ofs_y = -2},
    {.bitmap_index = 96, .adv_w = 163, .box_w = 10, .box_h = 13, .ofs_x = 0, .ofs_y = 0},
    {.bitmap_index = 129, .adv_w = 200, .box_w = 13, .box_h = 13, .ofs_x = 0, .ofs_y = 0},
    {.bitmap_index = 172, .adv_w = 60, .box_w = 2, .box_h = 5, .ofs_x = 1, .ofs_y = 8},
    {.bitmap_index = 175, .adv_w = 92, .box_w = 5, .box_h = 17, .ofs_x = 1, .ofs_y = -2},
    {.bitmap_index = 197, .adv_w = 92, .box_w = 5, .box_h = 17, .ofs_x = 0, .ofs_y = -2},
    {.bitmap_index = 219, .adv_w = 141, .box_w = 9, .box_h = 9, .ofs_x = 0, .ofs_y = 4},
    {.bitmap_index = 240, .adv_w = 163, .box_w = 10, .box_h = 10, .ofs_x = 0, .ofs_y = 0},
    {.bitmap_index = 265, .adv_w = 68, .box_w = 4, .box_h = 4, .ofs_x = 0, .ofs_y = -2},
    {.bitmap_index = 269, .adv_w = 92, .box_w = 6, .box_h = 2, .ofs_x = 0, .ofs_y = 5},
    {.bitmap_index = 272, .adv_w = 68, .box_w = 2, .box_h = 2, .ofs_x = 1, .ofs_y = 0},
    {.bitmap_index = 273, .adv_w = 120, .box_w = 8, .box_h = 13, .ofs_x = 0, .ofs_y = 0},
    {.bitmap_index = 299, .adv_w = 177, .box_w = 10, .box_h = 13, .ofs_x = 1, .ofs_y = 0},
    {.bitmap_index = 332, .adv_w = 117, .box_w = 7, .box_h = 13, .ofs_x = 0, .ofs_y = 0},
    {.bitmap_index = 355, .adv_w = 180, .box_w = 10, .box_h = 13, .ofs_x = 1, .ofs_y = 0},
    {.bitmap_index = 388, .adv_w = 166, .box_w = 10, .box_h = 13, .ofs_x = 0, .ofs_y = 0},
    {.bitmap_index = 421, .adv_w = 174, .box_w = 10, .box_h = 13, .ofs_x = 0, .ofs_y = 0},
    {.bitmap_index = 454, .adv_w = 180, .box_w = 10, .box_h = 13, .ofs_x = 1, .ofs_y = 0},
    {.bitmap_index = 487, .adv_w = 177, .box_w = 10, .box_h = 13, .ofs_x = 1, .ofs_y = 0},
    {.bitmap_index = 520, .adv_w = 169, .box_w = 10, .box_h = 13, .ofs_x = 0, .ofs_y = 0},
    {.bitmap_index = 553, .adv_w = 182, .box_w = 11, .box_h = 13, .ofs_x = 0, .ofs_y = 0},
    {.bitmap_index = 589, .adv_w = 177, .box_w = 10, .box_h = 13, .ofs_x = 1, .ofs_y = 0},
    {.bitmap_index = 622, .adv_w = 68, .box_w = 2, .box_h = 8, .ofs_x = 1, .ofs_y = 0},
    {.bitmap_index = 626, .adv_w = 68, .box_w = 3, .box_h = 11, .ofs_x = 0, .ofs_y = -2},
    {.bitmap_index = 635, .adv_w = 163, .box_w = 10, .box_h = 10, .ofs_x = 0, .ofs_y = 0},
    {.bitmap_index = 660, .adv_w = 163, .box_w = 10, .box_h = 7, .ofs_x = 0, .ofs_y = 2},
    {.bitmap_index = 678, .adv_w = 163, .box_w = 10, .box_h = 10, .ofs_x = 0, .ofs_y = 0},
    {.bitmap_index = 703, .adv_w = 150, .box_w = 10, .box_h = 13, .ofs_x = 0, .ofs_y = 0},
    {.bitmap_index = 736, .adv_w = 218, .box_w = 12, .box_h = 15, .ofs_x = 1, .ofs_y = -2},
    {.bitmap_index = 781, .adv_w = 177, .box_w = 11, .box_h = 13, .ofs_x = 0, .ofs_y = 0},
    {.bitmap_index = 817, .adv_w = 174, .box_w = 10, .box_h = 13, .ofs_x = 1, .ofs_y = 0},
    {.bitmap_index = 850, .adv_w = 150, .box_w = 8, .box_h = 13, .ofs_x = 1, .ofs_y = 0},
    {.bitmap_index = 876, .adv_w = 173, .box_w = 9, .box_h = 13, .ofs_x = 1, .ofs_y = 0},
    {.bitmap_index = 906, .adv_w = 158, .box_w = 9, .box_h = 13, .ofs_x = 1, .ofs_y = 0},
    {.bitmap_index = 936, .adv_w = 155, .box_w = 9, .box_h = 13, .ofs_x = 1, .ofs_y = 0},
    {.bitmap_index = 966, .adv_w = 177, .box_w = 10, .box_h = 13, .ofs_x = 1, .ofs_y = 0},
    {.bitmap_index = 999, .adv_w = 182, .box_w = 10, .box_h = 13, .ofs_x = 1, .ofs_y = 0},
    {.bitmap_index = 1032, .adv_w = 117, .box_w = 7, .box_h = 13, .ofs_x = 0, .ofs_y = 0},
    {.bitmap_index = 1055, .adv_w = 163, .box_w = 10, .box_h = 13, .ofs_x = 0, .ofs_y = 0},
    {.bitmap_index = 1088, .adv_w = 171, .box_w = 10, .box_h = 13, .ofs_x = 1, .ofs_y = 0},
    {.bitmap_index = 1121, .adv_w = 163, .box_w = 9, .box_h = 13, .ofs_x = 1, .ofs_y = 0},
    {.bitmap_index = 1151, .adv_w = 212, .box_w = 12, .box_h = 13, .ofs_x = 1, .ofs_y = 0},
    {.bitmap_index = 1190, .adv_w = 185, .box_w = 10, .box_h = 13, .ofs_x = 1, .ofs_y = 0},
    {.bitmap_index = 1223, .adv_w = 185, .box_w = 10, .box_h = 13, .ofs_x = 1, .ofs_y = 0},
    {.bitmap_index = 1256, .adv_w = 169, .box_w = 9, .box_h = 13, .ofs_x = 1, .ofs_y = 0},
    {.bitmap_index = 1286, .adv_w = 185, .box_w = 11, .box_h = 15, .ofs_x = 1, .ofs_y = -2},
    {.bitmap_index = 1328, .adv_w = 177, .box_w = 10, .box_h = 13, .ofs_x = 1, .ofs_y = 0},
    {.bitmap_index = 1361, .adv_w = 174, .box_w = 9, .box_h = 13, .ofs_x = 1, .ofs_y = 0},
    {.bitmap_index = 1391, .adv_w = 152, .box_w = 10, .box_h = 13, .ofs_x = 0, .ofs_y = 0},
    {.bitmap_index = 1424, .adv_w = 177, .box_w = 10, .box_h = 13, .ofs_x = 1, .ofs_y = 0},
    {.bitmap_index = 1457, .adv_w = 177, .box_w = 11, .box_h = 13, .ofs_x = 0, .ofs_y = 0},
    {.bitmap_index = 1493, .adv_w = 234, .box_w = 15, .box_h = 13, .ofs_x = 0, .ofs_y = 0},
    {.bitmap_index = 1542, .adv_w = 180, .box_w = 11, .box_h = 13, .ofs_x = 0, .ofs_y = 0},
    {.bitmap_index = 1578, .adv_w = 174, .box_w = 11, .box_h = 13, .ofs_x = 0, .ofs_y = 0},
    {.bitmap_index = 1614, .adv_w = 152, .box_w = 9, .box_h = 13, .ofs_x = 0, .ofs_y = 0},
    {.bitmap_index = 1644, .adv_w = 92, .box_w = 5, .box_h = 17, .ofs_x = 1, .ofs_y = -2},
    {.bitmap_index = 1666, .adv_w = 120, .box_w = 8, .box_h = 13, .ofs_x = 0, .ofs_y = 0},
    {.bitmap_index = 1692, .adv_w = 92, .box_w = 5, .box_h = 17, .ofs_x = 0, .ofs_y = -2},
    {.bitmap_index = 1714, .adv_w = 136, .box_w = 9, .box_h = 7, .ofs_x = 0, .ofs_y = 6},
    {.bitmap_index = 1730, .adv_w = 163, .box_w = 10, .box_h = 3, .ofs_x = 0, .ofs_y = -2},
    {.bitmap_index = 1738, .adv_w = 163, .box_w = 10, .box_h = 10, .ofs_x = 0, .ofs_y = 0},
    {.bitmap_index = 1763, .adv_w = 169, .box_w = 9, .box_h = 13, .ofs_x = 1, .ofs_y = 0},
    {.bitmap_index = 1793, .adv_w = 148, .box_w = 9, .box_h = 10, .ofs_x = 0, .ofs_y = 0},
    {.bitmap_index = 1816, .adv_w = 169, .box_w = 10, .box_h = 13, .ofs_x = 0, .ofs_y = 0},
    {.bitmap_index = 1849, .adv_w = 160, .box_w = 10, .box_h = 10, .ofs_x = 0, .ofs_y = 0},
    {.bitmap_index = 1874, .adv_w = 112, .box_w = 6, .box_h = 13, .ofs_x = 1, .ofs_y = 0},
    {.bitmap_index = 1894, .adv_w = 166, .box_w = 10, .box_h = 12, .ofs_x = 0, .ofs_y = -2},
    {.bitmap_index = 1924, .adv_w = 169, .box_w = 9, .box_h = 13, .ofs_x = 1, .ofs_y = 0},
    {.bitmap_index = 1954, .adv_w = 57, .box_w = 2, .box_h = 13, .ofs_x = 1, .ofs_y = 0},
    {.bitmap_index = 1961, .adv_w = 57, .box_w = 2, .box_h = 15, .ofs_x = 1, .ofs_y = -2},
    {.bitmap_index = 1969, .adv_w = 163, .box_w = 10, .box_h = 13, .ofs_x = 1, .ofs_y = 0},
    {.bitmap_index = 2002, .adv_w = 57, .box_w = 2, .box_h = 13, .ofs_x = 1, .ofs_y = 0},
    {.bitmap_index = 2009, .adv_w = 250, .box_w = 14, .box_h = 10, .ofs_x = 1, .ofs_y = 0},
    {.bitmap_index = 2044, .adv_w = 169, .box_w = 9, .box_h = 10, .ofs_x = 1, .ofs_y = 0},
    {.bitmap_index = 2067, .adv_w = 163, .box_w = 10, .box_h = 10, .ofs_x = 0, .ofs_y = 0},
    {.bitmap_index = 2092, .adv_w = 169, .box_w = 9, .box_h = 12, .ofs_x = 1, .ofs_y = -2},
    {.bitmap_index = 2119, .adv_w = 169, .box_w = 10, .box_h = 12, .ofs_x = 0, .ofs_y = -2},
    {.bitmap_index = 2149, .adv_w = 128, .box_w = 7, .box_h = 10, .ofs_x = 1, .ofs_y = 0},
    {.bitmap_index = 2167, .adv_w = 163, .box_w = 10, .box_h = 10, .ofs_x = 0, .ofs_y = 0},
    {.bitmap_index = 2192, .adv_w = 117, .box_w = 6, .box_h = 13, .ofs_x = 1, .ofs_y = 0},
    {.bitmap_index = 2212, .adv_w = 169, .box_w = 9, .box_h = 10, .ofs_x = 1, .ofs_y = 0},
    {.bitmap_index = 2235, .adv_w = 158, .box_w = 10, .box_h = 10, .ofs_x = 0, .ofs_y = 0},
    {.bitmap_index = 2260, .adv_w = 228, .box_w = 14, .box_h = 10, .ofs_x = 0, .ofs_y = 0},
    {.bitmap_index = 2295, .adv_w = 171, .box_w = 11, .box_h = 10, .ofs_x = 0, .ofs_y = 0},
    {.bitmap_index = 2323, .adv_w = 163, .box_w = 11, .box_h = 12, .ofs_x = 0, .ofs_y = -2},
    {.bitmap_index = 2356, .adv_w = 144, .box_w = 9, .box_h = 10, .ofs_x = 0, .ofs_y = 0},
    {.bitmap_index = 2379, .adv_w = 109, .box_w = 7, .box_h = 17, .ofs_x = 0, .ofs_y = -2},
    {.bitmap_index = 2409, .adv_w = 57, .box_w = 2, .box_h = 16, .ofs_x = 1, .ofs_y = -2},
    {.bitmap_index = 2417, .adv_w = 109, .box_w = 7, .box_h = 17, .ofs_x = 0, .ofs_y = -2},
    {.bitmap_index = 2447, .adv_w = 163, .box_w = 10, .box_h = 5, .ofs_x = 0, .ofs_y = 3},
    {.bitmap_index = 2460, .adv_w = 177, .box_w = 11, .box_h = 16, .ofs_x = 0, .ofs_y = 0},
    {.bitmap_index = 2504, .adv_w = 177, .box_w = 11, .box_h = 17, .ofs_x = 0, .ofs_y = 0},
    {.bitmap_index = 2551, .adv_w = 177, .box_w = 11, .box_h = 16, .ofs_x = 0, .ofs_y = 0},
    {.bitmap_index = 2595, .adv_w = 256, .box_w = 16, .box_h = 13, .ofs_x = 0, .ofs_y = 0},
    {.bitmap_index = 2647, .adv_w = 150, .box_w = 8, .box_h = 17, .ofs_x = 1, .ofs_y = -4},
    {.bitmap_index = 2681, .adv_w = 158, .box_w = 9, .box_h = 16, .ofs_x = 1, .ofs_y = 0},
    {.bitmap_index = 2717, .adv_w = 158, .box_w = 9, .box_h = 16, .ofs_x = 1, .ofs_y = 0},
    {.bitmap_index = 2753, .adv_w = 158, .box_w = 9, .box_h = 17, .ofs_x = 1, .ofs_y = 0},
    {.bitmap_index = 2792, .adv_w = 158, .box_w = 9, .box_h = 16, .ofs_x = 1, .ofs_y = 0},
    {.bitmap_index = 2828, .adv_w = 117, .box_w = 7, .box_h = 17, .ofs_x = 0, .ofs_y = 0},
    {.bitmap_index = 2858, .adv_w = 117, .box_w = 7, .box_h = 16, .ofs_x = 0, .ofs_y = 0},
    {.bitmap_index = 2886, .adv_w = 185, .box_w = 10, .box_h = 17, .ofs_x = 1, .ofs_y = 0},
    {.bitmap_index = 2929, .adv_w = 185, .box_w = 10, .box_h = 16, .ofs_x = 1, .ofs_y = 0},
    {.bitmap_index = 2969, .adv_w = 177, .box_w = 10, .box_h = 17, .ofs_x = 1, .ofs_y = 0},
    {.bitmap_index = 3012, .adv_w = 177, .box_w = 10, .box_h = 16, .ofs_x = 1, .ofs_y = 0},
    {.bitmap_index = 3052, .adv_w = 163, .box_w = 10, .box_h = 14, .ofs_x = 0, .ofs_y = 0},
    {.bitmap_index = 3087, .adv_w = 163, .box_w = 10, .box_h = 14, .ofs_x = 0, .ofs_y = 0},
    {.bitmap_index = 3122, .adv_w = 163, .box_w = 10, .box_h = 13, .ofs_x = 0, .ofs_y = 0},
    {.bitmap_index = 3155, .adv_w = 252, .box_w = 15, .box_h = 10, .ofs_x = 0, .ofs_y = 0},
    {.bitmap_index = 3193, .adv_w = 148, .box_w = 9, .box_h = 14, .ofs_x = 0, .ofs_y = -4},
    {.bitmap_index = 3225, .adv_w = 160, .box_w = 10, .box_h = 14, .ofs_x = 0, .ofs_y = 0},
    {.bitmap_index = 3260, .adv_w = 160, .box_w = 10, .box_h = 14, .ofs_x = 0, .ofs_y = 0},
    {.bitmap_index = 3295, .adv_w = 160, .box_w = 10, .box_h = 14, .ofs_x = 0, .ofs_y = 0},
    {.bitmap_index = 3330, .adv_w = 160, .box_w = 10, .box_h = 13, .ofs_x = 0, .ofs_y = 0},
    {.bitmap_index = 3363, .adv_w = 57, .box_w = 8, .box_h = 14, .ofs_x = -2, .ofs_y = 0},
    {.bitmap_index = 3391, .adv_w = 57, .box_w = 5, .box_h = 13, .ofs_x = -1, .ofs_y = 0},
    {.bitmap_index = 3408, .adv_w = 163, .box_w = 10, .box_h = 14, .ofs_x = 0, .ofs_y = 0},
    {.bitmap_index = 3443, .adv_w = 163, .box_w = 10, .box_h = 13, .ofs_x = 0, .ofs_y = 0},
    {.bitmap_index = 3476, .adv_w = 169, .box_w = 9, .box_h = 14, .ofs_x = 1, .ofs_y = 0},
    {.bitmap_index = 3508, .adv_w = 169, .box_w = 9, .box_h = 13, .ofs_x = 1, .ofs_y = 0},
    {.bitmap_index = 3538, .adv_w = 163, .box_w = 11, .box_h = 15, .ofs_x = 0, .ofs_y = -2},
    {.bitmap_index = 3580, .adv_w = 250, .box_w = 15, .box_h = 13, .ofs_x = 1, .ofs_y = 0},
    {.bitmap_index = 3629, .adv_w = 253, .box_w = 15, .box_h = 10, .ofs_x = 0, .ofs_y = 0},
    {.bitmap_index = 3667, .adv_w = 174, .box_w = 11, .box_h = 16, .ofs_x = 0, .ofs_y = 0}
};
/*---------------------
 *  CHARACTER MAPPING
 *--------------------*/
static const uint16_t unicode_list_2[] = {
    0x0, 0x2, 0x4, 0x6, 0x7, 0x8, 0x9, 0xa,
    0xb, 0xe, 0xf, 0x14, 0x16, 0x1b, 0x1c, 0x20,
    0x22, 0x24, 0x26, 0x27, 0x28, 0x29, 0x2a, 0x2b,
    0x2e, 0x2f, 0x34, 0x36, 0x3b, 0x3c, 0x3f, 0x92,
    0x93, 0xb8
};
/*Collect the unicode lists and glyph_id offsets*/
static const lv_font_fmt_txt_cmap_t cmaps[] =
{
    {
        .range_start = 32, .range_length = 64, .glyph_id_start = 1,
        .unicode_list = NULL, .glyph_id_ofs_list = NULL, .list_length = 0, .type = LV_FONT_FMT_TXT_CMAP_FORMAT0_TINY
    },
    {
        .range_start = 97, .range_length = 30, .glyph_id_start = 65,
        .unicode_list = NULL, .glyph_id_ofs_list = NULL, .list_length = 0, .type = LV_FONT_FMT_TXT_CMAP_FORMAT0_TINY
    },
    {
        .range_start = 192, .range_length = 185, .glyph_id_start = 95,
        .unicode_list = unicode_list_2, .glyph_id_ofs_list = NULL, .list_length = 34, .type = LV_FONT_FMT_TXT_CMAP_SPARSE_TINY
    }
};
/*-----------------
 *    KERNING
 *----------------*/
/*Pair left and right glyphs for kerning*/
static const uint8_t kern_pair_glyph_ids[] =
{
    13, 21,
    15, 21,
    24, 13,
    24, 15,
    24, 64,
    64, 21
};
/* Kerning between the respective left and right glyphs
 * 4.4 format which needs to scaled with `kern_scale`*/
static const int8_t kern_pair_values[] =
{
    -8, -8, -14, -14, -14, -8
};
/*Collect the kern pair's data in one place*/
static const lv_font_fmt_txt_kern_pair_t kern_pairs =
{
    .glyph_ids = kern_pair_glyph_ids,
    .values = kern_pair_values,
    .pair_cnt = 6,
    .glyph_ids_size = 0
};
/*--------------------
 *  ALL CUSTOM DATA
 *--------------------*/
/*Store all the custom data of the font*/
static lv_font_fmt_txt_glyph_cache_t cache;
static const lv_font_fmt_txt_dsc_t font_dsc = {
    .glyph_bitmap = glyph_bitmap,
    .glyph_dsc = glyph_dsc,
    .cmaps = cmaps,
    .kern_dsc = &kern_pairs,
    .kern_scale = 16,
    .cmap_num = 3,
    .bpp = 2,
    .kern_classes = 0,
    .bitmap_format = 0,
    .cache = &cache
};
/*-----------------
 *  PUBLIC FONT
 *----------------*/
/*Initialize a public general font descriptor*/
const lv_font_t typewriter = {
    .get_glyph_dsc = lv_font_get_glyph_dsc_fmt_txt,    /*Function pointer to get glyph's data*/
    .get_glyph_bitmap = lv_font_get_bitmap_fmt_txt,    /*Function pointer to get glyph's bitmap*/
    .line_height = 21,          /*The maximum line height required by the font*/
    .base_line = 4,             /*Baseline measured from the bottom of the line*/

    .subpx = LV_FONT_SUBPX_NONE,
    .underline_position = -1,
    .underline_thickness = 1,
    .dsc = &font_dsc,          /*The custom font data. Will be accessed by `get_glyph_bitmap/dsc` */
};
#endif

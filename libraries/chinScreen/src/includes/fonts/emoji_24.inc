/*******************************************************************************
 * Size: 24 px
 * Bpp: 2
 ******************************************************************************/


#ifdef __has_include

    #if __has_include("lvgl.h")
         #ifndef LV_LVGL_H_INCLUDE_SIMPLE
             #define LV_LVGL_H_INCLUDE_SIMPLE
         #endif
     #endif
 #endif

 #ifdef LV_LVGL_H_INCLUDE_SIMPLE
     #include "lvgl.h"
 #else
     #include "../lvgl-8.3.11/lvgl.h"
 #endif

 #ifndef EMOJI_24
 #define EMOJI_24 1
 #endif

 #if EMOJI_24

/*-----------------
 *    BITMAPS
 *----------------*/
/*Store the image of the glyphs*/
static LV_ATTRIBUTE_LARGE_CONST const uint8_t emoji_24_glyph_bitmap[] = {
    /* U+0020 " " */
    /* U+0030 "0" */
    0x0, 0x1a, 0xaa, 0x40, 0x0, 0x8, 0x0, 0x6,
    0x0, 0x6, 0x0, 0x0, 0x8, 0x0, 0x80, 0x0,
    0x0, 0x20, 0x20, 0x0, 0x0, 0x0, 0x81, 0x0,
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    0x0, 0x1a, 0xae, 0x0, 0x0,
    /* U+0031 "1" */
    0x6, 0xbf, 0xff, 0xe9, 0x3, 0xd6, 0xea, 0xb9,
    0x7d, 0x7f, 0x80, 0x0, 0x2f, 0xc0, 0xc6, 0xaa,
    0xa5, 0x20, 0x0, 0x14, 0x2, 0x0, 0x80, 0x7,
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    0x0, 0x1a, 0xaa, 0x80, 0x0,
    /* U+0032 "2" */
    0x0, 0x1a, 0xaa, 0x40, 0x0, 0x9, 0x0, 0x6,
    0x0, 0x6, 0x0, 0x0, 0x9, 0x0, 0x80, 0x0,
    0x0, 0x20, 0x20, 0x0, 0x0, 0x0, 0x82, 0x0,
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    0x0, 0x1a, 0xaa, 0x40, 0x0,
    /* U+0033 "3" */
    0x0, 0x1a, 0xaa, 0x40, 0x0, 0x9, 0x0, 0x6,
    0x0, 0x2, 0x0, 0x0, 0x8, 0x0, 0x80, 0x0,
    0x0, 0x20, 0x24, 0x0, 0x0, 0x0, 0x83, 0x0,
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    0x0, 0x1a, 0xaa, 0x0, 0x0,
    /* U+0034 "4" */
    0x0, 0x1a, 0xaa, 0x0, 0x0, 0x18, 0x0, 0x6,
    0x0, 0x5, 0x0, 0x0, 0x9, 0x1, 0x40, 0x0,
    0x0, 0x20, 0x20, 0x18, 0x2, 0x40, 0x85, 0x3,
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    0x90, 0x0, 0x60, 0x0, 0x1, 0xaa, 0xe4, 0x0,
    /* U+0035 "5" */
    0x0, 0x1a, 0xaa, 0x40, 0x0, 0x18, 0x0, 0xa,
    0x0, 0x8, 0x0, 0x0, 0x8, 0x1, 0x0, 0x0,
    0x0, 0x20, 0x21, 0x80, 0x0, 0x60, 0x85, 0x10,
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    0xa0, 0x0, 0xa0, 0x0, 0x1, 0xab, 0xe0, 0x0,
    /* U+0036 "6" */
    0x0, 0x1b, 0xfa, 0x0, 0x0, 0x9, 0x0, 0x6,
    0x0, 0x6, 0x0, 0x0, 0x8, 0x0, 0x80, 0x0,
    0x0, 0x20, 0x20, 0x2c, 0x3, 0x80, 0x81, 0x3,
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    0x90, 0x0, 0x74, 0x0, 0x1, 0xbf, 0xe4, 0x0,
    /* U+0037 "7" */
    0x0, 0x1a, 0xaa, 0x40, 0x0, 0x19, 0x0, 0x6,
    0x0, 0x6, 0x0, 0x0, 0x8, 0x1, 0x80, 0x0,
    0x0, 0x20, 0x20, 0x18, 0x2, 0x0, 0x85, 0x7,
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    0x0, 0x26, 0xfe, 0x0, 0x0,
    /* U+0038 "8" */
    0x0, 0x1a, 0xaa, 0x40, 0x0, 0x9, 0x0, 0x6,
    0x0, 0x6, 0x0, 0x0, 0x8, 0x0, 0x80, 0x0,
    0x0, 0x20, 0x20, 0xb0, 0x1, 0xd0, 0x82, 0x14,
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    0x0, 0x1a, 0xae, 0x40, 0x0,
    /* U+0039 "9" */
    0x0, 0x0, 0x69, 0x0, 0x0, 0x0, 0x6a, 0x92,
    0x90, 0x0, 0x2a, 0x90, 0x0, 0x20, 0x2, 0x51,
    0x5b, 0xe9, 0x10, 0x19, 0x0, 0x0, 0x0, 0x10,
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    0x0,
    /* U+0041 "A" */
    0x0, 0x1a, 0xaa, 0x40, 0x0, 0x9, 0x0, 0x6,
    0x40, 0x5, 0x0, 0x0, 0x9, 0x0, 0x46, 0x80,
    0x2d, 0x20, 0x20, 0x0, 0x0, 0x0, 0x81, 0x7,
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    0x90, 0x0, 0x74, 0x0, 0x1, 0xbf, 0xe4, 0x0,
    /* U+0042 "B" */
    0x0, 0x1a, 0xaa, 0x40, 0x0, 0x9, 0x0, 0x6,
    0x0, 0x6, 0x0, 0x15, 0x48, 0x0, 0x80, 0x4,
    0x1, 0x20, 0x20, 0x0, 0x47, 0x4, 0x85, 0x5,
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    0x0, 0x1, 0x58, 0x0, 0x0,
    /* U+0043 "C" */
    0x1f, 0xfe, 0xab, 0xff, 0xc0, 0xff, 0xe0, 0x2,
    0xff, 0x83, 0xfd, 0x0, 0x1, 0xff, 0x1f, 0xe0,
    0x0, 0x2, 0xfc, 0xbd, 0x1c, 0x1, 0x81, 0xf5,
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    0x1, 0xa5, 0x50, 0x0,
    /* U+0044 "D" */
    0x0, 0x1a, 0xaa, 0x40, 0x0, 0x9, 0x0, 0x6,
    0x0, 0x6, 0x0, 0x0, 0x9, 0x0, 0x80, 0x0,
    0x0, 0x10, 0x20, 0x0, 0x0, 0x0, 0x81, 0x3c,
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    0x90, 0x0, 0x70, 0x0, 0x1, 0xaf, 0xe4, 0x0,
    /* U+0045 "E" */
    0x0, 0x1a, 0xaa, 0x0, 0x0, 0x9, 0x0, 0x6,
    0x0, 0x6, 0x0, 0x0, 0x8, 0x0, 0x9a, 0x0,
    0xa, 0x20, 0x21, 0x0, 0x0, 0x0, 0x82, 0x15,
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    0x0, 0x1a, 0xaa, 0x40, 0x0,
    /* U+0046 "F" */
    0x0, 0x1a, 0xaa, 0x40, 0x0, 0x9, 0x0, 0x6,
    0x0, 0x6, 0x0, 0x0, 0x8, 0x0, 0x80, 0x0,
    0x0, 0x20, 0x20, 0x0, 0x0, 0x0, 0x82, 0x0,
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    0x0, 0x1a, 0xaa, 0x40, 0x0,
    /* U+0047 "G" */
    0x0, 0x1a, 0xaa, 0x40, 0x0, 0x18, 0x0, 0x6,
    0x40, 0x5, 0x0, 0x0, 0x9, 0x1, 0x80, 0x0,
    0x0, 0x24, 0x20, 0x2c, 0x3, 0x80, 0x81, 0x3,
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    0x90, 0x0, 0x70, 0x0, 0x1, 0xaa, 0xa4, 0x0,
    /* U+0048 "H" */
    0x0, 0x2f, 0xfe, 0x40, 0x0, 0x2f, 0xff, 0xff,
    0xc0, 0x0, 0xa4, 0xe0, 0x74, 0x90, 0x8, 0x2f,
    0x55, 0xf5, 0x80, 0x35, 0x0, 0x0, 0x1, 0x40,
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    0x6, 0xbf, 0x90, 0x0,
    /* U+0049 "I" */
    0x0, 0xa, 0xaa, 0x40, 0x0, 0xa, 0x0, 0x2,
    0x40, 0x2, 0x0, 0x0, 0x2, 0x0, 0x80, 0x0,
    0x0, 0x8, 0x4, 0x0, 0x0, 0x0, 0x82, 0x1,
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    0x0, 0x24, 0x0, 0x0, 0x0,
    /* U+004A "J" */
    0x0, 0x0, 0x0, 0x0, 0x1, 0x42, 0xfa, 0xaa,
    0xe0, 0x16, 0xe4, 0x0, 0x1e, 0x40, 0x14, 0x0,
    0x0, 0x98, 0x1f, 0x0, 0x0, 0xf, 0x0, 0x71,
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    0x0, 0x2a, 0xaa, 0x40, 0x0,
    /* U+004B "K" */
    0x0, 0x1a, 0xaa, 0x40, 0x0, 0x6, 0x0, 0x1,
    0xc0, 0x0, 0x50, 0x0, 0x38, 0x80, 0x6, 0x1e,
    0x0, 0x18, 0x80, 0x20, 0x90, 0x0, 0x0, 0x80,
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    0x6, 0xaa, 0x90, 0x0,
    /* U+004C "L" */
    0x0, 0x1a, 0xaa, 0x40, 0x0, 0x18, 0x0, 0x6,
    0x40, 0x5, 0x0, 0x0, 0x9, 0x1, 0x87, 0x0,
    0x0, 0x24, 0x20, 0x80, 0x0, 0x0, 0x85, 0x1,
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    0x90, 0x0, 0x70, 0x0, 0x1, 0xaa, 0xa4, 0x0,
    /* U+004D "M" */
    0x0, 0x1a, 0xaa, 0x40, 0x0, 0x19, 0x0, 0x6,
    0x0, 0x5, 0x0, 0x0, 0x9, 0x1, 0x45, 0x0,
    0x5, 0x20, 0x27, 0xe5, 0x7, 0xd5, 0x85, 0xac,
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    0x90, 0x0, 0x70, 0x0, 0x1, 0xaf, 0xa4, 0x0,
    /* U+004E "N" */
    0x0, 0x1a, 0xaa, 0x0, 0x0, 0x9, 0x0, 0x6,
    0x0, 0x2, 0x0, 0x0, 0x8, 0x0, 0x80, 0x0,
    0x0, 0x20, 0x20, 0xc, 0x3, 0x0, 0x81, 0x3,
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    0x0, 0x1a, 0xaa, 0x40, 0x0,
    /* U+004F "O" */
    0x0, 0x1a, 0xaa, 0x40, 0x0, 0x19, 0x0, 0x6,
    0x0, 0x5, 0x0, 0x0, 0x9, 0x1, 0x40, 0x0,
    0x0, 0x20, 0x20, 0x0, 0x0, 0x0, 0x85, 0x1,
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    0x90, 0x0, 0x60, 0x0, 0x1, 0xaa, 0xe4, 0x0,
    /* U+0050 "P" */
    0x0, 0x0, 0x0, 0x1, 0xc0, 0xe0, 0x2, 0xc1,
    0xa8, 0x4, 0x2a, 0x67, 0xd1, 0x0, 0x28, 0x0,
    0x10, 0x20, 0x9, 0x0, 0x4, 0x2, 0x1, 0x40,
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    0x0, 0x1a, 0xfa, 0x50, 0x0,
    /* U+0051 "Q" */
    0x0, 0x1a, 0xaa, 0x40, 0x0, 0x9, 0x0, 0x7,
    0x40, 0x6, 0x0, 0x0, 0xa, 0x0, 0x80, 0x0,
    0x0, 0x14, 0x20, 0x0, 0x0, 0x0, 0x82, 0x2,
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    0x90, 0x0, 0x74, 0x0, 0x0, 0xaa, 0xa4, 0x0,
    /* U+0052 "R" */
    0x0, 0xa, 0x96, 0xa0, 0x0, 0x2, 0x80, 0x0,
    0x74, 0x0, 0x2b, 0x80, 0x2, 0x64, 0x1, 0x4b,
    0xc0, 0x7c, 0x20, 0x8, 0x3f, 0xc7, 0xf4, 0x20,
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    0x1, 0xaa, 0xa4, 0x0,
    /* U+0053 "S" */
    0x0, 0x1a, 0xaa, 0x40, 0x0, 0x9, 0x0, 0x6,
    0x0, 0x6, 0x2c, 0x2, 0x89, 0x0, 0x89, 0x0,
    0x6, 0x20, 0x30, 0x50, 0x0, 0x50, 0x82, 0x2f,
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    0x1, 0x50, 0x5, 0x6d, 0x0,
    /* U+0054 "T" */
    0x0, 0x1a, 0xaa, 0x40, 0x0, 0x18, 0x0, 0x2,
    0x40, 0x5, 0x0, 0x1, 0x89, 0x1, 0x82, 0x0,
    0x6, 0x20, 0x20, 0x80, 0x0, 0x0, 0x85, 0x0,
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    0x0, 0x6, 0xb6, 0x0, 0x0,
    /* U+0055 "U" */
    0x0, 0x19, 0x5a, 0x40, 0x0, 0x18, 0x0, 0x2,
    0x40, 0x5, 0x0, 0x0, 0x6, 0x1, 0x40, 0x0,
    0x0, 0x24, 0x20, 0x0, 0x0, 0x0, 0x81, 0x3,
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    0x0, 0x1, 0xa4, 0x0, 0x0,
    /* U+0056 "V" */
    0x0, 0x1a, 0xaa, 0x40, 0x0, 0x9, 0x0, 0x6,
    0x0, 0x6, 0x0, 0x0, 0x9, 0x0, 0x80, 0x0,
    0x0, 0x20, 0x20, 0x0, 0x0, 0x0, 0x82, 0x2,
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    0x0, 0x6, 0x59, 0x0, 0x0,
    /* U+0057 "W" */
    0x0, 0x1a, 0xaa, 0x40, 0x0, 0x9, 0x0, 0x7e,
    0x40, 0x6, 0x18, 0x0, 0x49, 0x0, 0x8f, 0x80,
    0x0, 0x24, 0x22, 0xff, 0x7, 0xf0, 0x82, 0x13,
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    0x90, 0x0, 0x74, 0x0, 0x1, 0xaa, 0xa4, 0x0,
    /* U+0058 "X" */
    0x0, 0x1b, 0xea, 0x40, 0x0, 0x19, 0x0, 0x2f,
    0x0, 0x5, 0x0, 0x1, 0x24, 0x1, 0x6e, 0x1,
    0xa4, 0x10, 0x21, 0x0, 0x60, 0x10, 0x85, 0xb,
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    0x90, 0x0, 0x7d, 0x0, 0x1, 0xaa, 0xa4, 0x40,
    /* U+0059 "Y" */
    0x0, 0x0, 0x0, 0x0, 0x0, 0x0, 0xf, 0xfe,
    0x0, 0x0, 0x0, 0xff, 0xfe, 0x0, 0x4, 0x1b,
    0xff, 0xfe, 0x0, 0x7f, 0xff, 0xff, 0xff, 0xfd,
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    0x0, 0x0, 0x1b, 0xfa, 0x0, 0x0,
    /* U+005A "Z" */
    0x0, 0x2f, 0xea, 0x40, 0x0, 0x9, 0x14, 0xb,
    0x0, 0x2, 0x8, 0xb, 0x89, 0x0, 0x82, 0xe0,
    0x70, 0x24, 0x20, 0x1d, 0xb, 0x80, 0xc2, 0x0,
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    0xa, 0x90, 0x0, 0x0, 0x0,
    /* U+0061 "a" */
    0x0, 0x6, 0x59, 0x0, 0x0, 0x9, 0x0, 0x6,
    0x0, 0x2, 0x0, 0x0, 0x9, 0x0, 0x80, 0x0,
    0x0, 0x24, 0x7f, 0xff, 0xff, 0xff, 0xe7, 0xbf,
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    0x90, 0x0, 0x64, 0x0, 0x1, 0xaa, 0xb4, 0x0,
    /* U+0062 "b" */
    0x0, 0x1a, 0xa9, 0x0, 0x0, 0x9, 0x0, 0xa,
    0x0, 0x6, 0x8, 0x6, 0x8, 0x0, 0x83, 0xc0,
    0x3c, 0x20, 0x30, 0x50, 0x0, 0x50, 0x86, 0xf,
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    0x1, 0xaa, 0xaa, 0xa4, 0x0,
    /* U+0063 "c" */
    0x0, 0x2a, 0x56, 0x0, 0x0, 0x9, 0x0, 0x2,
    0x40, 0x1, 0x81, 0x50, 0x0, 0x90, 0x8, 0x22,
    0x40, 0xc6, 0x18, 0x12, 0x38, 0x1, 0xf0, 0x20,
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    0x6, 0x7f, 0xd0, 0x0,
    /* U+0064 "d" */
    0x0, 0x1a, 0xaa, 0x40, 0x0, 0x18, 0x0, 0x6,
    0x0, 0x5, 0x74, 0x0, 0x95, 0x0, 0x88, 0x0,
    0x2, 0x54, 0x20, 0x0, 0x0, 0x0, 0x81, 0x0,
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    0x90, 0x0, 0x70, 0x0, 0x1, 0xaf, 0xa4, 0x0,
    /* U+0065 "e" */
    0x0, 0x1a, 0xaa, 0x40, 0x0, 0x18, 0x0, 0x6,
    0x0, 0x5, 0x0, 0x0, 0x9, 0x1, 0x40, 0x0,
    0x0, 0x20, 0x20, 0x2c, 0x3, 0x80, 0x85, 0x3,
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    0x90, 0x0, 0x60, 0x0, 0x1, 0xaa, 0xa4, 0x0,
    /* U+0066 "f" */
    0x0, 0x1a, 0xaa, 0x40, 0x0, 0x19, 0x0, 0x6,
    0x0, 0x5, 0x0, 0x0, 0x4, 0x0, 0x40, 0x2a,
    0x80, 0x10, 0x20, 0x5, 0x5, 0x0, 0xc1, 0x0,
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    0x80, 0x0, 0x24, 0x0, 0x1, 0xaa, 0xa4, 0x0,
    /* U+0067 "g" */
    0x0, 0xbf, 0xea, 0x40, 0x0, 0x12, 0x0, 0x6,
    0x0, 0x8, 0x10, 0x0, 0x9, 0x1, 0x80, 0x40,
    0x0, 0x20, 0x34, 0x8, 0x0, 0x0, 0x85, 0x80,
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    0x90, 0x0, 0x60, 0x0, 0x1, 0xaa, 0xa4, 0x0,
    /* U+0068 "h" */
    0x0, 0x1a, 0xaa, 0x40, 0x0, 0x19, 0x0, 0x6,
    0x0, 0x5, 0x0, 0x2, 0xd9, 0x1, 0x40, 0x0,
    0x1, 0x20, 0x20, 0xf9, 0x0, 0x0, 0x85, 0x0,
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    0x90, 0x0, 0x60, 0x0, 0x1, 0xaa, 0xa4, 0x0,
    /* U+0069 "i" */
    0x0, 0x1a, 0xaa, 0x40, 0x0, 0x19, 0x0, 0x6,
    0x0, 0x5, 0x0, 0x0, 0x9, 0x1, 0x40, 0x0,
    0x0, 0x20, 0x20, 0x0, 0x0, 0x0, 0x85, 0x0,
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    0x90, 0x0, 0x60, 0x0, 0x1, 0xaa, 0xa4, 0x0,
    /* U+006A "j" */
    0x0, 0x1a, 0xba, 0x40, 0x0, 0x2, 0x40, 0x0,
    0x90, 0x0, 0x20, 0x0, 0x0, 0x60, 0x2, 0x0,
    0x0, 0x0, 0x50, 0x10, 0x14, 0x1, 0x40, 0x80,
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    0x0,
    /* U+006B "k" */
    0x0, 0x1a, 0xa9, 0x40, 0x0, 0x1d, 0x0, 0x3,
    0x0, 0x3, 0xfa, 0xa, 0xfc, 0x1, 0xff, 0xf0,
    0xff, 0xf4, 0x2f, 0xfd, 0x7, 0xff, 0x85, 0x7f,
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    0x90, 0x0, 0x60, 0x0, 0x1, 0xaa, 0xa4, 0x0,
    /* U+006C "l" */
    0x0, 0x6, 0xfa, 0x0, 0x0, 0x6, 0x40, 0x6,
    0x0, 0x2, 0x40, 0x0, 0x8, 0x0, 0x91, 0x80,
    0xf4, 0x20, 0x18, 0x7e, 0x19, 0x41, 0x42, 0x1,
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    0xe, 0xab, 0x0, 0x80, 0x59, 0x0, 0x6, 0xa0,
    /* U+006D "m" */
    0x0, 0x1a, 0xaa, 0x40, 0x0, 0x19, 0x0, 0x6,
    0x0, 0x6, 0xd, 0x7, 0x9, 0x0, 0x83, 0x80,
    0x2d, 0x20, 0x20, 0x0, 0x0, 0x0, 0x82, 0x0,
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    0x90, 0x0, 0x74, 0x0, 0x1, 0xab, 0xa4, 0x0,
    /* U+006E "n" */
    0x0, 0x19, 0x6a, 0x40, 0x0, 0x1, 0x0, 0x0,
    0x50, 0x0, 0x0, 0x0, 0x0, 0x10, 0x3, 0xff,
    0x40, 0xbf, 0xd0, 0x24, 0x3, 0xed, 0x0, 0xd1,
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    0x6, 0xaa, 0x90, 0x0,
    /* U+006F "o" */
    0x0, 0x1b, 0xfe, 0x40, 0x0, 0x1f, 0xff, 0xff,
    0x0, 0x6, 0x55, 0x55, 0x54, 0x1, 0x42, 0x40,
    0x8, 0x0, 0x20, 0xd0, 0x0, 0x74, 0x45, 0x0,
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    0xa0, 0x0, 0x60, 0x0, 0x1, 0xaa, 0xa4, 0x0,
    /* U+0070 "p" */
    0x0, 0x1a, 0xaa, 0x40, 0x0, 0x18, 0x0, 0x2,
    0x0, 0x6, 0x0, 0x0, 0x8, 0x1, 0x81, 0x40,
    0x8, 0x20, 0x20, 0xa0, 0x0, 0x64, 0x81, 0x1,
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    0x80, 0x0, 0x24, 0x0, 0x2, 0xea, 0xa8, 0x0,
    /* U+0071 "q" */
    0x0, 0x1a, 0xaa, 0x40, 0x0, 0x19, 0x0, 0x6,
    0x0, 0x6, 0x0, 0x0, 0x5, 0x0, 0x94, 0x0,
    0x3e, 0x14, 0x22, 0xad, 0xf, 0xf8, 0x82, 0x2b,
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    0x90, 0x0, 0x60, 0x0, 0x1, 0xaa, 0xa4, 0x0,
    /* U+0072 "r" */
    0x0, 0x1a, 0xaa, 0x40, 0x0, 0x19, 0x0, 0x6,
    0x0, 0x5, 0x0, 0x0, 0x9, 0x1, 0x40, 0x0,
    0x0, 0x20, 0x21, 0x80, 0x0, 0xa0, 0x85, 0x10,
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    0x90, 0x0, 0x60, 0x0, 0x1, 0xab, 0xe4, 0x0,
    /* U+0073 "s" */
    0x0, 0x1a, 0xab, 0x96, 0x90, 0x19, 0x1, 0x46,
    0xd5, 0x5, 0x0, 0x18, 0x57, 0x81, 0x40, 0x1,
    0x40, 0x14, 0x20, 0x0, 0x0, 0x0, 0x81, 0x0,
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    0x90, 0x0, 0x60, 0x0, 0x1, 0xbf, 0xe4, 0x0,
    /* U+0074 "t" */
    0x0, 0x1a, 0xfa, 0x40, 0x0, 0x9, 0x0, 0x2,
    0x0, 0x6, 0x0, 0x0, 0x5, 0x0, 0x82, 0xe0,
    0xbd, 0x24, 0x2f, 0xff, 0xf, 0xff, 0xc3, 0xff,
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    0xd0, 0x0, 0x64, 0x0, 0x1, 0xaa, 0xe4, 0x0,
    /* U+0075 "u" */
    0x0, 0x19, 0x6a, 0xff, 0xe0, 0x2, 0x40, 0x3,
    0xff, 0xc0, 0x20, 0x0, 0xf, 0xff, 0x2, 0x0,
    0x0, 0x1f, 0xf8, 0x20, 0x2d, 0x7, 0xdf, 0xc0,
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    0x0,
    /* U+0076 "v" */
    0x0, 0xa, 0xaa, 0x40, 0x0, 0xa, 0x0, 0x7,
    0x0, 0x3, 0x40, 0x0, 0xc, 0x0, 0xff, 0x80,
    0x2f, 0xf0, 0x2f, 0xff, 0xf, 0xff, 0x83, 0xff,
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    0x0, 0x6, 0xf8, 0x0, 0x0,
    /* U+0077 "w" */
    0x0, 0x1a, 0xa8, 0x0, 0x0, 0x24, 0x0, 0x65,
    0x0, 0x60, 0x0, 0x2, 0xe0, 0x20, 0x0, 0x0,
    0x18, 0x20, 0x7c, 0xb, 0xa0, 0x88, 0x3f, 0x47,
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    0x0, 0xaa, 0xa8, 0x0,
    /* U+0078 "x" */
    0x0, 0xa, 0x6a, 0x90, 0x0, 0x2, 0x40, 0x0,
    0x60, 0x0, 0x20, 0x90, 0x9, 0x20, 0x2, 0x0,
    0xd0, 0xd0, 0x20, 0x4, 0x0, 0x40, 0x0, 0x50,
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    0x1, 0xaa, 0xa0, 0x0,
    /* U+0079 "y" */
    0x0, 0x1a, 0xaa, 0x40, 0x0, 0x18, 0x0, 0x6,
    0x0, 0x5, 0x0, 0x0, 0x8, 0x0, 0x80, 0x40,
    0x10, 0x20, 0x20, 0x7e, 0xb, 0xc0, 0x81, 0x6,
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    0x90, 0x0, 0x60, 0x0, 0x1, 0xaa, 0xa0, 0x0,
    /* U+007A "z" */
    0x0, 0x1a, 0xaa, 0x0, 0x0, 0x9, 0x0, 0x6,
    0x0, 0x6, 0x28, 0x2, 0x48, 0x0, 0x85, 0x0,
    0x9, 0x20, 0x20, 0x0, 0x0, 0x0, 0x42, 0x0,
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    0x6, 0x90, 0x0, 0x0, 0x0
};
/*---------------------
 *  GLYPH DESCRIPTION
 *--------------------*/
static const lv_font_fmt_txt_glyph_dsc_t emoji_24_glyph_dsc[] = {
    {.bitmap_index = 0, .adv_w = 0, .box_w = 0, .box_h = 0, .ofs_x = 0, .ofs_y = 0} /* id = 0 reserved */,
    {.bitmap_index = 0, .adv_w = 115, .box_w = 0, .box_h = 0, .ofs_x = 0, .ofs_y = 0},
    {.bitmap_index = 0, .adv_w = 318, .box_w = 18, .box_h = 17, .ofs_x = 1, .ofs_y = 1},
    {.bitmap_index = 77, .adv_w = 321, .box_w = 18, .box_h = 17, .ofs_x = 1, .ofs_y = 1},
    {.bitmap_index = 154, .adv_w = 320, .box_w = 18, .box_h = 17, .ofs_x = 1, .ofs_y = 1},
    {.bitmap_index = 231, .adv_w = 320, .box_w = 18, .box_h = 17, .ofs_x = 1, .ofs_y = 1},
    {.bitmap_index = 308, .adv_w = 318, .box_w = 18, .box_h = 16, .ofs_x = 1, .ofs_y = 2},
    {.bitmap_index = 380, .adv_w = 314, .box_w = 18, .box_h = 16, .ofs_x = 1, .ofs_y = 2},
    {.bitmap_index = 452, .adv_w = 320, .box_w = 18, .box_h = 16, .ofs_x = 1, .ofs_y = 2},
    {.bitmap_index = 524, .adv_w = 318, .box_w = 18, .box_h = 17, .ofs_x = 1, .ofs_y = 1},
    {.bitmap_index = 601, .adv_w = 318, .box_w = 18, .box_h = 17, .ofs_x = 1, .ofs_y = 1},
    {.bitmap_index = 678, .adv_w = 332, .box_w = 19, .box_h = 17, .ofs_x = 1, .ofs_y = 1},
    {.bitmap_index = 759, .adv_w = 321, .box_w = 18, .box_h = 16, .ofs_x = 1, .ofs_y = 2},
    {.bitmap_index = 831, .adv_w = 318, .box_w = 18, .box_h = 17, .ofs_x = 1, .ofs_y = 1},
    {.bitmap_index = 908, .adv_w = 335, .box_w = 19, .box_h = 16, .ofs_x = 1, .ofs_y = 2},
    {.bitmap_index = 984, .adv_w = 319, .box_w = 18, .box_h = 16, .ofs_x = 1, .ofs_y = 2},
    {.bitmap_index = 1056, .adv_w = 318, .box_w = 18, .box_h = 17, .ofs_x = 1, .ofs_y = 1},
    {.bitmap_index = 1133, .adv_w = 318, .box_w = 18, .box_h = 17, .ofs_x = 1, .ofs_y = 1},
    {.bitmap_index = 1210, .adv_w = 319, .box_w = 18, .box_h = 16, .ofs_x = 1, .ofs_y = 2},
    {.bitmap_index = 1282, .adv_w = 329, .box_w = 19, .box_h = 16, .ofs_x = 1, .ofs_y = 2},
    {.bitmap_index = 1358, .adv_w = 326, .box_w = 18, .box_h = 17, .ofs_x = 1, .ofs_y = 1},
    {.bitmap_index = 1435, .adv_w = 322, .box_w = 18, .box_h = 17, .ofs_x = 1, .ofs_y = 2},
    {.bitmap_index = 1512, .adv_w = 329, .box_w = 19, .box_h = 16, .ofs_x = 1, .ofs_y = 2},
    {.bitmap_index = 1588, .adv_w = 319, .box_w = 18, .box_h = 16, .ofs_x = 1, .ofs_y = 2},
    {.bitmap_index = 1660, .adv_w = 319, .box_w = 18, .box_h = 16, .ofs_x = 1, .ofs_y = 2},
    {.bitmap_index = 1732, .adv_w = 318, .box_w = 18, .box_h = 17, .ofs_x = 1, .ofs_y = 1},
    {.bitmap_index = 1809, .adv_w = 318, .box_w = 18, .box_h = 16, .ofs_x = 1, .ofs_y = 2},
    {.bitmap_index = 1881, .adv_w = 318, .box_w = 18, .box_h = 17, .ofs_x = 1, .ofs_y = 2},
    {.bitmap_index = 1958, .adv_w = 323, .box_w = 18, .box_h = 16, .ofs_x = 1, .ofs_y = 2},
    {.bitmap_index = 2030, .adv_w = 333, .box_w = 19, .box_h = 16, .ofs_x = 1, .ofs_y = 2},
    {.bitmap_index = 2106, .adv_w = 320, .box_w = 18, .box_h = 17, .ofs_x = 1, .ofs_y = 1},
    {.bitmap_index = 2183, .adv_w = 320, .box_w = 18, .box_h = 17, .ofs_x = 1, .ofs_y = 1},
    {.bitmap_index = 2260, .adv_w = 319, .box_w = 18, .box_h = 17, .ofs_x = 1, .ofs_y = 1},
    {.bitmap_index = 2337, .adv_w = 320, .box_w = 18, .box_h = 17, .ofs_x = 1, .ofs_y = 1},
    {.bitmap_index = 2414, .adv_w = 321, .box_w = 18, .box_h = 16, .ofs_x = 1, .ofs_y = 2},
    {.bitmap_index = 2486, .adv_w = 318, .box_w = 18, .box_h = 16, .ofs_x = 1, .ofs_y = 2},
    {.bitmap_index = 2558, .adv_w = 343, .box_w = 19, .box_h = 18, .ofs_x = 1, .ofs_y = 2},
    {.bitmap_index = 2644, .adv_w = 322, .box_w = 18, .box_h = 17, .ofs_x = 1, .ofs_y = 1},
    {.bitmap_index = 2721, .adv_w = 323, .box_w = 18, .box_h = 16, .ofs_x = 1, .ofs_y = 2},
    {.bitmap_index = 2793, .adv_w = 318, .box_w = 18, .box_h = 17, .ofs_x = 1, .ofs_y = 1},
    {.bitmap_index = 2870, .adv_w = 330, .box_w = 19, .box_h = 16, .ofs_x = 1, .ofs_y = 2},
    {.bitmap_index = 2946, .adv_w = 321, .box_w = 18, .box_h = 16, .ofs_x = 1, .ofs_y = 2},
    {.bitmap_index = 3018, .adv_w = 318, .box_w = 18, .box_h = 16, .ofs_x = 1, .ofs_y = 2},
    {.bitmap_index = 3090, .adv_w = 324, .box_w = 18, .box_h = 16, .ofs_x = 1, .ofs_y = 2},
    {.bitmap_index = 3162, .adv_w = 318, .box_w = 18, .box_h = 16, .ofs_x = 1, .ofs_y = 2},
    {.bitmap_index = 3234, .adv_w = 318, .box_w = 18, .box_h = 16, .ofs_x = 1, .ofs_y = 2},
    {.bitmap_index = 3306, .adv_w = 318, .box_w = 18, .box_h = 16, .ofs_x = 1, .ofs_y = 2},
    {.bitmap_index = 3378, .adv_w = 328, .box_w = 19, .box_h = 17, .ofs_x = 1, .ofs_y = 1},
    {.bitmap_index = 3459, .adv_w = 321, .box_w = 18, .box_h = 16, .ofs_x = 1, .ofs_y = 2},
    {.bitmap_index = 3531, .adv_w = 321, .box_w = 18, .box_h = 16, .ofs_x = 1, .ofs_y = 1},
    {.bitmap_index = 3603, .adv_w = 320, .box_w = 18, .box_h = 16, .ofs_x = 1, .ofs_y = 2},
    {.bitmap_index = 3675, .adv_w = 329, .box_w = 19, .box_h = 16, .ofs_x = 1, .ofs_y = 2},
    {.bitmap_index = 3751, .adv_w = 319, .box_w = 18, .box_h = 16, .ofs_x = 1, .ofs_y = 2},
    {.bitmap_index = 3823, .adv_w = 319, .box_w = 18, .box_h = 16, .ofs_x = 1, .ofs_y = 2},
    {.bitmap_index = 3895, .adv_w = 321, .box_w = 18, .box_h = 16, .ofs_x = 1, .ofs_y = 2},
    {.bitmap_index = 3967, .adv_w = 318, .box_w = 18, .box_h = 16, .ofs_x = 1, .ofs_y = 2},
    {.bitmap_index = 4039, .adv_w = 320, .box_w = 18, .box_h = 16, .ofs_x = 1, .ofs_y = 2},
    {.bitmap_index = 4111, .adv_w = 321, .box_w = 18, .box_h = 16, .ofs_x = 1, .ofs_y = 2},
    {.bitmap_index = 4183, .adv_w = 330, .box_w = 19, .box_h = 17, .ofs_x = 1, .ofs_y = 1},
    {.bitmap_index = 4264, .adv_w = 319, .box_w = 18, .box_h = 17, .ofs_x = 1, .ofs_y = 1},
    {.bitmap_index = 4341, .adv_w = 309, .box_w = 17, .box_h = 16, .ofs_x = 1, .ofs_y = 2},
    {.bitmap_index = 4409, .adv_w = 337, .box_w = 19, .box_h = 16, .ofs_x = 1, .ofs_y = 2},
    {.bitmap_index = 4485, .adv_w = 318, .box_w = 18, .box_h = 16, .ofs_x = 1, .ofs_y = 2},
    {.bitmap_index = 4557, .adv_w = 316, .box_w = 18, .box_h = 17, .ofs_x = 1, .ofs_y = 1}
};
/*---------------------
 *  CHARACTER MAPPING
 *--------------------*/
/*Collect the unicode lists and glyph_id offsets*/
static const lv_font_fmt_txt_cmap_t emoji_24_cmaps[] =
{
    {
        .range_start = 32, .range_length = 1, .glyph_id_start = 1,
        .unicode_list = NULL, .glyph_id_ofs_list = NULL, .list_length = 0, .type = LV_FONT_FMT_TXT_CMAP_FORMAT0_TINY
    },
    {
        .range_start = 48, .range_length = 10, .glyph_id_start = 2,
        .unicode_list = NULL, .glyph_id_ofs_list = NULL, .list_length = 0, .type = LV_FONT_FMT_TXT_CMAP_FORMAT0_TINY
    },
    {
        .range_start = 65, .range_length = 26, .glyph_id_start = 12,
        .unicode_list = NULL, .glyph_id_ofs_list = NULL, .list_length = 0, .type = LV_FONT_FMT_TXT_CMAP_FORMAT0_TINY
    },
    {
        .range_start = 97, .range_length = 26, .glyph_id_start = 38,
        .unicode_list = NULL, .glyph_id_ofs_list = NULL, .list_length = 0, .type = LV_FONT_FMT_TXT_CMAP_FORMAT0_TINY
    }
};
/*--------------------
 *  ALL CUSTOM DATA
 *--------------------*/
/*Store all the custom data of the font*/
static lv_font_fmt_txt_glyph_cache_t emoji_24_cache;
static const lv_font_fmt_txt_dsc_t emoji_24_font_dsc = {
    .glyph_bitmap = emoji_24_glyph_bitmap,
    .glyph_dsc = emoji_24_glyph_dsc,
    .cmaps = emoji_24_cmaps,
    .kern_dsc = NULL,
    .kern_scale = 0,
    .cmap_num = 4,
    .bpp = 2,
    .kern_classes = 0,
    .bitmap_format = 0,
    .cache = &emoji_24_cache
};
/*-----------------
 *  PUBLIC FONT
 *----------------*/
/*Initialize a public general font descriptor*/
const lv_font_t emoji_24 = {
    .get_glyph_dsc = lv_font_get_glyph_dsc_fmt_txt,    /*Function pointer to get glyph's data*/
    .get_glyph_bitmap = lv_font_get_bitmap_fmt_txt,    /*Function pointer to get glyph's bitmap*/
    .line_height = 20,          /*The maximum line height required by the font*/
    .base_line = 0,             /*Baseline measured from the bottom of the line*/

    .subpx = LV_FONT_SUBPX_NONE,
    .underline_position = -1,
    .underline_thickness = 1,
    .dsc = &emoji_24_font_dsc,          /*The custom font data. Will be accessed by `get_glyph_bitmap/dsc` */
};
#endif

/*******************************************************************************
 * Size: 18 px
 * Bpp: 2
 ******************************************************************************/


#ifdef __has_include

    #if __has_include("lvgl.h")
         #ifndef LV_LVGL_H_INCLUDE_SIMPLE
             #define LV_LVGL_H_INCLUDE_SIMPLE
         #endif
     #endif
 #endif

 #ifdef LV_LVGL_H_INCLUDE_SIMPLE
     #include "lvgl.h"
 #else
     #include "../lvgl-8.3.11/lvgl.h"
 #endif

 #ifndef CURSIVE
 #define CURSIVE 1
 #endif

 #if CURSIVE

/*-----------------
 *    BITMAPS
 *----------------*/
/*Store the image of the glyphs*/
static LV_ATTRIBUTE_LARGE_CONST const uint8_t cursive_glyph_bitmap[] = {
    /* U+0020 " " */
    /* U+0021 "!" */
    0x18, 0xe3, 0x4d, 0x30, 0xc7, 0x18, 0x20, 0x5,
    0x28,
    /* U+0022 "\"" */
    0x99, 0x99, 0x99, 0x44,
    /* U+0023 "#" */
    0x0, 0x41, 0x0, 0x10, 0x50, 0x2, 0x4, 0x1,
    0xbb, 0xfd, 0x3, 0x8, 0x0, 0x30, 0xc0, 0x1b,
    0xbf, 0xc0, 0xa1, 0x80, 0x9, 0x24, 0x0, 0xc3,
    0x40, 0x1c, 0x30, 0x2, 0x86, 0x0,
    /* U+0024 "$" */
    0x2, 0xf8, 0xe, 0xcc, 0x1c, 0xc8, 0x1c, 0xc0,
    0xf, 0xc0, 0x2, 0xe0, 0x0, 0xfc, 0x0, 0x9d,
    0x75, 0x8e, 0xa1, 0x8d, 0xb1, 0xa8, 0x2f, 0x90,
    0x1, 0x40,
    /* U+0025 "%" */
    0x6, 0x3, 0xa, 0xa7, 0x46, 0x19, 0x80, 0xc9,
    0xc0, 0x18, 0xa0, 0x0, 0x30, 0x0, 0x28, 0x0,
    0xc, 0xd8, 0xe, 0x60, 0x87, 0x18, 0x13, 0x42,
    0xa0,
    /* U+0026 "&" */
    0x2, 0xf0, 0x0, 0x30, 0xb0, 0x1, 0xc1, 0xc0,
    0x7, 0xd, 0x0, 0xd, 0xa0, 0x0, 0x2d, 0x0,
    0x1, 0xf4, 0xb0, 0x1c, 0x74, 0xd0, 0xe0, 0xf3,
    0x3, 0x80, 0xfc, 0xb, 0x41, 0xf4, 0xb, 0xe8,
    0xbd, 0x0, 0x0, 0x10,
    /* U+0027 "'" */
    0xdd, 0xc4,
    /* U+0028 "(" */
    0x2, 0x8, 0x18, 0x30, 0x30, 0x60, 0x90, 0xd0,
    0xe0, 0xa0, 0xb0, 0x70, 0x38, 0xc,
    /* U+0029 ")" */
    0x30, 0x2c, 0xd, 0xe, 0xa, 0x7, 0x7, 0x6,
    0xa, 0xc, 0xc, 0x24, 0x20, 0x80,
    /* U+002A "*" */
    0x1, 0x0, 0xc8, 0x1, 0xe7, 0x1, 0xf0, 0x2f,
    0x40, 0x35, 0x0, 0x40, 0x0,
    /* U+002B "+" */
    0x0, 0x0, 0x4, 0x0, 0x20, 0xf, 0xfd, 0x2,
    0x0, 0xc, 0x0, 0x20, 0x0,
    /* U+002C "," */
    0x11, 0xc3, 0x10,
    /* U+002D "-" */
    0x0, 0x3, 0xfc, 0x0, 0x0,
    /* U+002E "." */
    0x21, 0xc0,
    /* U+002F "/" */
    0x0, 0x10, 0x5, 0x0, 0x80, 0xc, 0x1, 0x80,
    0x24, 0x3, 0x0, 0x30, 0xa, 0x0, 0xd0, 0x1c,
    0x3, 0x80, 0x74, 0x6, 0x0,
    /* U+0030 "0" */
    0x1, 0xf4, 0x8, 0x2c, 0x24, 0xe, 0x30, 0xe,
    0x30, 0xb, 0x70, 0xa, 0x70, 0xa, 0x70, 0xd,
    0x74, 0xc, 0x3c, 0x24, 0xf, 0xd0,
    /* U+0031 "1" */
    0x1, 0x80, 0xf0, 0x9c, 0x17, 0x22, 0xc8, 0xa5,
    0x28, 0xe, 0x3, 0x80, 0xd0, 0x30,
    /* U+0032 "2" */
    0x6, 0xd0, 0x10, 0x74, 0x30, 0x38, 0x20, 0x38,
    0x0, 0x30, 0x0, 0xd0, 0x2, 0x40, 0x9, 0x0,
    0x28, 0x4, 0xbf, 0xe8, 0xc1, 0xf0,
    /* U+0033 "3" */
    0x2d, 0x0, 0xdf, 0xe1, 0xf, 0x80, 0x20, 0x2,
    0x0, 0x1f, 0x80, 0x3, 0x40, 0xa, 0x0, 0x28,
    0x0, 0xda, 0xb, 0xf, 0xa0,
    /* U+0034 "4" */
    0x2, 0x40, 0x3, 0x40, 0x7, 0x0, 0x9, 0x0,
    0xc, 0x20, 0x14, 0x70, 0x30, 0x60, 0x20, 0xbc,
    0xbf, 0xed, 0x0, 0xd0, 0x0, 0xd0, 0x0, 0xd0,
    /* U+0035 "5" */
    0x0, 0x24, 0x83, 0xc3, 0xfd, 0x5, 0x0, 0x10,
    0x0, 0xaf, 0x0, 0xf, 0x0, 0xd, 0x0, 0x34,
    0x0, 0xce, 0xa, 0xf, 0x90,
    /* U+0036 "6" */
    0x1, 0xf4, 0xa, 0xc, 0x1c, 0xc, 0x34, 0x0,
    0x36, 0xa0, 0x38, 0x28, 0x70, 0xc, 0x70, 0xc,
    0x34, 0xc, 0x38, 0x24, 0xb, 0xd0,
    /* U+0037 "7" */
    0xb9, 0x12, 0x6f, 0xd0, 0xa, 0x0, 0x20, 0x0,
    0xc0, 0x5, 0x0, 0xfa, 0x1, 0xc0, 0xd, 0x0,
    0x70, 0x2, 0x80, 0x0,
    /* U+0038 "8" */
    0x9, 0xa0, 0x60, 0xa3, 0x41, 0x8a, 0x8, 0xa,
    0x80, 0x2b, 0x42, 0x87, 0x1c, 0xe, 0xa0, 0x2a,
    0xc0, 0xd2, 0xa9, 0x0,
    /* U+0039 "9" */
    0x6, 0x90, 0x70, 0xd3, 0x42, 0x8c, 0x7, 0x30,
    0x1c, 0x90, 0xb0, 0xaa, 0xc0, 0xa, 0x0, 0x34,
    0xc1, 0xc2, 0xe8, 0x0,
    /* U+003A ":" */
    0xb5, 0x0, 0x6, 0xb0,
    /* U+003B ";" */
    0x2c, 0x50, 0x0, 0x0, 0x12, 0xc6, 0x20, 0x0,
    /* U+003C "<" */
    0x0, 0x0, 0x0, 0xc, 0x0, 0xa0, 0x1a, 0x0,
    0x3e, 0x0, 0x2, 0xe0, 0x0, 0x2c,
    /* U+003D "=" */
    0x3f, 0xf8, 0x0, 0x0, 0x0, 0x1f, 0xfc, 0x0,
    0x0,
    /* U+003E ">" */
    0x0, 0x0, 0x38, 0x0, 0xb, 0x80, 0x0, 0xbc,
    0x0, 0xa0, 0x1a, 0x0, 0x20, 0x0,
    /* U+003F "?" */
    0xa, 0x80, 0xc3, 0xc1, 0x7, 0x0, 0x1c, 0x0,
    0xd0, 0x1c, 0x0, 0xc0, 0x3, 0x40, 0x0, 0x0,
    0x20, 0x0, 0xc0, 0x0,
    /* U+0040 "@" */
    0x0, 0x6a, 0x90, 0x0, 0xe0, 0xe, 0x0, 0xd0,
    0x0, 0xd0, 0xe1, 0xf7, 0x2c, 0x70, 0xc3, 0xc7,
    0x28, 0xa0, 0xa0, 0xdd, 0x24, 0x34, 0x33, 0x4a,
    0x1d, 0x1c, 0xe2, 0xcb, 0x4d, 0x3c, 0x3c, 0xbd,
    0x7, 0x80, 0x0, 0x0, 0xb8, 0x1, 0x80, 0xb,
    0xff, 0x40, 0x0, 0x0, 0x0, 0x0,
    /* U+0041 "A" */
    0x0, 0x20, 0x0, 0x7, 0x40, 0x0, 0xa8, 0x0,
    0x16, 0x80, 0x2, 0x28, 0x0, 0x52, 0xc0, 0x8,
    0x1c, 0x7, 0xfb, 0xc1, 0x24, 0x1c, 0x13, 0x1,
    0xc8, 0x70, 0x1d, 0x4a, 0x1, 0xe0,
    /* U+0042 "B" */
    0x2, 0x0, 0x3, 0xe9, 0x6, 0xe0, 0xf3, 0x68,
    0xe, 0x4e, 0x2, 0x83, 0x40, 0xd0, 0xd5, 0x60,
    0x36, 0xa8, 0xd, 0x3, 0x3, 0x40, 0xc0, 0x40,
    0xa0, 0x3e, 0x90,
    /* U+0043 "C" */
    0x1, 0xb8, 0x2, 0x43, 0x42, 0x80, 0xd0, 0xc0,
    0x30, 0xb0, 0x0, 0x38, 0x0, 0xd, 0x0, 0x3,
    0x40, 0x1, 0xe0, 0x2, 0x2c, 0x1, 0x43, 0xc1,
    0x80, 0x7f, 0x40,
    /* U+0044 "D" */
    0x0, 0xc0, 0x0, 0xb, 0xb8, 0x0, 0xac, 0x2d,
    0xc, 0x70, 0x2c, 0x62, 0xc0, 0x3a, 0x4b, 0x0,
    0xb5, 0x2c, 0x1, 0xc0, 0xb0, 0x7, 0x2, 0xc0,
    0x2c, 0xa, 0x0, 0xd0, 0x38, 0x7, 0x2, 0xe0,
    0x70, 0xb, 0xea, 0x0,
    /* U+0045 "E" */
    0x2, 0xa4, 0x3, 0x43, 0x1, 0xc0, 0xc0, 0xa0,
    0x0, 0x1c, 0x0, 0x3, 0xac, 0x1, 0xaa, 0x0,
    0xc0, 0x1, 0xb0, 0x0, 0xac, 0x0, 0x83, 0x80,
    0x90, 0x7e, 0x80,
    /* U+0046 "F" */
    0x1, 0x0, 0x0, 0xd0, 0x1, 0xbf, 0xf9, 0x4c,
    0x0, 0xd7, 0x0, 0x11, 0xc0, 0x0, 0x70, 0x0,
    0x7f, 0xd0, 0xa, 0x0, 0x2, 0x80, 0x0, 0xe0,
    0x0, 0x30, 0x0,
    /* U+0047 "G" */
    0x1, 0xfc, 0x0, 0x28, 0x2c, 0x2, 0x80, 0x30,
    0xc, 0x0, 0x0, 0xb0, 0x0, 0x3, 0x80, 0x0,
    0xd, 0x1, 0xa0, 0x38, 0xc, 0xb9, 0xf0, 0x2f,
    0x82, 0xc0, 0xd, 0x3, 0xd0, 0xa0, 0x2, 0xfd,
    0x0,
    /* U+0048 "H" */
    0x0, 0x0, 0xa0, 0x78, 0x3, 0x81, 0x70, 0x2a,
    0x14, 0xc0, 0xe8, 0x63, 0x3, 0x90, 0xc, 0xe,
    0x0, 0x70, 0x70, 0x7, 0xc7, 0xc0, 0xf, 0xd7,
    0x0, 0x28, 0x1c, 0x0, 0xe0, 0x70, 0x3, 0x80,
    0xd0, 0x9, 0x3, 0x80,
    /* U+0049 "I" */
    0x0, 0xa, 0x0, 0x1e, 0x1, 0xb8, 0x9, 0x28,
    0xc, 0x28, 0x4, 0x28, 0x0, 0x28, 0x0, 0x28,
    0x0, 0x34, 0x20, 0x30, 0x60, 0xa0, 0x3f, 0x80,
    /* U+004A "J" */
    0x0, 0x1c, 0x0, 0xf, 0x0, 0x2b, 0x0, 0x30,
    0xc0, 0x28, 0x30, 0x0, 0x1c, 0x0, 0x7, 0x0,
    0x1, 0xe8, 0x0, 0xb0, 0x0, 0xbc, 0x0, 0xcb,
    0x0, 0x92, 0x80, 0x60, 0xa0, 0x34, 0x38, 0xd,
    0xe, 0x3, 0x43, 0x40, 0xa1, 0xc0, 0xa, 0x80,
    0x0,
    /* U+004B "K" */
    0x0, 0x1d, 0xe, 0x0, 0x38, 0x1c, 0x5, 0x34,
    0x34, 0x18, 0x34, 0x30, 0x14, 0x34, 0x90, 0x0,
    0x34, 0xc0, 0x0, 0x37, 0x40, 0x0, 0x3f, 0x40,
    0x0, 0x72, 0xc0, 0x80, 0xa0, 0xd0, 0xd1, 0xc0,
    0xb0, 0x7e, 0x0, 0x74, 0x0, 0x0, 0x2e, 0x0,
    0x0, 0x0,
    /* U+004C "L" */
    0x0, 0x1a, 0x40, 0x1c, 0x60, 0xd, 0x24, 0x3,
    0x18, 0x2, 0xe4, 0x0, 0xb0, 0x0, 0x28, 0x0,
    0xe, 0x0, 0x3, 0x40, 0x1a, 0xc0, 0x8, 0xfd,
    0x5, 0xe6, 0xf8,
    /* U+004D "M" */
    0x0, 0x0, 0x30, 0x0, 0x0, 0xd, 0x0, 0x30,
    0x7, 0x0, 0xd, 0x2, 0x80, 0x2, 0xc1, 0xd0,
    0x0, 0xb8, 0xf4, 0x0, 0x27, 0x8c, 0x0, 0xc,
    0xd3, 0x0, 0x2, 0x34, 0xc1, 0x2, 0x4e, 0x30,
    0x80, 0xc6, 0x8c, 0x50, 0x91, 0xa3, 0x60, 0xe0,
    0x70, 0xf0, 0x0,
    /* U+004E "N" */
    0x3, 0x0, 0xb0, 0x1c, 0xe, 0x90, 0x34, 0x60,
    0x0, 0xb3, 0x0, 0x2, 0xf8, 0x0, 0x9, 0xd0,
    0x0, 0x23, 0x80, 0x1, 0x4f, 0x0, 0x8, 0x2c,
    0x0, 0x30, 0xb4, 0x2, 0x42, 0xd0, 0x38, 0xb,
    0x0,
    /* U+004F "O" */
    0x1, 0xbe, 0x0, 0x6, 0x7, 0x80, 0xa, 0x92,
    0xc0, 0x1d, 0x0, 0xd0, 0x3c, 0x0, 0xe0, 0x79,
    0x0, 0xe0, 0xa3, 0x0, 0xe0, 0xa1, 0xd0, 0xd8,
    0x70, 0x1a, 0xe0, 0x74, 0x2, 0x40, 0x3d, 0xa,
    0x0, 0xb, 0xf4, 0x0,
    /* U+0050 "P" */
    0x0, 0x0, 0x0, 0x8, 0x0, 0x2, 0xfe, 0x2,
    0x9c, 0x3c, 0x70, 0xc0, 0xd9, 0x1c, 0xe, 0x41,
    0xc0, 0xa0, 0x1c, 0xd, 0x1, 0xc2, 0x80, 0x3e,
    0x90, 0x2, 0xc0, 0x0, 0x2c, 0x0, 0x3, 0x80,
    0x0, 0x34, 0x0,
    /* U+0051 "Q" */
    0x0, 0xbe, 0x0, 0x60, 0x3c, 0xc, 0x0, 0xe2,
    0x40, 0xf, 0x30, 0x0, 0xb3, 0x0, 0xb, 0x70,
    0x0, 0xa7, 0x0, 0x9, 0x74, 0x0, 0xc3, 0x80,
    0x18, 0x1f, 0xe6, 0x0, 0x7f, 0xc2, 0x0, 0xf,
    0xc0, 0x0, 0x0,
    /* U+0052 "R" */
    0x0, 0x0, 0x0, 0x2, 0x0, 0x0, 0x2f, 0xe0,
    0xa, 0xa1, 0xf0, 0xa3, 0x81, 0xd3, 0xd, 0x3,
    0x88, 0x34, 0xa, 0x0, 0xd0, 0x28, 0x3, 0x40,
    0xc0, 0xd, 0xa6, 0x0, 0x36, 0xb0, 0x1, 0xd0,
    0xa0, 0xb, 0x1, 0xc0, 0x28, 0x3, 0x80, 0x0,
    0xf, 0x80, 0x0, 0x4,
    /* U+0053 "S" */
    0x2, 0xf4, 0xd, 0xc, 0x1c, 0x8, 0x1d, 0x0,
    0xf, 0x40, 0x2, 0xf0, 0x0, 0x7c, 0x0, 0xd,
    0x74, 0xe, 0xa0, 0xd, 0xb0, 0x28, 0x2f, 0xe0,
    /* U+0054 "T" */
    0x7e, 0x58, 0x0, 0x96, 0xfd, 0x1, 0x80, 0x2e,
    0xf8, 0x50, 0x18, 0x0, 0x19, 0x1c, 0x0, 0x0,
    0x1c, 0x0, 0x0, 0x1c, 0x0, 0x0, 0x28, 0x0,
    0x0, 0x28, 0x0, 0x14, 0x34, 0x0, 0x28, 0x30,
    0x0, 0xf, 0xc0, 0x0,
    /* U+0055 "U" */
    0x2c, 0x2, 0x1, 0x70, 0x1d, 0x8, 0xc0, 0x70,
    0x13, 0x2, 0xc0, 0x1c, 0xb, 0x0, 0x70, 0x28,
    0x2, 0x80, 0xe0, 0xa, 0x3, 0x44, 0x28, 0x1d,
    0x10, 0xa0, 0xb5, 0x1, 0xc8, 0xd8, 0x2, 0xc3,
    0xc0,
    /* U+0056 "V" */
    0x0, 0xb, 0x0, 0x2, 0xd0, 0x70, 0x38, 0x35,
    0x6, 0x1d, 0x41, 0x87, 0x40, 0x62, 0xe0, 0x18,
    0xb4, 0x5, 0x2c, 0x2, 0xb, 0x0, 0xc6, 0xc0,
    0x60, 0x34, 0x20, 0xf, 0x24, 0x0, 0xf4, 0x0,
    /* U+0057 "W" */
    0x2, 0xc0, 0xc, 0x7, 0x40, 0xe, 0xd, 0x42,
    0x7, 0xd, 0x8b, 0x3, 0xc, 0x8b, 0x3, 0x5e,
    0x4f, 0x2, 0x2d, 0xb, 0x2, 0x1c, 0x17, 0x2,
    0x1c, 0x23, 0x45, 0xd, 0x23, 0x88, 0xe, 0xc2,
    0xe4, 0xb, 0x41, 0xd0,
    /* U+0058 "X" */
    0xc, 0x1, 0x80, 0x34, 0xd, 0x0, 0xf0, 0x60,
    0x3, 0xc3, 0x0, 0xb, 0x94, 0x0, 0x4b, 0xc0,
    0x2, 0xe, 0x0, 0x0, 0x7c, 0x8, 0x3, 0x74,
    0x20, 0x38, 0xf2, 0x43, 0xc1, 0xf8, 0x1c, 0x2,
    0xc0,
    /* U+0059 "Y" */
    0x1c, 0x1, 0x81, 0xc0, 0x3c, 0x8c, 0x3, 0x84,
    0xc0, 0x38, 0xc, 0x3, 0x41, 0xc0, 0x70, 0x1c,
    0x7, 0x1, 0xc0, 0xb0, 0x1c, 0xf, 0x1, 0xc2,
    0xb4, 0xc, 0x4b, 0x0, 0xb5, 0xe0, 0x0, 0x6a,
    0x0, 0xc, 0xe0, 0x2, 0x4e, 0x0, 0x30, 0xd0,
    0x3, 0xc, 0x0, 0x2f, 0x40,
    /* U+005A "Z" */
    0xf, 0x40, 0x0, 0x6b, 0xd7, 0x1, 0x1, 0xfc,
    0x0, 0x8, 0x0, 0x0, 0x50, 0x0, 0x2, 0x0,
    0x0, 0x20, 0x0, 0x0, 0x80, 0x4, 0x8, 0x0,
    0x10, 0x79, 0x2, 0x3, 0xaf, 0xf8, 0x1c, 0xb,
    0x80,
    /* U+005B "[" */
    0x3e, 0x83, 0x0, 0x30, 0x3, 0x0, 0x30, 0x7,
    0x0, 0x70, 0x7, 0x0, 0x70, 0xa, 0x0, 0xa0,
    0xa, 0x0, 0xa0, 0x7, 0xa8,
    /* U+005C "\\" */
    0x80, 0x8, 0x0, 0x90, 0x6, 0x0, 0x30, 0x3,
    0x0, 0x24, 0x1, 0x80, 0xc, 0x0, 0xa0, 0x7,
    0x0, 0x38, 0x2, 0xc0, 0xc,
    /* U+005D "]" */
    0x2a, 0x80, 0x30, 0xc, 0x7, 0x1, 0xc0, 0x70,
    0x18, 0xa, 0x2, 0x80, 0xa0, 0x28, 0xa, 0x3,
    0xaa, 0x80,
    /* U+005E "^" */
    0x1, 0x0, 0x1d, 0x0, 0xac, 0x9, 0x38, 0xa0,
    0x38,
    /* U+005F "_" */
    0x0, 0x0, 0x4f, 0xff, 0xe0,
    /* U+0061 "a" */
    0x1e, 0x60, 0x70, 0xe0, 0xd0, 0xd1, 0xc0, 0xc1,
    0xd2, 0xc4, 0xe2, 0xd8, 0x38, 0xf0,
    /* U+0062 "b" */
    0xc, 0x0, 0x38, 0x0, 0x74, 0x0, 0xa4, 0x0,
    0xa4, 0x0, 0xef, 0x40, 0xf8, 0xc0, 0xfc, 0xd8,
    0xd7, 0xd0, 0xd0, 0xc0, 0xe2, 0x40, 0x7d, 0x0,
    /* U+0063 "c" */
    0x1b, 0x1, 0xc9, 0x9, 0x11, 0x34, 0x8, 0xd0,
    0x53, 0xc6, 0x3, 0xe0, 0x0,
    /* U+0064 "d" */
    0x0, 0x20, 0x0, 0x1d, 0x0, 0x7, 0x0, 0x2,
    0xc0, 0x0, 0xa0, 0x7, 0xb8, 0x7, 0xd, 0x3,
    0x83, 0x44, 0xd0, 0xd1, 0x34, 0x75, 0xf, 0x1d,
    0x80, 0xe3, 0xc0,
    /* U+0065 "e" */
    0x2b, 0x1, 0xc9, 0xd, 0x31, 0x3a, 0x8, 0xd0,
    0x52, 0xc6, 0x3, 0xe0, 0x0,
    /* U+0066 "f" */
    0x3, 0x40, 0x19, 0x0, 0xd4, 0x3, 0x40, 0xd,
    0x0, 0x74, 0x3, 0xc0, 0x1e, 0x58, 0x3f, 0x40,
    0xd4, 0x3, 0x50, 0xd, 0x10, 0x34, 0x40, 0xd1,
    0x3, 0x50, 0xd, 0x40, 0x36, 0x0, 0xb0, 0x0,
    /* U+0067 "g" */
    0x1e, 0x60, 0x70, 0xe0, 0xd0, 0xd5, 0xc0, 0xd8,
    0xd1, 0xf0, 0xe1, 0xd0, 0x39, 0xc0, 0x2, 0xc0,
    0x8, 0xc0, 0x24, 0xc0, 0x31, 0xc0, 0x31, 0x80,
    0x2e, 0x0,
    /* U+0068 "h" */
    0x1c, 0x0, 0x38, 0x0, 0x74, 0x0, 0xb4, 0x0,
    0xa4, 0x0, 0xb5, 0xc0, 0xf3, 0xd0, 0xe8, 0xc1,
    0xf0, 0xc1, 0xe1, 0xc8, 0xe1, 0xd4, 0xd0, 0xe0,
    /* U+0069 "i" */
    0x0, 0xc, 0x7, 0x0, 0x0, 0x20, 0x3c, 0xd,
    0x13, 0x44, 0xd4, 0x36, 0xf, 0x0,
    /* U+006A "j" */
    0x0, 0x0, 0x3, 0x0, 0xc, 0x0, 0x0, 0x0,
    0xc0, 0x7, 0x0, 0x28, 0x40, 0xa8, 0x2, 0xd0,
    0xa, 0x0, 0x34, 0x2, 0xd0, 0x23, 0x41, 0x8d,
    0xc, 0x30, 0x34, 0xc0, 0x78, 0x0,
    /* U+006B "k" */
    0x20, 0x1, 0xc0, 0x7, 0x0, 0x2c, 0x0, 0xb0,
    0x2, 0xcf, 0xa, 0x9c, 0x29, 0x30, 0xf6, 0x3,
    0xa8, 0xe, 0x30, 0x34, 0xb0, 0x0, 0xa0,
    /* U+006C "l" */
    0x28, 0xd, 0x6, 0x42, 0x90, 0xa4, 0x3c, 0xe,
    0x3, 0x44, 0xd1, 0x34, 0x4d, 0x83, 0xc0,
    /* U+006D "m" */
    0x32, 0xc7, 0x3, 0xdf, 0x2d, 0xe, 0x9e, 0x34,
    0x7c, 0x70, 0xc1, 0xe1, 0xc3, 0x23, 0x8b, 0xd,
    0x4d, 0x1c, 0x38, 0x0,
    /* U+006E "n" */
    0x1c, 0xb0, 0xe, 0x7c, 0x3, 0xa7, 0x4, 0xf1,
    0xc4, 0x38, 0x72, 0xd, 0x1d, 0x3, 0x47, 0x40,
    /* U+006F "o" */
    0x2e, 0x80, 0x7c, 0xd0, 0xdc, 0xa4, 0xd7, 0xe0,
    0xd0, 0x90, 0xb0, 0xc0, 0x3e, 0x0,
    /* U+0070 "p" */
    0xc, 0xf0, 0x78, 0xe2, 0xd2, 0xcb, 0x6, 0x28,
    0x28, 0xa0, 0xc2, 0xed, 0xd, 0x0, 0x34, 0x0,
    0xd0, 0x7, 0x40, 0x1c, 0x0, 0x60, 0x0,
    /* U+0071 "q" */
    0x1e, 0x60, 0x70, 0xe0, 0xd0, 0xd1, 0xc0, 0xc4,
    0xd2, 0xd4, 0xe2, 0xe0, 0x7d, 0xd0, 0x1, 0xc0,
    0x1, 0xc0, 0x2, 0xc0, 0x3, 0xc0, 0x3, 0x80,
    0x3, 0x0,
    /* U+0072 "r" */
    0xd0, 0xd, 0x0, 0x6c, 0x1, 0xc4, 0x28, 0x82,
    0xa0, 0x1d, 0x0,
    /* U+0073 "s" */
    0x38, 0x34, 0xd, 0x16, 0xd0, 0x38, 0x26, 0xa,
    0x0,
    /* U+0074 "t" */
    0x4, 0x0, 0xc0, 0xc, 0x1, 0xc0, 0x3d, 0x41,
    0xc0, 0x2c, 0x12, 0x84, 0x28, 0x82, 0xa0, 0x2d,
    0x0,
    /* U+0075 "u" */
    0x70, 0x90, 0xe0, 0xd0, 0xe0, 0xc1, 0xd2, 0xc1,
    0xd3, 0xc8, 0xda, 0xd4, 0xb5, 0xe0,
    /* U+0076 "v" */
    0x72, 0x80, 0xf3, 0x80, 0xe3, 0x84, 0xd1, 0xe0,
    0xe0, 0x40, 0xb2, 0x0, 0x3c, 0x0,
    /* U+0077 "w" */
    0x60, 0x28, 0xe, 0x17, 0x80, 0xd3, 0x7c, 0x4c,
    0x31, 0xe4, 0xd3, 0x4, 0xe, 0x75, 0x0, 0x76,
    0xd0, 0x0,
    /* U+0078 "x" */
    0x18, 0x20, 0x2c, 0x80, 0xe, 0x41, 0x7, 0x1,
    0x7, 0x84, 0x1d, 0xd4, 0x34, 0xe0,
    /* U+0079 "y" */
    0x70, 0x90, 0xe0, 0xc0, 0xe1, 0xc4, 0xd2, 0xd0,
    0xd3, 0xd0, 0xd9, 0xc0, 0xf6, 0x80, 0xa, 0x80,
    0x16, 0x80, 0x32, 0x80, 0x92, 0x40, 0xa3, 0x0,
    0x39, 0x0,
    /* U+007A "z" */
    0xe0, 0xc2, 0xff, 0x0, 0x70, 0x42, 0x1, 0x14,
    0x22, 0xfa, 0x4d, 0xb8, 0x0,
    /* U+007B "{" */
    0x2, 0x2, 0x40, 0xc0, 0x34, 0xd, 0x3, 0x2,
    0x80, 0x70, 0xc, 0x3, 0x1, 0xc0, 0x70, 0xc,
    0x2, 0x80,
    /* U+007C "|" */
    0x14, 0x51, 0x45, 0x24, 0x82, 0x8, 0x30, 0xc3,
    0xc, 0x30, 0xc0, 0x0,
    /* U+007D "}" */
    0x24, 0x3, 0x0, 0xc0, 0x30, 0x1c, 0x7, 0x0,
    0xe0, 0x34, 0x18, 0xa, 0x1, 0xc0, 0x60, 0x24,
    0x18, 0x0,
    /* U+007E "~" */
    0x1f, 0x44, 0x22, 0xf8, 0x0, 0x0,
    /* U+00C0 "À" */
    0x0, 0x30, 0x0, 0x3, 0x40, 0x0, 0x9, 0x0,
    0x2, 0x0, 0x0, 0x74, 0x0, 0xa, 0x80, 0x1,
    0x68, 0x0, 0x22, 0x80, 0x5, 0x2c, 0x0, 0x81,
    0xc0, 0x7f, 0xbc, 0x12, 0x41, 0xc1, 0x30, 0x1c,
    0x87, 0x1, 0xd4, 0xa0, 0x1e, 0x0,
    /* U+00C2 "Â" */
    0x0, 0x18, 0x0, 0x2, 0xc0, 0x0, 0x5a, 0x0,
    0x2, 0x0, 0x0, 0x74, 0x0, 0xa, 0x80, 0x1,
    0x68, 0x0, 0x22, 0x80, 0x5, 0x2c, 0x0, 0x81,
    0xc0, 0x7f, 0xbc, 0x12, 0x41, 0xc1, 0x30, 0x1c,
    0x87, 0x1, 0xd4, 0xa0, 0x1e, 0x0,
    /* U+00C4 "Ä" */
    0x0, 0x41, 0x0, 0xd, 0x70, 0x0, 0x20, 0x0,
    0x7, 0x40, 0x0, 0xa8, 0x0, 0x16, 0x80, 0x2,
    0x28, 0x0, 0x52, 0xc0, 0x8, 0x1c, 0x7, 0xfb,
    0xc1, 0x24, 0x1c, 0x13, 0x1, 0xc8, 0x70, 0x1d,
    0x4a, 0x1, 0xe0,
    /* U+00C6 "Æ" */
    0x0, 0x24, 0x0, 0x0, 0x1, 0xe2, 0xa4, 0x0,
    0xa, 0xf4, 0x30, 0x0, 0x4b, 0x80, 0x0, 0x2,
    0x2e, 0x0, 0x0, 0x14, 0xbe, 0xa0, 0x0, 0x82,
    0xea, 0x40, 0x1f, 0xaf, 0x0, 0x4, 0x24, 0x2c,
    0x0, 0x20, 0xc0, 0xb0, 0x1, 0x7, 0x1, 0xc0,
    0x4, 0x28, 0x3, 0xc1, 0x80, 0x0, 0x2, 0xe4,
    0x0,
    /* U+00C7 "Ç" */
    0x1, 0xb8, 0x2, 0x43, 0x42, 0x80, 0xd0, 0xc0,
    0x30, 0xb0, 0x0, 0x38, 0x0, 0xd, 0x0, 0x3,
    0x40, 0x1, 0xe0, 0x2, 0x2c, 0x1, 0x43, 0xc1,
    0x80, 0x7f, 0x40, 0x3, 0x0, 0x0, 0x90, 0x0,
    0xa0, 0x0,
    /* U+00C8 "È" */
    0x0, 0xc0, 0x0, 0x28, 0x0, 0x1, 0x40, 0xa,
    0x90, 0xd, 0xc, 0x7, 0x3, 0x2, 0x80, 0x0,
    0x70, 0x0, 0xe, 0xb0, 0x6, 0xa8, 0x3, 0x0,
    0x6, 0xc0, 0x2, 0xb0, 0x2, 0xe, 0x2, 0x41,
    0xfa, 0x0,
    /* U+00C9 "É" */
    0x0, 0x10, 0x0, 0xd, 0x0, 0x7, 0x0, 0x1,
    0x0, 0x2, 0xa4, 0x3, 0x43, 0x1, 0xc0, 0xc0,
    0xa0, 0x0, 0x1c, 0x0, 0x3, 0xac, 0x1, 0xaa,
    0x0, 0xc0, 0x1, 0xb0, 0x0, 0xac, 0x0, 0x83,
    0x80, 0x90, 0x7e, 0x80,
    /* U+00CA "Ê" */
    0x0, 0x20, 0x0, 0x2c, 0x0, 0x11, 0xc0, 0xa,
    0x90, 0xd, 0xc, 0x7, 0x3, 0x2, 0x80, 0x0,
    0x70, 0x0, 0xe, 0xb0, 0x6, 0xa8, 0x3, 0x0,
    0x6, 0xc0, 0x2, 0xb0, 0x2, 0xe, 0x2, 0x41,
    0xfa, 0x0,
    /* U+00CB "Ë" */
    0x1, 0x44, 0x0, 0xa3, 0x0, 0x0, 0x0, 0xa,
    0x90, 0xd, 0xc, 0x7, 0x3, 0x2, 0x80, 0x0,
    0x70, 0x0, 0xe, 0xb0, 0x6, 0xa8, 0x3, 0x0,
    0x6, 0xc0, 0x2, 0xb0, 0x2, 0xe, 0x2, 0x41,
    0xfa, 0x0,
    /* U+00CE "Î" */
    0x0, 0x24, 0x0, 0x6c, 0x0, 0x41, 0x0, 0xa,
    0x0, 0x1e, 0x1, 0xb8, 0x9, 0x28, 0xc, 0x28,
    0x4, 0x28, 0x0, 0x28, 0x0, 0x28, 0x0, 0x34,
    0x20, 0x30, 0x60, 0xa0, 0x3f, 0x80,
    /* U+00CF "Ï" */
    0x1, 0x44, 0x3, 0x5c, 0x0, 0x0, 0x0, 0xa,
    0x0, 0x1e, 0x1, 0xb8, 0x9, 0x28, 0xc, 0x28,
    0x4, 0x28, 0x0, 0x28, 0x0, 0x28, 0x0, 0x34,
    0x20, 0x30, 0x60, 0xa0, 0x3f, 0x80,
    /* U+00D4 "Ô" */
    0x0, 0x14, 0x0, 0x0, 0x3c, 0x0, 0x0, 0x9a,
    0x0, 0x1, 0xbe, 0x0, 0x6, 0x7, 0x80, 0xa,
    0x92, 0xc0, 0x1d, 0x0, 0xd0, 0x3c, 0x0, 0xe0,
    0x79, 0x0, 0xe0, 0xa3, 0x0, 0xe0, 0xa1, 0xd0,
    0xd8, 0x70, 0x1a, 0xe0, 0x74, 0x2, 0x40, 0x3d,
    0xa, 0x0, 0xb, 0xf4, 0x0,
    /* U+00D6 "Ö" */
    0x0, 0x41, 0x0, 0x0, 0xca, 0x0, 0x0, 0x0,
    0x0, 0x1, 0xbe, 0x0, 0x6, 0x7, 0x80, 0xa,
    0x92, 0xc0, 0x1d, 0x0, 0xd0, 0x3c, 0x0, 0xe0,
    0x79, 0x0, 0xe0, 0xa3, 0x0, 0xe0, 0xa1, 0xd0,
    0xd8, 0x70, 0x1a, 0xe0, 0x74, 0x2, 0x40, 0x3d,
    0xa, 0x0, 0xb, 0xf4, 0x0,
    /* U+00DB "Û" */
    0x0, 0x20, 0x0, 0x2, 0xc0, 0x0, 0x15, 0xc0,
    0xb, 0x0, 0x80, 0x5c, 0x7, 0x42, 0x30, 0x1c,
    0x4, 0xc0, 0xb0, 0x7, 0x2, 0xc0, 0x1c, 0xa,
    0x0, 0xa0, 0x38, 0x2, 0x80, 0xd1, 0xa, 0x7,
    0x44, 0x28, 0x2d, 0x40, 0x72, 0x36, 0x0, 0xb0,
    0xf0, 0x0,
    /* U+00DC "Ü" */
    0x1, 0x4, 0x0, 0xd, 0x70, 0x2, 0xc0, 0x20,
    0x17, 0x1, 0xd0, 0x8c, 0x7, 0x1, 0x30, 0x2c,
    0x1, 0xc0, 0xb0, 0x7, 0x2, 0x80, 0x28, 0xe,
    0x0, 0xa0, 0x34, 0x42, 0x81, 0xd1, 0xa, 0xb,
    0x50, 0x1c, 0x8d, 0x80, 0x2c, 0x3c, 0x0,
    /* U+00E0 "à" */
    0xc, 0x0, 0xe, 0x0, 0x2, 0x80, 0x0, 0x0,
    0x1e, 0x60, 0x70, 0xe0, 0xd0, 0xd1, 0xc0, 0xc1,
    0xd2, 0xc4, 0xe2, 0xd8, 0x38, 0xf0,
    /* U+00E2 "â" */
    0x3, 0x0, 0x7, 0x40, 0x8, 0xc0, 0x0, 0x0,
    0x1e, 0x60, 0x70, 0xe0, 0xd0, 0xd1, 0xc0, 0xc1,
    0xd2, 0xc4, 0xe2, 0xd8, 0x38, 0xf0,
    /* U+00E4 "ä" */
    0x1c, 0xa0, 0x4, 0x40, 0x0, 0x0, 0x1e, 0x60,
    0x70, 0xe0, 0xd0, 0xd1, 0xc0, 0xc1, 0xd2, 0xc4,
    0xe2, 0xd8, 0x38, 0xf0,
    /* U+00E6 "æ" */
    0x1f, 0x6d, 0x3, 0xd, 0x50, 0xa0, 0xc8, 0x1d,
    0xc, 0x81, 0xd0, 0xe0, 0x8b, 0x1e, 0x24, 0x3d,
    0x7d, 0x0,
    /* U+00E7 "ç" */
    0x1b, 0x1, 0xc9, 0xa, 0x11, 0x34, 0x8, 0xd0,
    0x53, 0x82, 0x7, 0xe0, 0x6, 0x0, 0xc, 0x0,
    0xa0, 0x0,
    /* U+00E8 "è" */
    0x8, 0x0, 0x34, 0x0, 0x34, 0x0, 0x0, 0x2b,
    0x1, 0xc9, 0xd, 0x31, 0x3a, 0x8, 0xd0, 0x52,
    0xc6, 0x3, 0xe0, 0x0,
    /* U+00E9 "é" */
    0x3, 0x40, 0xc, 0x0, 0x90, 0x0, 0x0, 0x2b,
    0x1, 0xc9, 0xd, 0x31, 0x3a, 0x8, 0xd0, 0x52,
    0xc6, 0x3, 0xe0, 0x0,
    /* U+00EA "ê" */
    0x6, 0x0, 0x2c, 0x1, 0x1c, 0x0, 0x0, 0x2b,
    0x1, 0xc9, 0xd, 0x31, 0x3a, 0x8, 0xd0, 0x52,
    0xc6, 0x3, 0xe0, 0x0,
    /* U+00EB "ë" */
    0x35, 0xc0, 0x41, 0x0, 0x0, 0xa, 0xc0, 0x72,
    0x43, 0x4c, 0x4e, 0x82, 0x34, 0x14, 0xb1, 0x80,
    0xf8, 0x0,
    /* U+00EE "î" */
    0xc, 0x2, 0xd0, 0x3, 0x0, 0x0, 0x8, 0x3,
    0xc0, 0x34, 0x43, 0x44, 0x35, 0x3, 0x60, 0x3c,
    0x0,
    /* U+00EF "ï" */
    0x73, 0x41, 0x10, 0x0, 0x0, 0x80, 0x3c, 0x3,
    0x44, 0x34, 0x43, 0x50, 0x36, 0x3, 0xc0,
    /* U+00F4 "ô" */
    0x3, 0x0, 0x7, 0x40, 0x0, 0xc0, 0x0, 0x0,
    0x2e, 0x80, 0x7c, 0xd0, 0xdc, 0xa4, 0xd7, 0xe0,
    0xd0, 0x90, 0xb0, 0xc0, 0x3e, 0x0,
    /* U+00F6 "ö" */
    0x1c, 0xd0, 0x4, 0x40, 0x0, 0x0, 0x2e, 0x80,
    0x7c, 0xd0, 0xdc, 0xa4, 0xd7, 0xe0, 0xd0, 0x90,
    0xb0, 0xc0, 0x3e, 0x0,
    /* U+00FB "û" */
    0x3, 0x0, 0xb, 0x40, 0x0, 0xc0, 0x0, 0x0,
    0x70, 0x90, 0xe0, 0xd0, 0xe0, 0xc1, 0xd2, 0xc1,
    0xd3, 0xc8, 0xda, 0xd4, 0xb5, 0xe0,
    /* U+00FC "ü" */
    0x28, 0xc0, 0x10, 0x40, 0x0, 0x0, 0x70, 0x90,
    0xe0, 0xd0, 0xe0, 0xc1, 0xd2, 0xc1, 0xd3, 0xc8,
    0xda, 0xd4, 0xb5, 0xe0,
    /* U+00FF "ÿ" */
    0x14, 0x40, 0x34, 0xc0, 0x0, 0x0, 0x0, 0x0,
    0x70, 0x90, 0xe0, 0xc0, 0xe1, 0xc4, 0xd2, 0xd0,
    0xd3, 0xd0, 0xd9, 0xc0, 0xf6, 0x80, 0xa, 0x80,
    0x16, 0x80, 0x32, 0x80, 0x92, 0x40, 0xa3, 0x0,
    0x39, 0x0,
    /* U+0152 "Œ" */
    0x1, 0xbc, 0x1, 0xb4, 0x0, 0x60, 0x70, 0xa1,
    0x80, 0xa, 0x92, 0xdc, 0x20, 0x0, 0xe0, 0xf,
    0xd9, 0x0, 0x2f, 0x40, 0xfd, 0x0, 0x3, 0x2f,
    0xfe, 0xfa, 0x0, 0x60, 0x0, 0xfa, 0xa0, 0xa,
    0x0, 0xf, 0x0, 0x4, 0xb0, 0x0, 0xf0, 0x0,
    0x87, 0x40, 0x2f, 0x0, 0x20, 0x3d, 0xa, 0x38,
    0x9, 0x0, 0xbf, 0x40, 0xfe, 0x0,
    /* U+0153 "œ" */
    0xf, 0xd6, 0xc0, 0x39, 0x3c, 0x90, 0x36, 0x38,
    0xc1, 0x73, 0x3a, 0x44, 0x70, 0xb8, 0x8, 0x34,
    0xbc, 0x20, 0x1f, 0x4f, 0x80,
    /* U+0178 "Ÿ" */
    0x2, 0x8d, 0x0, 0x14, 0x40, 0x1c, 0x1, 0x81,
    0xc0, 0x3c, 0x8c, 0x3, 0x84, 0xc0, 0x38, 0xc,
    0x3, 0x41, 0xc0, 0x70, 0x1c, 0x7, 0x1, 0xc0,
    0xb0, 0x1c, 0xf, 0x1, 0xc2, 0xb4, 0xc, 0x4b,
    0x0, 0xb5, 0xe0, 0x0, 0x6a, 0x0, 0xc, 0xe0,
    0x2, 0x4e, 0x0, 0x30, 0xd0, 0x3, 0xc, 0x0,
    0x2f, 0x40
};
/*---------------------
 *  GLYPH DESCRIPTION
 *--------------------*/
static const lv_font_fmt_txt_glyph_dsc_t cursive_glyph_dsc[] = {
    {.bitmap_index = 0, .adv_w = 0, .box_w = 0, .box_h = 0, .ofs_x = 0, .ofs_y = 0} /* id = 0 reserved */,
    {.bitmap_index = 0, .adv_w = 57, .box_w = 0, .box_h = 0, .ofs_x = 0, .ofs_y = 0},
    {.bitmap_index = 0, .adv_w = 73, .box_w = 3, .box_h = 12, .ofs_x = 1, .ofs_y = 0},
    {.bitmap_index = 9, .adv_w = 71, .box_w = 4, .box_h = 4, .ofs_x = 0, .ofs_y = 8},
    {.bitmap_index = 13, .adv_w = 165, .box_w = 10, .box_h = 12, .ofs_x = 0, .ofs_y = 0},
    {.bitmap_index = 43, .adv_w = 139, .box_w = 8, .box_h = 13, .ofs_x = 0, .ofs_y = -1},
    {.bitmap_index = 69, .adv_w = 150, .box_w = 9, .box_h = 11, .ofs_x = 0, .ofs_y = 0},
    {.bitmap_index = 94, .adv_w = 153, .box_w = 11, .box_h = 13, .ofs_x = 0, .ofs_y = -1},
    {.bitmap_index = 130, .adv_w = 37, .box_w = 2, .box_h = 4, .ofs_x = 0, .ofs_y = 8},
    {.bitmap_index = 132, .adv_w = 79, .box_w = 4, .box_h = 14, .ofs_x = 1, .ofs_y = -2},
    {.bitmap_index = 146, .adv_w = 74, .box_w = 4, .box_h = 14, .ofs_x = 0, .ofs_y = -2},
    {.bitmap_index = 160, .adv_w = 107, .box_w = 7, .box_h = 7, .ofs_x = 0, .ofs_y = 6},
    {.bitmap_index = 173, .adv_w = 116, .box_w = 7, .box_h = 7, .ofs_x = 0, .ofs_y = 1},
    {.bitmap_index = 186, .adv_w = 44, .box_w = 3, .box_h = 4, .ofs_x = 0, .ofs_y = -2},
    {.bitmap_index = 189, .adv_w = 83, .box_w = 6, .box_h = 3, .ofs_x = -1, .ofs_y = 3},
    {.bitmap_index = 194, .adv_w = 51, .box_w = 3, .box_h = 2, .ofs_x = 0, .ofs_y = 0},
    {.bitmap_index = 196, .adv_w = 79, .box_w = 6, .box_h = 14, .ofs_x = -1, .ofs_y = -2},
    {.bitmap_index = 217, .adv_w = 134, .box_w = 8, .box_h = 11, .ofs_x = 0, .ofs_y = 0},
    {.bitmap_index = 239, .adv_w = 90, .box_w = 5, .box_h = 11, .ofs_x = 0, .ofs_y = 0},
    {.bitmap_index = 253, .adv_w = 120, .box_w = 8, .box_h = 11, .ofs_x = 0, .ofs_y = 0},
    {.bitmap_index = 275, .adv_w = 116, .box_w = 7, .box_h = 12, .ofs_x = 0, .ofs_y = 0},
    {.bitmap_index = 296, .adv_w = 127, .box_w = 8, .box_h = 12, .ofs_x = 0, .ofs_y = 0},
    {.bitmap_index = 320, .adv_w = 113, .box_w = 7, .box_h = 12, .ofs_x = 0, .ofs_y = 0},
    {.bitmap_index = 341, .adv_w = 129, .box_w = 8, .box_h = 11, .ofs_x = 0, .ofs_y = 0},
    {.bitmap_index = 363, .adv_w = 102, .box_w = 7, .box_h = 11, .ofs_x = 0, .ofs_y = 0},
    {.bitmap_index = 383, .adv_w = 117, .box_w = 7, .box_h = 11, .ofs_x = 0, .ofs_y = 0},
    {.bitmap_index = 403, .adv_w = 123, .box_w = 7, .box_h = 11, .ofs_x = 0, .ofs_y = 0},
    {.bitmap_index = 423, .adv_w = 59, .box_w = 2, .box_h = 7, .ofs_x = 1, .ofs_y = 0},
    {.bitmap_index = 427, .adv_w = 58, .box_w = 3, .box_h = 10, .ofs_x = 0, .ofs_y = -3},
    {.bitmap_index = 435, .adv_w = 128, .box_w = 8, .box_h = 7, .ofs_x = 0, .ofs_y = 2},
    {.bitmap_index = 449, .adv_w = 147, .box_w = 7, .box_h = 5, .ofs_x = 1, .ofs_y = 2},
    {.bitmap_index = 458, .adv_w = 130, .box_w = 8, .box_h = 7, .ofs_x = 0, .ofs_y = 2},
    {.bitmap_index = 472, .adv_w = 111, .box_w = 7, .box_h = 11, .ofs_x = 0, .ofs_y = 0},
    {.bitmap_index = 492, .adv_w = 209, .box_w = 13, .box_h = 14, .ofs_x = 0, .ofs_y = -4},
    {.bitmap_index = 538, .adv_w = 144, .box_w = 10, .box_h = 12, .ofs_x = 0, .ofs_y = 0},
    {.bitmap_index = 568, .adv_w = 146, .box_w = 9, .box_h = 12, .ofs_x = 0, .ofs_y = 0},
    {.bitmap_index = 595, .adv_w = 119, .box_w = 9, .box_h = 12, .ofs_x = 0, .ofs_y = 0},
    {.bitmap_index = 622, .adv_w = 188, .box_w = 11, .box_h = 13, .ofs_x = 0, .ofs_y = 0},
    {.bitmap_index = 658, .adv_w = 126, .box_w = 9, .box_h = 12, .ofs_x = 0, .ofs_y = 0},
    {.bitmap_index = 685, .adv_w = 118, .box_w = 9, .box_h = 12, .ofs_x = 0, .ofs_y = 0},
    {.bitmap_index = 712, .adv_w = 159, .box_w = 11, .box_h = 12, .ofs_x = 0, .ofs_y = 0},
    {.bitmap_index = 745, .adv_w = 158, .box_w = 11, .box_h = 13, .ofs_x = 0, .ofs_y = 0},
    {.bitmap_index = 781, .adv_w = 124, .box_w = 8, .box_h = 12, .ofs_x = 0, .ofs_y = 0},
    {.bitmap_index = 805, .adv_w = 120, .box_w = 9, .box_h = 18, .ofs_x = 0, .ofs_y = -6},
    {.bitmap_index = 846, .adv_w = 188, .box_w = 12, .box_h = 14, .ofs_x = 0, .ofs_y = -2},
    {.bitmap_index = 888, .adv_w = 139, .box_w = 9, .box_h = 12, .ofs_x = 0, .ofs_y = 0},
    {.bitmap_index = 915, .adv_w = 187, .box_w = 13, .box_h = 13, .ofs_x = 0, .ofs_y = 0},
    {.bitmap_index = 958, .adv_w = 143, .box_w = 11, .box_h = 12, .ofs_x = 0, .ofs_y = 0},
    {.bitmap_index = 991, .adv_w = 169, .box_w = 12, .box_h = 12, .ofs_x = 0, .ofs_y = 0},
    {.bitmap_index = 1027, .adv_w = 159, .box_w = 10, .box_h = 14, .ofs_x = 0, .ofs_y = 0},
    {.bitmap_index = 1062, .adv_w = 173, .box_w = 10, .box_h = 14, .ofs_x = 0, .ofs_y = -2},
    {.bitmap_index = 1097, .adv_w = 168, .box_w = 11, .box_h = 16, .ofs_x = 0, .ofs_y = -2},
    {.bitmap_index = 1141, .adv_w = 138, .box_w = 8, .box_h = 12, .ofs_x = 0, .ofs_y = 0},
    {.bitmap_index = 1165, .adv_w = 121, .box_w = 12, .box_h = 12, .ofs_x = 0, .ofs_y = 0},
    {.bitmap_index = 1201, .adv_w = 147, .box_w = 11, .box_h = 12, .ofs_x = 0, .ofs_y = 0},
    {.bitmap_index = 1234, .adv_w = 146, .box_w = 9, .box_h = 14, .ofs_x = 0, .ofs_y = 0},
    {.bitmap_index = 1266, .adv_w = 198, .box_w = 12, .box_h = 12, .ofs_x = 0, .ofs_y = 0},
    {.bitmap_index = 1302, .adv_w = 151, .box_w = 11, .box_h = 12, .ofs_x = 0, .ofs_y = 0},
    {.bitmap_index = 1335, .adv_w = 149, .box_w = 10, .box_h = 18, .ofs_x = 0, .ofs_y = -6},
    {.bitmap_index = 1380, .adv_w = 144, .box_w = 11, .box_h = 12, .ofs_x = 0, .ofs_y = 0},
    {.bitmap_index = 1413, .adv_w = 107, .box_w = 6, .box_h = 14, .ofs_x = 1, .ofs_y = -2},
    {.bitmap_index = 1434, .adv_w = 79, .box_w = 6, .box_h = 14, .ofs_x = 0, .ofs_y = -2},
    {.bitmap_index = 1455, .adv_w = 97, .box_w = 5, .box_h = 14, .ofs_x = 0, .ofs_y = -2},
    {.bitmap_index = 1473, .adv_w = 154, .box_w = 7, .box_h = 5, .ofs_x = 1, .ofs_y = 8},
    {.bitmap_index = 1482, .adv_w = 132, .box_w = 9, .box_h = 2, .ofs_x = -1, .ofs_y = -2},
    {.bitmap_index = 1487, .adv_w = 110, .box_w = 8, .box_h = 7, .ofs_x = 0, .ofs_y = 0},
    {.bitmap_index = 1501, .adv_w = 103, .box_w = 8, .box_h = 12, .ofs_x = 0, .ofs_y = 0},
    {.bitmap_index = 1525, .adv_w = 82, .box_w = 7, .box_h = 7, .ofs_x = 0, .ofs_y = 0},
    {.bitmap_index = 1538, .adv_w = 113, .box_w = 9, .box_h = 12, .ofs_x = 0, .ofs_y = 0},
    {.bitmap_index = 1565, .adv_w = 84, .box_w = 7, .box_h = 7, .ofs_x = 0, .ofs_y = 0},
    {.bitmap_index = 1578, .adv_w = 65, .box_w = 7, .box_h = 18, .ofs_x = -1, .ofs_y = -6},
    {.bitmap_index = 1610, .adv_w = 107, .box_w = 8, .box_h = 13, .ofs_x = 0, .ofs_y = -6},
    {.bitmap_index = 1636, .adv_w = 107, .box_w = 8, .box_h = 12, .ofs_x = 0, .ofs_y = 0},
    {.bitmap_index = 1660, .adv_w = 50, .box_w = 5, .box_h = 11, .ofs_x = 0, .ofs_y = 0},
    {.bitmap_index = 1674, .adv_w = 48, .box_w = 7, .box_h = 17, .ofs_x = -3, .ofs_y = -6},
    {.bitmap_index = 1704, .adv_w = 99, .box_w = 7, .box_h = 13, .ofs_x = 0, .ofs_y = -1},
    {.bitmap_index = 1727, .adv_w = 50, .box_w = 5, .box_h = 12, .ofs_x = 0, .ofs_y = 0},
    {.bitmap_index = 1742, .adv_w = 156, .box_w = 11, .box_h = 7, .ofs_x = 0, .ofs_y = 0},
    {.bitmap_index = 1762, .adv_w = 107, .box_w = 9, .box_h = 7, .ofs_x = -1, .ofs_y = 0},
    {.bitmap_index = 1778, .adv_w = 105, .box_w = 8, .box_h = 7, .ofs_x = 0, .ofs_y = 0},
    {.bitmap_index = 1792, .adv_w = 104, .box_w = 7, .box_h = 13, .ofs_x = -1, .ofs_y = -6},
    {.bitmap_index = 1815, .adv_w = 109, .box_w = 8, .box_h = 13, .ofs_x = 0, .ofs_y = -6},
    {.bitmap_index = 1841, .adv_w = 73, .box_w = 6, .box_h = 7, .ofs_x = 0, .ofs_y = 0},
    {.bitmap_index = 1852, .adv_w = 60, .box_w = 5, .box_h = 7, .ofs_x = 0, .ofs_y = 0},
    {.bitmap_index = 1861, .adv_w = 58, .box_w = 6, .box_h = 11, .ofs_x = -1, .ofs_y = 0},
    {.bitmap_index = 1878, .adv_w = 105, .box_w = 8, .box_h = 7, .ofs_x = 0, .ofs_y = 0},
    {.bitmap_index = 1892, .adv_w = 101, .box_w = 8, .box_h = 7, .ofs_x = 0, .ofs_y = 0},
    {.bitmap_index = 1906, .adv_w = 134, .box_w = 10, .box_h = 7, .ofs_x = 0, .ofs_y = 0},
    {.bitmap_index = 1924, .adv_w = 91, .box_w = 8, .box_h = 7, .ofs_x = -1, .ofs_y = 0},
    {.bitmap_index = 1938, .adv_w = 101, .box_w = 8, .box_h = 13, .ofs_x = 0, .ofs_y = -6},
    {.bitmap_index = 1964, .adv_w = 98, .box_w = 7, .box_h = 7, .ofs_x = 0, .ofs_y = 0},
    {.bitmap_index = 1977, .adv_w = 85, .box_w = 5, .box_h = 14, .ofs_x = 0, .ofs_y = -2},
    {.bitmap_index = 1995, .adv_w = 55, .box_w = 3, .box_h = 15, .ofs_x = 0, .ofs_y = -3},
    {.bitmap_index = 2007, .adv_w = 79, .box_w = 5, .box_h = 14, .ofs_x = 0, .ofs_y = -2},
    {.bitmap_index = 2025, .adv_w = 131, .box_w = 8, .box_h = 3, .ofs_x = 0, .ofs_y = 3},
    {.bitmap_index = 2031, .adv_w = 144, .box_w = 10, .box_h = 15, .ofs_x = 0, .ofs_y = 0},
    {.bitmap_index = 2069, .adv_w = 144, .box_w = 10, .box_h = 15, .ofs_x = 0, .ofs_y = 0},
    {.bitmap_index = 2107, .adv_w = 144, .box_w = 10, .box_h = 14, .ofs_x = 0, .ofs_y = 0},
    {.bitmap_index = 2142, .adv_w = 211, .box_w = 15, .box_h = 13, .ofs_x = 0, .ofs_y = -1},
    {.bitmap_index = 2191, .adv_w = 119, .box_w = 9, .box_h = 15, .ofs_x = 0, .ofs_y = -3},
    {.bitmap_index = 2225, .adv_w = 127, .box_w = 9, .box_h = 15, .ofs_x = 0, .ofs_y = 0},
    {.bitmap_index = 2259, .adv_w = 127, .box_w = 9, .box_h = 16, .ofs_x = 0, .ofs_y = 0},
    {.bitmap_index = 2295, .adv_w = 127, .box_w = 9, .box_h = 15, .ofs_x = 0, .ofs_y = 0},
    {.bitmap_index = 2329, .adv_w = 127, .box_w = 9, .box_h = 15, .ofs_x = 0, .ofs_y = 0},
    {.bitmap_index = 2363, .adv_w = 124, .box_w = 8, .box_h = 15, .ofs_x = 0, .ofs_y = 0},
    {.bitmap_index = 2393, .adv_w = 124, .box_w = 8, .box_h = 15, .ofs_x = 0, .ofs_y = 0},
    {.bitmap_index = 2423, .adv_w = 169, .box_w = 12, .box_h = 15, .ofs_x = 0, .ofs_y = 0},
    {.bitmap_index = 2468, .adv_w = 170, .box_w = 12, .box_h = 15, .ofs_x = 0, .ofs_y = 0},
    {.bitmap_index = 2513, .adv_w = 149, .box_w = 11, .box_h = 15, .ofs_x = 0, .ofs_y = 0},
    {.bitmap_index = 2555, .adv_w = 149, .box_w = 11, .box_h = 14, .ofs_x = 0, .ofs_y = 0},
    {.bitmap_index = 2594, .adv_w = 110, .box_w = 8, .box_h = 11, .ofs_x = 0, .ofs_y = 0},
    {.bitmap_index = 2616, .adv_w = 110, .box_w = 8, .box_h = 11, .ofs_x = 0, .ofs_y = 0},
    {.bitmap_index = 2638, .adv_w = 110, .box_w = 8, .box_h = 10, .ofs_x = 0, .ofs_y = 0},
    {.bitmap_index = 2658, .adv_w = 138, .box_w = 10, .box_h = 7, .ofs_x = 0, .ofs_y = 0},
    {.bitmap_index = 2676, .adv_w = 82, .box_w = 7, .box_h = 10, .ofs_x = 0, .ofs_y = -3},
    {.bitmap_index = 2694, .adv_w = 84, .box_w = 7, .box_h = 11, .ofs_x = 0, .ofs_y = 0},
    {.bitmap_index = 2714, .adv_w = 84, .box_w = 7, .box_h = 11, .ofs_x = 0, .ofs_y = 0},
    {.bitmap_index = 2734, .adv_w = 84, .box_w = 7, .box_h = 11, .ofs_x = 0, .ofs_y = 0},
    {.bitmap_index = 2754, .adv_w = 84, .box_w = 7, .box_h = 10, .ofs_x = 0, .ofs_y = 0},
    {.bitmap_index = 2772, .adv_w = 50, .box_w = 6, .box_h = 11, .ofs_x = -1, .ofs_y = 0},
    {.bitmap_index = 2789, .adv_w = 50, .box_w = 6, .box_h = 10, .ofs_x = -1, .ofs_y = 0},
    {.bitmap_index = 2804, .adv_w = 105, .box_w = 8, .box_h = 11, .ofs_x = 0, .ofs_y = 0},
    {.bitmap_index = 2826, .adv_w = 105, .box_w = 8, .box_h = 10, .ofs_x = 0, .ofs_y = 0},
    {.bitmap_index = 2846, .adv_w = 105, .box_w = 8, .box_h = 11, .ofs_x = 0, .ofs_y = 0},
    {.bitmap_index = 2868, .adv_w = 105, .box_w = 8, .box_h = 10, .ofs_x = 0, .ofs_y = 0},
    {.bitmap_index = 2888, .adv_w = 101, .box_w = 8, .box_h = 17, .ofs_x = 0, .ofs_y = -6},
    {.bitmap_index = 2922, .adv_w = 258, .box_w = 18, .box_h = 12, .ofs_x = 0, .ofs_y = 0},
    {.bitmap_index = 2976, .adv_w = 148, .box_w = 12, .box_h = 7, .ofs_x = -1, .ofs_y = 0},
    {.bitmap_index = 2997, .adv_w = 149, .box_w = 10, .box_h = 20, .ofs_x = 0, .ofs_y = -6}
};
/*---------------------
 *  CHARACTER MAPPING
 *--------------------*/
static const uint16_t cursive_unicode_list_2[] = {
    0x0, 0x2, 0x4, 0x6, 0x7, 0x8, 0x9, 0xa,
    0xb, 0xe, 0xf, 0x14, 0x16, 0x1b, 0x1c, 0x20,
    0x22, 0x24, 0x26, 0x27, 0x28, 0x29, 0x2a, 0x2b,
    0x2e, 0x2f, 0x34, 0x36, 0x3b, 0x3c, 0x3f, 0x92,
    0x93, 0xb8
};
/*Collect the unicode lists and glyph_id offsets*/
static const lv_font_fmt_txt_cmap_t cursive_cmaps[] =
{
    {
        .range_start = 32, .range_length = 64, .glyph_id_start = 1,
        .unicode_list = NULL, .glyph_id_ofs_list = NULL, .list_length = 0, .type = LV_FONT_FMT_TXT_CMAP_FORMAT0_TINY
    },
    {
        .range_start = 97, .range_length = 30, .glyph_id_start = 65,
        .unicode_list = NULL, .glyph_id_ofs_list = NULL, .list_length = 0, .type = LV_FONT_FMT_TXT_CMAP_FORMAT0_TINY
    },
    {
        .range_start = 192, .range_length = 185, .glyph_id_start = 95,
        .unicode_list = cursive_unicode_list_2, .glyph_id_ofs_list = NULL, .list_length = 34, .type = LV_FONT_FMT_TXT_CMAP_SPARSE_TINY
    }
};
/*--------------------
 *  ALL CUSTOM DATA
 *--------------------*/
/*Store all the custom data of the font*/
static lv_font_fmt_txt_glyph_cache_t cursive_cache;
static const lv_font_fmt_txt_dsc_t cursive_font_dsc = {
    .glyph_bitmap = cursive_glyph_bitmap,
    .glyph_dsc = cursive_glyph_dsc,
    .cmaps = cursive_cmaps,
    .kern_dsc = NULL,
    .kern_scale = 0,
    .cmap_num = 3,
    .bpp = 2,
    .kern_classes = 0,
    .bitmap_format = 0,
    .cache = &cursive_cache
};
/*-----------------
 *  PUBLIC FONT
 *----------------*/
/*Initialize a public general font descriptor*/
const lv_font_t cursive = {
    .get_glyph_dsc = lv_font_get_glyph_dsc_fmt_txt,    /*Function pointer to get glyph's data*/
    .get_glyph_bitmap = lv_font_get_bitmap_fmt_txt,    /*Function pointer to get glyph's bitmap*/
    .line_height = 22,          /*The maximum line height required by the font*/
    .base_line = 6,             /*Baseline measured from the bottom of the line*/

    .subpx = LV_FONT_SUBPX_NONE,
    .underline_position = -1,
    .underline_thickness = 1,
    .dsc = &cursive_font_dsc,          /*The custom font data. Will be accessed by `get_glyph_bitmap/dsc` */
};
#endif

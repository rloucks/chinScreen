/*******************************************************************************
 * Size: 24 px
 * Bpp: 2
 ******************************************************************************/


#ifdef __has_include

    #if __has_include("lvgl.h")
         #ifndef LV_LVGL_H_INCLUDE_SIMPLE
             #define LV_LVGL_H_INCLUDE_SIMPLE
         #endif
     #endif
 #endif

 #ifdef LV_LVGL_H_INCLUDE_SIMPLE
     #include "lvgl.h"
 #else
     #include "../lvgl-8.3.11/lvgl.h"
 #endif

 #ifndef BITJI_24
 #define BITJI_24 1
 #endif

 #if BITJI_24

/*-----------------
 *    BITMAPS
 *----------------*/
/*Store the image of the glyphs*/
static LV_ATTRIBUTE_LARGE_CONST const uint8_t bitji_24_glyph_bitmap[] = {
    /* U+0020 " " */
    /* U+0021 "!" */
    /* U+0022 "\"" */
    /* U+0023 "#" */
    /* U+0024 "$" */
    /* U+0025 "%" */
    /* U+0026 "&" */
    /* U+0027 "'" */
    /* U+0028 "(" */
    /* U+0029 ")" */
    /* U+002A "*" */
    /* U+002B "+" */
    /* U+002C "," */
    /* U+002D "-" */
    /* U+002E "." */
    /* U+002F "/" */
    /* U+0030 "0" */
    /* U+0031 "1" */
    /* U+0032 "2" */
    /* U+0033 "3" */
    /* U+0034 "4" */
    /* U+0035 "5" */
    /* U+0036 "6" */
    /* U+0037 "7" */
    /* U+0038 "8" */
    /* U+0039 "9" */
    /* U+003A ":" */
    /* U+003B ";" */
    /* U+003C "<" */
    /* U+003D "=" */
    /* U+003E ">" */
    /* U+003F "?" */
    /* U+0040 "@" */
    /* U+0041 "A" */
    0x1a, 0xa9, 0x0, 0x2, 0xaa, 0x80, 0xbf, 0xf8,
    0x0, 0xf, 0xff, 0xf, 0xc0, 0xff, 0xff, 0xf8,
    0x2f, 0xbe, 0x2, 0xff, 0xbf, 0x90, 0x6e, 0xe0,
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    0xaf, 0x92, 0xff, 0xe0, 0x0, 0x3f, 0xfc, 0x0,
    /* U+0042 "B" */
    0x1a, 0xa9, 0x2a, 0xa8, 0xb, 0xff, 0x8f, 0xff,
    0xf, 0xc0, 0xff, 0x82, 0xfb, 0xe0, 0x2f, 0x90,
    0x6e, 0xe0, 0x2, 0xc0, 0x3, 0xb8, 0x0, 0xb0,
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    0x3, 0xfe, 0x0, 0x0,
    /* U+0043 "C" */
    0x2f, 0xf0, 0xb, 0xfc, 0xb, 0xfc, 0x2, 0xff,
    0xf, 0xff, 0xe3, 0xff, 0xfb, 0xff, 0xf8, 0xfc,
    0xbe, 0xff, 0xfe, 0x7f, 0x1f, 0xbf, 0xff, 0xfe,
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    0x3, 0xfe, 0x0, 0x0,
    /* U+0044 "D" */
    0x0, 0xb0, 0x0, 0x0, 0x2, 0xc0, 0x0, 0x0,
    0xb, 0x0, 0x0, 0x0, 0x92, 0x40, 0x0, 0x3,
    0x8e, 0x0, 0x3, 0xf0, 0xb, 0xe0, 0xa, 0xa4,
    0xaa, 0x40, 0x0, 0xe3, 0x80, 0x0, 0x0, 0xb0,
    0x0, 0x0, 0x2, 0xc0, 0x2, 0x40, 0xb, 0x0,
    0xe, 0x0, 0x0, 0x2, 0xcb, 0x0, 0x0, 0x6,
    0xa8, 0x0, 0x0, 0x3, 0x80,
    /* U+0045 "E" */
    0x2f, 0x80, 0x0, 0xfc, 0x2a, 0xa8, 0x1, 0xaa,
    0x9e, 0xb, 0x0, 0xb0, 0x3b, 0x82, 0xff, 0xfc,
    0xe, 0xaa, 0xaa, 0xaa, 0xaa, 0x4b, 0xe0, 0x0,
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    0xaa, 0xaa, 0xa4, 0x0, 0xb, 0xff, 0xf0, 0x0,
    /* U+0046 "F" */
    0x0, 0xf, 0xf8, 0x0, 0x0, 0x1b, 0xef, 0x80,
    0x0, 0xb, 0xe3, 0xf0, 0x3, 0xff, 0xc0, 0x2f,
    0xfe, 0xfa, 0xa0, 0x6, 0xab, 0xb8, 0x0, 0x0,
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    0xab, 0xef, 0xaf, 0x2, 0xff, 0xe3, 0xff, 0xc0,
    /* U+0047 "G" */
    0x0, 0xf, 0xc0, 0x0, 0x0, 0x3f, 0x0, 0x0,
    0xb, 0xff, 0x80, 0x3f, 0xff, 0xff, 0xff, 0xfe,
    0xff, 0xff, 0xff, 0xf2, 0xff, 0xff, 0xf2, 0xff,
    0x2f, 0xfe, 0xb, 0xfc, 0xbf, 0xf8, 0x3, 0x80,
    0x3f, 0x0, 0x6f, 0x86, 0xfe, 0x42, 0xff, 0x2f,
    0xfe, 0xb, 0xff, 0xff, 0xf8, 0x2f, 0xfa, 0xbf,
    0xe0, 0xbf, 0xc0, 0xff, 0x80,
    /* U+0048 "H" */
    0x0, 0xf, 0xff, 0x0, 0x0, 0x0, 0xff, 0xf0,
    0x0, 0x0, 0xf, 0xff, 0xfc, 0x0, 0x0, 0xff,
    0xff, 0xe4, 0x0, 0xb, 0xff, 0xff, 0x80, 0x0,
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    0x3, 0xfe, 0x0, 0x0, 0x0,
    /* U+0049 "I" */
    0x0, 0xf, 0xff, 0xe0, 0x0, 0x0, 0xba, 0xaa,
    0xbc, 0x0, 0x3, 0xe0, 0x0, 0x1b, 0x80, 0x3,
    0x80, 0x0, 0x3, 0x80, 0x3, 0x80, 0x0, 0x3,
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    0xbc, 0x0, 0x0, 0xf, 0xc0, 0xfc, 0x0,
    /* U+004A "J" */
    0x0, 0xb, 0xff, 0x80, 0x0, 0x0, 0x0, 0xfa,
    0xab, 0xff, 0xfc, 0x0, 0x2, 0x40, 0x6, 0xfa,
    0xa0, 0x0, 0xb0, 0x0, 0x3, 0x80, 0x38, 0x2,
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    0x0, 0x0,
    /* U+004B "K" */
    0x0, 0xb, 0xff, 0x80, 0x0, 0x0, 0x0, 0xff,
    0xff, 0xcb, 0xfc, 0x0, 0x3, 0xff, 0xff, 0x2f,
    0xf0, 0x0, 0xbf, 0xff, 0xfc, 0xbf, 0xf8, 0x2,
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    0x0, 0x0,
    /* U+004C "L" */
    0xff, 0xff, 0xff, 0xff, 0xfe, 0x3e, 0xbe, 0xaa,
    0xaf, 0xab, 0x8e, 0x2a, 0x90, 0xa, 0xa4, 0xe3,
    0x8e, 0x38, 0x3, 0x8e, 0x38, 0xff, 0xff, 0xff,
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    0x92, 0x40, 0x0, 0x3, 0x80, 0x38, 0x0,
    /* U+004D "M" */
    0x0, 0x0, 0x0, 0x92, 0x40, 0x0, 0x0, 0x38,
    0xe0, 0x0, 0x0, 0x2, 0xc0, 0x1, 0x80, 0x2,
    0xa9, 0x0, 0xb0, 0x0, 0xe3, 0x80, 0x0, 0x0,
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    0x2c, 0x0, 0x0, 0x0,
    /* U+004E "N" */
    0x61, 0x80, 0x0, 0x0, 0x2c, 0xb0, 0x0, 0x0,
    0x0, 0xe0, 0x0, 0x0, 0x1, 0xaa, 0x0, 0x9,
    0x0, 0xb2, 0xc0, 0x3, 0x80, 0x0, 0x0, 0x0,
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    0x0, 0x0, 0xe0, 0x0,
    /* U+004F "O" */
    0x3, 0xfe, 0x0, 0xff, 0x80, 0x1b, 0xea, 0x86,
    0xab, 0xe0, 0x2f, 0x82, 0xcb, 0x3, 0xf0, 0xe0,
    0xb0, 0x38, 0x2c, 0xe, 0xe0, 0xb0, 0x38, 0x2c,
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    0x0, 0x24, 0x0, 0x0,
    /* U+0050 "P" */
    0x2f, 0x80, 0x3f, 0x0, 0xbe, 0x38, 0x2c, 0xb0,
    0x38, 0xe0, 0xbe, 0xb, 0x2c, 0xe, 0x38, 0x2f,
    0x82, 0xcb, 0x3, 0x8e, 0xb, 0x1a, 0x40, 0x2a,
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    0x0, 0x0, 0x0, 0xe, 0x0, 0x0, 0x0,
    /* U+0051 "Q" */
    0x3, 0x80, 0x0, 0x0, 0xa, 0xbe, 0x90, 0x0,
    0x0, 0xff, 0xfe, 0x0, 0x0, 0x2, 0xff, 0x0,
    0x0, 0x0, 0x2e, 0xf0, 0x0, 0x0, 0x2, 0xcb,
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    0x0, 0x3f, 0xff, 0x80,
    /* U+0052 "R" */
    0x0, 0xe, 0x38, 0x0, 0x38, 0xe0, 0x0, 0xff,
    0x80, 0x0, 0xb0, 0x0, 0x2, 0xc0, 0x0, 0x0,
    0x2, 0xcb, 0x0, 0xb, 0x2c, 0x0, 0xff, 0xfe,
    0x3, 0xff, 0xf8, 0xf, 0xff, 0xe0, 0xb, 0xfc,
    0x0, 0x3, 0x80, 0x0, 0xe, 0x0, 0x0,
    /* U+0053 "S" */
    0x0, 0x0, 0x3f, 0xff, 0x80, 0xe3, 0x82, 0xea,
    0xaa, 0xf0, 0xe3, 0x81, 0x80, 0x0, 0x60, 0xff,
    0x8e, 0xb, 0xfc, 0xe, 0xbe, 0x4e, 0x2a, 0xaa,
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    0x2a, 0x0, 0x0, 0x2f, 0x80, 0x0, 0x0, 0x0,
    /* U+0054 "T" */
    0x0, 0xbf, 0xcb, 0xfc, 0x0, 0x3, 0xff, 0xff,
    0xff, 0x80, 0x1b, 0xff, 0xff, 0xff, 0xe0, 0x2f,
    0xff, 0xff, 0xff, 0xf0, 0xbf, 0x80, 0x0, 0x0,
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    0xf, 0xff, 0xe0, 0x0,
    /* U+0055 "U" */
    0x0, 0x0, 0x3f, 0xff, 0xff, 0xc0, 0x0, 0xa,
    0xaa, 0xaa, 0xf0, 0x0, 0xfc, 0x0, 0x0, 0x2c,
    0x1, 0xaa, 0x2, 0x49, 0xb, 0x0, 0xb0, 0x0,
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    0x0, 0x0, 0x0, 0x0,
    /* U+0056 "V" */
    0x2f, 0x8e, 0x3f, 0xf, 0xff, 0xff, 0xfe, 0xff,
    0xff, 0xff, 0xef, 0xff, 0xff, 0xfe, 0xff, 0xff,
    0xff, 0xef, 0xff, 0xff, 0xfe, 0xff, 0xff, 0xff,
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    0x1a, 0xa1, 0xaa, 0x2, 0xff, 0x2f, 0xf0,
    /* U+0057 "W" */
    0x0, 0xe, 0x0, 0xe0, 0x0, 0x0, 0xb, 0xcb,
    0x90, 0x0, 0x5, 0x52, 0xcb, 0x5, 0x50, 0x2f,
    0xf2, 0xcb, 0x2f, 0xf0, 0xbf, 0xfb, 0xcb, 0xbf,
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    0xfc, 0x0,
    /* U+0058 "X" */
    0x0, 0x2, 0xf8, 0x0, 0x0, 0x3f, 0xfa, 0xff,
    0xc0, 0x1a, 0xae, 0xb, 0xaa, 0x42, 0xc0, 0xe0,
    0xb0, 0x38, 0x2c, 0xf, 0xff, 0x3, 0x82, 0xc0,
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    0x0,
    /* U+0059 "Y" */
    0x0, 0xf, 0xff, 0xe0, 0x0, 0x3f, 0xaa, 0xab,
    0xc0, 0x2, 0xa0, 0x0, 0x18, 0x2, 0xc0, 0x0,
    0x0, 0x38, 0x2c, 0x0, 0x2a, 0x92, 0xa2, 0xc0,
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    0xa9, 0x0,
    /* U+005A "Z" */
    0x0, 0x2, 0xc0, 0x0, 0x6, 0x0, 0xb0, 0x6,
    0x2, 0xc0, 0x2c, 0x2, 0xc0, 0x9, 0x0, 0x2,
    0x40, 0x3, 0x80, 0x0, 0xe0, 0x0, 0x3, 0xfe,
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    0x0,
    /* U+005B "[" */
    /* U+005C "\\" */
    /* U+005D "]" */
    /* U+005E "^" */
    /* U+005F "_" */
    /* U+0061 "a" */
    0x0, 0x0, 0x0, 0xff, 0x80, 0x0, 0x0, 0xb,
    0xaa, 0xf0, 0x0, 0x0, 0x6, 0x0, 0xb0, 0x0,
    0x0, 0x38, 0x0, 0xb0, 0x0, 0x0, 0x3e, 0xaa,
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    0xff, 0xfa, 0x40, 0x0, 0xf, 0xff, 0xe0, 0x0,
    /* U+0062 "b" */
    0x0, 0x2, 0xc0, 0x0, 0xe, 0x0, 0x0, 0xb0,
    0x0, 0x3, 0x80, 0x0, 0x2c, 0x0, 0x0, 0xe0,
    0x0, 0x3f, 0xfc, 0x2, 0xcb, 0x0, 0x6a, 0xaa,
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    0x0,
    /* U+0063 "c" */
    0x0, 0x0, 0x38, 0x0, 0x0, 0x0, 0xf, 0xff,
    0xe0, 0x0, 0x0, 0xa, 0xaa, 0x90, 0x0, 0x3,
    0xf0, 0x0, 0x2f, 0x80, 0x2c, 0x0, 0x0, 0x0,
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    0x0,
    /* U+0064 "d" */
    0x0, 0x0, 0x38, 0x0, 0x0, 0x3, 0x80, 0x38,
    0x3, 0x80, 0x3, 0x80, 0x38, 0x3, 0x80, 0x0,
    0xb0, 0x0, 0x2c, 0x0, 0x0, 0x61, 0xaa, 0x18,
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    0x0, 0x24, 0x0, 0x0,
    /* U+0065 "e" */
    0x0, 0x0, 0x3f, 0x0, 0x0, 0x0, 0x2f, 0xfa,
    0xbf, 0xe0, 0x0, 0x2a, 0xbc, 0xf, 0xaa, 0x0,
    0xe, 0xb, 0x3, 0x82, 0xc0, 0x1b, 0x81, 0x80,
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    0x0,
    /* U+0066 "f" */
    0x2c, 0x0, 0x0, 0x0, 0x0, 0x3e, 0xe0, 0xbf,
    0xf8, 0x0, 0x9, 0x24, 0x1a, 0xa9, 0x0, 0x0,
    0xb0, 0x38, 0x0, 0xb0, 0x0, 0x18, 0x69, 0x0,
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    0x0, 0x0, 0x3f, 0xff, 0xf0, 0x0,
    /* U+0067 "g" */
    0x3, 0x80, 0x0, 0x3, 0x80, 0x38, 0xe3, 0x80,
    0xb, 0xbc, 0x9, 0x38, 0x90, 0x1, 0x86, 0x0,
    0xbf, 0xc0, 0x0, 0xe, 0x0, 0xab, 0xe9, 0x0,
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    0x24, 0x0, 0x0, 0x0, 0xe3, 0x80, 0x0,
    /* U+0068 "h" */
    0x18, 0x1, 0xaa, 0x0, 0x60, 0x2c, 0x2, 0xff,
    0x0, 0xb0, 0xe3, 0x8f, 0xcb, 0xe3, 0x8e, 0xe2,
    0xaf, 0xef, 0xfa, 0x4e, 0xe0, 0xbf, 0xff, 0xfc,
    0xe, 0x2c, 0xb2, 0xff, 0x2c, 0xb0, 0xa8, 0xbb,
    0xff, 0xbc, 0x69, 0xe0, 0xbf, 0xff, 0xfc, 0xe,
    0xe3, 0x8f, 0xcb, 0xe3, 0x8e, 0xaa, 0x4b, 0xef,
    0x92, 0xa9, 0x2c, 0x2, 0xff, 0x0, 0xb0,
    /* U+0069 "i" */
    0x0, 0x0, 0x0, 0xfc, 0xbe, 0x0, 0x0, 0x0,
    0x2a, 0x1a, 0x40, 0x0, 0x0, 0xb0, 0x38, 0x2c,
    0x0, 0x0, 0x2c, 0xe, 0xb, 0x0, 0x0, 0xb,
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    0x0, 0x0,
    /* U+006A "j" */
    0xa, 0x80, 0x0, 0xa, 0x80, 0x3f, 0x0, 0x0,
    0x3f, 0xb, 0x3, 0x80, 0xb, 0x3, 0xac, 0xe,
    0x0, 0x2c, 0xe, 0xb0, 0x38, 0x0, 0xb0, 0x38,
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    0xfe, 0x0, 0x0,
    /* U+006B "k" */
    0x18, 0x0, 0x0, 0x0, 0x60, 0x2c, 0x0, 0x0,
    0x0, 0xb0, 0x3, 0x80, 0x0, 0x3, 0x80, 0xab,
    0xe0, 0x0, 0x1b, 0xe9, 0xff, 0xf0, 0x0, 0x2f,
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    0x0, 0x0, 0x2, 0xff, 0x0, 0x0,
    /* U+006C "l" */
    0x2c, 0x0, 0x0, 0x0, 0xb0, 0x1a, 0x40, 0x0,
    0x2, 0xa0, 0x3, 0x80, 0x0, 0x3, 0x80, 0xff,
    0xf0, 0x0, 0x2f, 0xfe, 0xab, 0xe0, 0x0, 0x1b,
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    0xb0, 0x0, 0x2c, 0x0,
    /* U+006D "m" */
    0x0, 0x0, 0x0, 0x3, 0x80, 0x0, 0xbf, 0xc0,
    0x2f, 0xf0, 0x0, 0x6a, 0x80, 0x2f, 0xf0, 0x3,
    0x80, 0x38, 0xff, 0xfe, 0x3, 0x80, 0x38, 0xbf,
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    0xaa, 0x0, 0x0, 0x0, 0xf, 0xf8, 0x0, 0x0,
    /* U+006E "n" */
    0x0, 0xe, 0x0, 0x0, 0x0, 0xe0, 0x0, 0x0,
    0xe, 0x0, 0x0, 0x6, 0x18, 0x0, 0x0, 0xb2,
    0xc0, 0x0, 0x38, 0x3, 0x80, 0x2c, 0x0, 0xb,
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    0x6a, 0x80, 0x0,
    /* U+006F "o" */
    0x0, 0x0, 0x0, 0x3, 0x80, 0x0, 0x0, 0x0,
    0x0, 0xe0, 0x0, 0x0, 0x0, 0x0, 0x38, 0x0,
    0x0, 0x0, 0x0, 0xb2, 0xc0, 0x0, 0x0, 0x0,
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    0x0, 0xf, 0xf8, 0x0, 0x0, 0x0,
    /* U+0070 "p" */
    0x0, 0x2, 0xff, 0x0, 0x0, 0x0, 0x0, 0x6a,
    0x80, 0x0, 0x0, 0x0, 0xe0, 0xe, 0x0, 0x0,
    0x1, 0xa4, 0x2, 0xa0, 0x0, 0x0, 0xb0, 0x0,
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    0x0,
    /* U+0071 "q" */
    0x2f, 0x80, 0x0, 0x3, 0xf0, 0xfa, 0xff, 0xff,
    0xfe, 0xae, 0xe0, 0xba, 0xaa, 0xbc, 0xe, 0xe0,
    0xb0, 0x0, 0x2c, 0xe, 0xe2, 0xa0, 0x0, 0x1a,
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    0x0, 0xaa, 0xa9,
    /* U+0072 "r" */
    0x0, 0x0, 0x0, 0xff, 0x80, 0x0, 0x3, 0xff,
    0xb8, 0x0, 0x0, 0x2f, 0x93, 0x80, 0x0, 0xfc,
    0xb2, 0xff, 0x0, 0xbe, 0x38, 0xfc, 0xb0, 0xb,
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    0xfa, 0x80, 0x3, 0xff, 0xff, 0x0, 0x0,
    /* U+0073 "s" */
    0x0, 0x0, 0x0, 0x3, 0xf0, 0x0, 0x0, 0xf,
    0xff, 0x0, 0x0, 0x0, 0xff, 0xf0, 0x0, 0x3,
    0xff, 0xff, 0x0, 0xa, 0xbf, 0xff, 0xf0, 0x0,
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    0xa, 0xa4, 0x2f, 0xf0, 0x0, 0x0, 0x0,
    /* U+0074 "t" */
    0x0, 0xb, 0xff, 0xfe, 0x0, 0x6, 0xaa, 0xfe,
    0x0, 0x0, 0x0, 0xbe, 0x0, 0x0, 0x3, 0xf0,
    0x0, 0x0, 0x1b, 0xe0, 0x0, 0x0, 0x2f, 0x80,
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    0x6f, 0xa4, 0x0, 0x0, 0xbf, 0xf8, 0x0, 0x0,
    /* U+0075 "u" */
    0x0, 0x0, 0xb, 0xff, 0xf0, 0x0, 0x0, 0xf,
    0xaa, 0xab, 0xf0, 0x0, 0x2, 0x40, 0x0, 0xbc,
    0x0, 0xb, 0x2f, 0xf0, 0xb, 0x0, 0x2, 0xef,
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    0x0, 0x0, 0x0, 0x3, 0xff, 0xc0,
    /* U+0076 "v" */
    0x0, 0xb0, 0x0, 0x0, 0x0, 0x0, 0xfb, 0x82,
    0xff, 0x0, 0x0, 0x38, 0xe0, 0x6a, 0x80, 0x0,
    0xe, 0x38, 0xe0, 0xe, 0x0, 0x2, 0xaa, 0xa4,
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    0x0,
    /* U+0077 "w" */
    0x0, 0x0, 0x0, 0x2f, 0xf0, 0x0, 0x0, 0x0,
    0x3e, 0xab, 0x80, 0x0, 0x0, 0x69, 0x0, 0xe0,
    0x0, 0x0, 0x2c, 0x0, 0x38, 0x0, 0x0, 0xb,
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    0x0, 0x0, 0xff, 0x80, 0x0, 0x0, 0x0,
    /* U+0078 "x" */
    0x2f, 0xfe, 0x0, 0x2f, 0xfe, 0x3f, 0xff, 0xf0,
    0x3f, 0xff, 0xff, 0xff, 0xfc, 0xf, 0xff, 0xff,
    0xff, 0xff, 0x3, 0xff, 0xff, 0xff, 0xff, 0xc0,
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    0xe0, 0x6a, 0xa4, 0x0, 0x6a, 0xa4,
    /* U+0079 "y" */
    0x2f, 0xfe, 0x0, 0xff, 0xf0, 0x3f, 0xff, 0xf2,
    0xff, 0xff, 0x8f, 0xff, 0xfc, 0xbf, 0xff, 0xff,
    0xff, 0xff, 0x2f, 0xff, 0xff, 0xff, 0xff, 0xcb,
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    0x0, 0x6a, 0xa4, 0x2, 0xaa, 0x80,
    /* U+007A "z" */
    0x90, 0x0, 0xe0, 0x0, 0xe0, 0xb0, 0x92, 0xa0,
    0x3, 0x80, 0x0, 0x0, 0x0, 0x69, 0x0, 0xbe,
    /* U+007B "{" */
    /* U+007C "|" */
    /* U+007D "}" */
    /* U+007E "~" */
    /* U+00C0 "À" */
    /* U+00C2 "Â" */
    /* U+00C4 "Ä" */
    /* U+00C6 "Æ" */
    /* U+00C7 "Ç" */
    /* U+00C8 "È" */
    /* U+00C9 "É" */
    /* U+00CA "Ê" */
    /* U+00CB "Ë" */
    /* U+00CE "Î" */
    /* U+00CF "Ï" */
    /* U+00D4 "Ô" */
    /* U+00D6 "Ö" */
    /* U+00DB "Û" */
    /* U+00DC "Ü" */
    /* U+00E0 "à" */
    /* U+00E2 "â" */
    /* U+00E4 "ä" */
    /* U+00E6 "æ" */
    /* U+00E7 "ç" */
    /* U+00E8 "è" */
    /* U+00E9 "é" */
    /* U+00EA "ê" */
    /* U+00EB "ë" */
    /* U+00EE "î" */
    /* U+00EF "ï" */
    /* U+00F4 "ô" */
    /* U+00F6 "ö" */
    /* U+00FB "û" */
    /* U+00FC "ü" */
    /* U+00FF "ÿ" */
    /* U+0152 "Œ" */
    /* U+0153 "œ" */
    /* U+0178 "Ÿ" */
};
/*---------------------
 *  GLYPH DESCRIPTION
 *--------------------*/
static const lv_font_fmt_txt_glyph_dsc_t bitji_24_glyph_dsc[] = {
    {.bitmap_index = 0, .adv_w = 0, .box_w = 0, .box_h = 0, .ofs_x = 0, .ofs_y = 0} /* id = 0 reserved */,
    {.bitmap_index = 0, .adv_w = 120, .box_w = 0, .box_h = 0, .ofs_x = 0, .ofs_y = 0},
    {.bitmap_index = 0, .adv_w = 192, .box_w = 0, .box_h = 0, .ofs_x = 0, .ofs_y = 0},
    {.bitmap_index = 0, .adv_w = 192, .box_w = 0, .box_h = 0, .ofs_x = 0, .ofs_y = 0},
    {.bitmap_index = 0, .adv_w = 192, .box_w = 0, .box_h = 0, .ofs_x = 0, .ofs_y = 0},
    {.bitmap_index = 0, .adv_w = 192, .box_w = 0, .box_h = 0, .ofs_x = 0, .ofs_y = 0},
    {.bitmap_index = 0, .adv_w = 192, .box_w = 0, .box_h = 0, .ofs_x = 0, .ofs_y = 0},
    {.bitmap_index = 0, .adv_w = 192, .box_w = 0, .box_h = 0, .ofs_x = 0, .ofs_y = 0},
    {.bitmap_index = 0, .adv_w = 192, .box_w = 0, .box_h = 0, .ofs_x = 0, .ofs_y = 0},
    {.bitmap_index = 0, .adv_w = 192, .box_w = 0, .box_h = 0, .ofs_x = 0, .ofs_y = 0},
    {.bitmap_index = 0, .adv_w = 192, .box_w = 0, .box_h = 0, .ofs_x = 0, .ofs_y = 0},
    {.bitmap_index = 0, .adv_w = 192, .box_w = 0, .box_h = 0, .ofs_x = 0, .ofs_y = 0},
    {.bitmap_index = 0, .adv_w = 192, .box_w = 0, .box_h = 0, .ofs_x = 0, .ofs_y = 0},
    {.bitmap_index = 0, .adv_w = 192, .box_w = 0, .box_h = 0, .ofs_x = 0, .ofs_y = 0},
    {.bitmap_index = 0, .adv_w = 192, .box_w = 0, .box_h = 0, .ofs_x = 0, .ofs_y = 0},
    {.bitmap_index = 0, .adv_w = 192, .box_w = 0, .box_h = 0, .ofs_x = 0, .ofs_y = 0},
    {.bitmap_index = 0, .adv_w = 192, .box_w = 0, .box_h = 0, .ofs_x = 0, .ofs_y = 0},
    {.bitmap_index = 0, .adv_w = 192, .box_w = 0, .box_h = 0, .ofs_x = 0, .ofs_y = 0},
    {.bitmap_index = 0, .adv_w = 192, .box_w = 0, .box_h = 0, .ofs_x = 0, .ofs_y = 0},
    {.bitmap_index = 0, .adv_w = 192, .box_w = 0, .box_h = 0, .ofs_x = 0, .ofs_y = 0},
    {.bitmap_index = 0, .adv_w = 192, .box_w = 0, .box_h = 0, .ofs_x = 0, .ofs_y = 0},
    {.bitmap_index = 0, .adv_w = 192, .box_w = 0, .box_h = 0, .ofs_x = 0, .ofs_y = 0},
    {.bitmap_index = 0, .adv_w = 192, .box_w = 0, .box_h = 0, .ofs_x = 0, .ofs_y = 0},
    {.bitmap_index = 0, .adv_w = 192, .box_w = 0, .box_h = 0, .ofs_x = 0, .ofs_y = 0},
    {.bitmap_index = 0, .adv_w = 192, .box_w = 0, .box_h = 0, .ofs_x = 0, .ofs_y = 0},
    {.bitmap_index = 0, .adv_w = 192, .box_w = 0, .box_h = 0, .ofs_x = 0, .ofs_y = 0},
    {.bitmap_index = 0, .adv_w = 192, .box_w = 0, .box_h = 0, .ofs_x = 0, .ofs_y = 0},
    {.bitmap_index = 0, .adv_w = 192, .box_w = 0, .box_h = 0, .ofs_x = 0, .ofs_y = 0},
    {.bitmap_index = 0, .adv_w = 192, .box_w = 0, .box_h = 0, .ofs_x = 0, .ofs_y = 0},
    {.bitmap_index = 0, .adv_w = 192, .box_w = 0, .box_h = 0, .ofs_x = 0, .ofs_y = 0},
    {.bitmap_index = 0, .adv_w = 192, .box_w = 0, .box_h = 0, .ofs_x = 0, .ofs_y = 0},
    {.bitmap_index = 0, .adv_w = 192, .box_w = 0, .box_h = 0, .ofs_x = 0, .ofs_y = 0},
    {.bitmap_index = 0, .adv_w = 192, .box_w = 0, .box_h = 0, .ofs_x = 0, .ofs_y = 0},
    {.bitmap_index = 0, .adv_w = 192, .box_w = 0, .box_h = 0, .ofs_x = 0, .ofs_y = 0},
    {.bitmap_index = 0, .adv_w = 384, .box_w = 23, .box_h = 11, .ofs_x = 0, .ofs_y = 2},
    {.bitmap_index = 64, .adv_w = 288, .box_w = 17, .box_h = 14, .ofs_x = 0, .ofs_y = 0},
    {.bitmap_index = 124, .adv_w = 288, .box_w = 17, .box_h = 14, .ofs_x = 0, .ofs_y = 0},
    {.bitmap_index = 184, .adv_w = 264, .box_w = 15, .box_h = 14, .ofs_x = 0, .ofs_y = 0},
    {.bitmap_index = 237, .adv_w = 288, .box_w = 17, .box_h = 15, .ofs_x = 0, .ofs_y = 0},
    {.bitmap_index = 301, .adv_w = 288, .box_w = 17, .box_h = 15, .ofs_x = 0, .ofs_y = 0},
    {.bitmap_index = 365, .adv_w = 264, .box_w = 15, .box_h = 14, .ofs_x = 0, .ofs_y = 2},
    {.bitmap_index = 418, .adv_w = 312, .box_w = 18, .box_h = 17, .ofs_x = 0, .ofs_y = 0},
    {.bitmap_index = 495, .adv_w = 336, .box_w = 20, .box_h = 19, .ofs_x = 0, .ofs_y = -1},
    {.bitmap_index = 590, .adv_w = 360, .box_w = 23, .box_h = 24, .ofs_x = -2, .ofs_y = -6},
    {.bitmap_index = 728, .adv_w = 360, .box_w = 23, .box_h = 24, .ofs_x = -2, .ofs_y = -6},
    {.bitmap_index = 866, .adv_w = 360, .box_w = 21, .box_h = 15, .ofs_x = 0, .ofs_y = 0},
    {.bitmap_index = 945, .adv_w = 288, .box_w = 17, .box_h = 14, .ofs_x = 0, .ofs_y = 2},
    {.bitmap_index = 1005, .adv_w = 312, .box_w = 17, .box_h = 14, .ofs_x = 1, .ofs_y = 2},
    {.bitmap_index = 1065, .adv_w = 336, .box_w = 20, .box_h = 20, .ofs_x = 0, .ofs_y = -5},
    {.bitmap_index = 1165, .adv_w = 360, .box_w = 21, .box_h = 18, .ofs_x = 0, .ofs_y = -6},
    {.bitmap_index = 1260, .adv_w = 312, .box_w = 18, .box_h = 15, .ofs_x = 0, .ofs_y = 2},
    {.bitmap_index = 1328, .adv_w = 192, .box_w = 11, .box_h = 14, .ofs_x = 0, .ofs_y = 0},
    {.bitmap_index = 1367, .adv_w = 336, .box_w = 20, .box_h = 24, .ofs_x = 0, .ofs_y = -6},
    {.bitmap_index = 1487, .adv_w = 336, .box_w = 20, .box_h = 12, .ofs_x = 0, .ofs_y = 2},
    {.bitmap_index = 1547, .adv_w = 360, .box_w = 21, .box_h = 22, .ofs_x = 0, .ofs_y = -5},
    {.bitmap_index = 1663, .adv_w = 288, .box_w = 14, .box_h = 18, .ofs_x = 3, .ofs_y = 0},
    {.bitmap_index = 1726, .adv_w = 336, .box_w = 20, .box_h = 18, .ofs_x = 0, .ofs_y = 0},
    {.bitmap_index = 1816, .adv_w = 312, .box_w = 18, .box_h = 18, .ofs_x = 0, .ofs_y = 0},
    {.bitmap_index = 1897, .adv_w = 312, .box_w = 18, .box_h = 20, .ofs_x = 0, .ofs_y = -2},
    {.bitmap_index = 1987, .adv_w = 288, .box_w = 17, .box_h = 17, .ofs_x = 0, .ofs_y = 0},
    {.bitmap_index = 2060, .adv_w = 192, .box_w = 0, .box_h = 0, .ofs_x = 0, .ofs_y = 0},
    {.bitmap_index = 2060, .adv_w = 192, .box_w = 0, .box_h = 0, .ofs_x = 0, .ofs_y = 0},
    {.bitmap_index = 2060, .adv_w = 192, .box_w = 0, .box_h = 0, .ofs_x = 0, .ofs_y = 0},
    {.bitmap_index = 2060, .adv_w = 192, .box_w = 0, .box_h = 0, .ofs_x = 0, .ofs_y = 0},
    {.bitmap_index = 2060, .adv_w = 192, .box_w = 0, .box_h = 0, .ofs_x = 0, .ofs_y = 0},
    {.bitmap_index = 2060, .adv_w = 336, .box_w = 20, .box_h = 24, .ofs_x = 0, .ofs_y = -6},
    {.bitmap_index = 2180, .adv_w = 360, .box_w = 21, .box_h = 23, .ofs_x = 0, .ofs_y = -5},
    {.bitmap_index = 2301, .adv_w = 336, .box_w = 20, .box_h = 21, .ofs_x = 0, .ofs_y = -3},
    {.bitmap_index = 2406, .adv_w = 336, .box_w = 20, .box_h = 20, .ofs_x = 0, .ofs_y = -2},
    {.bitmap_index = 2506, .adv_w = 360, .box_w = 21, .box_h = 20, .ofs_x = 0, .ofs_y = -2},
    {.bitmap_index = 2611, .adv_w = 360, .box_w = 21, .box_h = 24, .ofs_x = 0, .ofs_y = -6},
    {.bitmap_index = 2737, .adv_w = 360, .box_w = 21, .box_h = 21, .ofs_x = 0, .ofs_y = -3},
    {.bitmap_index = 2848, .adv_w = 336, .box_w = 20, .box_h = 11, .ofs_x = 0, .ofs_y = 2},
    {.bitmap_index = 2903, .adv_w = 360, .box_w = 21, .box_h = 17, .ofs_x = 0, .ofs_y = 0},
    {.bitmap_index = 2993, .adv_w = 336, .box_w = 19, .box_h = 14, .ofs_x = 1, .ofs_y = 0},
    {.bitmap_index = 3060, .adv_w = 336, .box_w = 20, .box_h = 14, .ofs_x = 0, .ofs_y = 0},
    {.bitmap_index = 3130, .adv_w = 336, .box_w = 20, .box_h = 12, .ofs_x = 0, .ofs_y = 2},
    {.bitmap_index = 3190, .adv_w = 336, .box_w = 20, .box_h = 24, .ofs_x = 0, .ofs_y = -6},
    {.bitmap_index = 3310, .adv_w = 240, .box_w = 14, .box_h = 19, .ofs_x = 0, .ofs_y = -2},
    {.bitmap_index = 3377, .adv_w = 360, .box_w = 21, .box_h = 24, .ofs_x = 0, .ofs_y = -6},
    {.bitmap_index = 3503, .adv_w = 360, .box_w = 21, .box_h = 20, .ofs_x = 0, .ofs_y = -3},
    {.bitmap_index = 3608, .adv_w = 336, .box_w = 20, .box_h = 23, .ofs_x = 0, .ofs_y = -5},
    {.bitmap_index = 3723, .adv_w = 312, .box_w = 18, .box_h = 21, .ofs_x = 0, .ofs_y = -3},
    {.bitmap_index = 3818, .adv_w = 312, .box_w = 18, .box_h = 21, .ofs_x = 0, .ofs_y = -3},
    {.bitmap_index = 3913, .adv_w = 288, .box_w = 16, .box_h = 18, .ofs_x = 1, .ofs_y = -1},
    {.bitmap_index = 3985, .adv_w = 360, .box_w = 21, .box_h = 24, .ofs_x = 0, .ofs_y = -6},
    {.bitmap_index = 4111, .adv_w = 360, .box_w = 21, .box_h = 23, .ofs_x = 0, .ofs_y = -5},
    {.bitmap_index = 4232, .adv_w = 360, .box_w = 21, .box_h = 18, .ofs_x = 0, .ofs_y = 0},
    {.bitmap_index = 4327, .adv_w = 360, .box_w = 21, .box_h = 24, .ofs_x = 0, .ofs_y = -6},
    {.bitmap_index = 4453, .adv_w = 360, .box_w = 21, .box_h = 24, .ofs_x = 0, .ofs_y = -6},
    {.bitmap_index = 4579, .adv_w = 144, .box_w = 8, .box_h = 8, .ofs_x = 0, .ofs_y = 6},
    {.bitmap_index = 4595, .adv_w = 192, .box_w = 0, .box_h = 0, .ofs_x = 0, .ofs_y = 0},
    {.bitmap_index = 4595, .adv_w = 192, .box_w = 0, .box_h = 0, .ofs_x = 0, .ofs_y = 0},
    {.bitmap_index = 4595, .adv_w = 192, .box_w = 0, .box_h = 0, .ofs_x = 0, .ofs_y = 0},
    {.bitmap_index = 4595, .adv_w = 192, .box_w = 0, .box_h = 0, .ofs_x = 0, .ofs_y = 0},
    {.bitmap_index = 4595, .adv_w = 192, .box_w = 0, .box_h = 0, .ofs_x = 0, .ofs_y = 0},
    {.bitmap_index = 4595, .adv_w = 192, .box_w = 0, .box_h = 0, .ofs_x = 0, .ofs_y = 0},
    {.bitmap_index = 4595, .adv_w = 192, .box_w = 0, .box_h = 0, .ofs_x = 0, .ofs_y = 0},
    {.bitmap_index = 4595, .adv_w = 192, .box_w = 0, .box_h = 0, .ofs_x = 0, .ofs_y = 0},
    {.bitmap_index = 4595, .adv_w = 192, .box_w = 0, .box_h = 0, .ofs_x = 0, .ofs_y = 0},
    {.bitmap_index = 4595, .adv_w = 192, .box_w = 0, .box_h = 0, .ofs_x = 0, .ofs_y = 0},
    {.bitmap_index = 4595, .adv_w = 192, .box_w = 0, .box_h = 0, .ofs_x = 0, .ofs_y = 0},
    {.bitmap_index = 4595, .adv_w = 192, .box_w = 0, .box_h = 0, .ofs_x = 0, .ofs_y = 0},
    {.bitmap_index = 4595, .adv_w = 192, .box_w = 0, .box_h = 0, .ofs_x = 0, .ofs_y = 0},
    {.bitmap_index = 4595, .adv_w = 192, .box_w = 0, .box_h = 0, .ofs_x = 0, .ofs_y = 0},
    {.bitmap_index = 4595, .adv_w = 192, .box_w = 0, .box_h = 0, .ofs_x = 0, .ofs_y = 0},
    {.bitmap_index = 4595, .adv_w = 192, .box_w = 0, .box_h = 0, .ofs_x = 0, .ofs_y = 0},
    {.bitmap_index = 4595, .adv_w = 192, .box_w = 0, .box_h = 0, .ofs_x = 0, .ofs_y = 0},
    {.bitmap_index = 4595, .adv_w = 192, .box_w = 0, .box_h = 0, .ofs_x = 0, .ofs_y = 0},
    {.bitmap_index = 4595, .adv_w = 192, .box_w = 0, .box_h = 0, .ofs_x = 0, .ofs_y = 0},
    {.bitmap_index = 4595, .adv_w = 192, .box_w = 0, .box_h = 0, .ofs_x = 0, .ofs_y = 0},
    {.bitmap_index = 4595, .adv_w = 192, .box_w = 0, .box_h = 0, .ofs_x = 0, .ofs_y = 0},
    {.bitmap_index = 4595, .adv_w = 192, .box_w = 0, .box_h = 0, .ofs_x = 0, .ofs_y = 0},
    {.bitmap_index = 4595, .adv_w = 192, .box_w = 0, .box_h = 0, .ofs_x = 0, .ofs_y = 0},
    {.bitmap_index = 4595, .adv_w = 192, .box_w = 0, .box_h = 0, .ofs_x = 0, .ofs_y = 0},
    {.bitmap_index = 4595, .adv_w = 192, .box_w = 0, .box_h = 0, .ofs_x = 0, .ofs_y = 0},
    {.bitmap_index = 4595, .adv_w = 192, .box_w = 0, .box_h = 0, .ofs_x = 0, .ofs_y = 0},
    {.bitmap_index = 4595, .adv_w = 192, .box_w = 0, .box_h = 0, .ofs_x = 0, .ofs_y = 0},
    {.bitmap_index = 4595, .adv_w = 192, .box_w = 0, .box_h = 0, .ofs_x = 0, .ofs_y = 0},
    {.bitmap_index = 4595, .adv_w = 192, .box_w = 0, .box_h = 0, .ofs_x = 0, .ofs_y = 0},
    {.bitmap_index = 4595, .adv_w = 192, .box_w = 0, .box_h = 0, .ofs_x = 0, .ofs_y = 0},
    {.bitmap_index = 4595, .adv_w = 192, .box_w = 0, .box_h = 0, .ofs_x = 0, .ofs_y = 0},
    {.bitmap_index = 4595, .adv_w = 192, .box_w = 0, .box_h = 0, .ofs_x = 0, .ofs_y = 0},
    {.bitmap_index = 4595, .adv_w = 192, .box_w = 0, .box_h = 0, .ofs_x = 0, .ofs_y = 0},
    {.bitmap_index = 4595, .adv_w = 192, .box_w = 0, .box_h = 0, .ofs_x = 0, .ofs_y = 0},
    {.bitmap_index = 4595, .adv_w = 192, .box_w = 0, .box_h = 0, .ofs_x = 0, .ofs_y = 0},
    {.bitmap_index = 4595, .adv_w = 192, .box_w = 0, .box_h = 0, .ofs_x = 0, .ofs_y = 0},
    {.bitmap_index = 4595, .adv_w = 192, .box_w = 0, .box_h = 0, .ofs_x = 0, .ofs_y = 0},
    {.bitmap_index = 4595, .adv_w = 192, .box_w = 0, .box_h = 0, .ofs_x = 0, .ofs_y = 0}
};
/*---------------------
 *  CHARACTER MAPPING
 *--------------------*/
static const uint16_t bitji_24_unicode_list_2[] = {
    0x0, 0x2, 0x4, 0x6, 0x7, 0x8, 0x9, 0xa,
    0xb, 0xe, 0xf, 0x14, 0x16, 0x1b, 0x1c, 0x20,
    0x22, 0x24, 0x26, 0x27, 0x28, 0x29, 0x2a, 0x2b,
    0x2e, 0x2f, 0x34, 0x36, 0x3b, 0x3c, 0x3f, 0x92,
    0x93, 0xb8
};
/*Collect the unicode lists and glyph_id offsets*/
static const lv_font_fmt_txt_cmap_t bitji_24_cmaps[] =
{
    {
        .range_start = 32, .range_length = 64, .glyph_id_start = 1,
        .unicode_list = NULL, .glyph_id_ofs_list = NULL, .list_length = 0, .type = LV_FONT_FMT_TXT_CMAP_FORMAT0_TINY
    },
    {
        .range_start = 97, .range_length = 30, .glyph_id_start = 65,
        .unicode_list = NULL, .glyph_id_ofs_list = NULL, .list_length = 0, .type = LV_FONT_FMT_TXT_CMAP_FORMAT0_TINY
    },
    {
        .range_start = 192, .range_length = 185, .glyph_id_start = 95,
        .unicode_list = bitji_24_unicode_list_2, .glyph_id_ofs_list = NULL, .list_length = 34, .type = LV_FONT_FMT_TXT_CMAP_SPARSE_TINY
    }
};
/*--------------------
 *  ALL CUSTOM DATA
 *--------------------*/
/*Store all the custom data of the font*/
static lv_font_fmt_txt_glyph_cache_t bitji_24_cache;
static const lv_font_fmt_txt_dsc_t bitji_24_font_dsc = {
    .glyph_bitmap = bitji_24_glyph_bitmap,
    .glyph_dsc = bitji_24_glyph_dsc,
    .cmaps = bitji_24_cmaps,
    .kern_dsc = NULL,
    .kern_scale = 0,
    .cmap_num = 3,
    .bpp = 2,
    .kern_classes = 0,
    .bitmap_format = 0,
    .cache = &bitji_24_cache
};
/*-----------------
 *  PUBLIC FONT
 *----------------*/
/*Initialize a public general font descriptor*/
const lv_font_t bitji_24 = {
    .get_glyph_dsc = lv_font_get_glyph_dsc_fmt_txt,    /*Function pointer to get glyph's data*/
    .get_glyph_bitmap = lv_font_get_bitmap_fmt_txt,    /*Function pointer to get glyph's bitmap*/
    .line_height = 24,          /*The maximum line height required by the font*/
    .base_line = 6,             /*Baseline measured from the bottom of the line*/

    .subpx = LV_FONT_SUBPX_NONE,
    .underline_position = -1,
    .underline_thickness = 1,
    .dsc = &bitji_24_font_dsc,          /*The custom font data. Will be accessed by `get_glyph_bitmap/dsc` */
};
#endif

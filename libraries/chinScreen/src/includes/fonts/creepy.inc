/*******************************************************************************
 * Size: 20 px
 * Bpp: 2
 ******************************************************************************/


#ifdef __has_include

    #if __has_include("lvgl.h")
         #ifndef LV_LVGL_H_INCLUDE_SIMPLE
             #define LV_LVGL_H_INCLUDE_SIMPLE
         #endif
     #endif
 #endif

 #ifdef LV_LVGL_H_INCLUDE_SIMPLE
     #include "lvgl.h"
 #else
     #include "../lvgl-8.3.11/lvgl.h"
 #endif

 #ifndef CREEPY
 #define CREEPY 1
 #endif

 #if CREEPY

/*-----------------
 *    BITMAPS
 *----------------*/
/*Store the image of the glyphs*/
static LV_ATTRIBUTE_LARGE_CONST const uint8_t creepy_glyph_bitmap[] = {
    /* U+0020 " " */
    /* U+0021 "!" */
    0x2b, 0x3f, 0xcb, 0xf4, 0xfe, 0x3f, 0x5f, 0xc7,
    0xf5, 0x79, 0xc, 0x40, 0x13, 0xf1, 0xfe, 0x3e,
    0x48, 0x1, 0x4, 0x80, 0x10, 0x0,
    /* U+0022 "\"" */
    0x34, 0x71, 0xf7, 0xdb, 0xef, 0xff, 0xbf, 0x3c,
    0x78, 0x80, 0x52, 0x0, 0x44, 0x2, 0x10, 0x0,
    0x0, 0x0,
    /* U+0023 "#" */
    0x0, 0x7, 0x3, 0x40, 0x0, 0xfc, 0x2f, 0x0,
    0x3, 0xe0, 0xb8, 0x0, 0xf, 0x42, 0xe0, 0xb,
    0xff, 0xff, 0xf0, 0x3f, 0xff, 0xff, 0xd0, 0x3f,
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    0x0, 0x4, 0x4, 0x2, 0x0, 0x20, 0x0, 0x0,
    /* U+0024 "$" */
    0x0, 0x1f, 0x0, 0x0, 0x7f, 0xfe, 0x1, 0xff,
    0xff, 0xc1, 0xfe, 0x7f, 0xf4, 0x7f, 0x4c, 0x18,
    0xf, 0xff, 0x4, 0x1, 0xff, 0xe5, 0x0, 0x3f,
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    0x0,
    /* U+0025 "%" */
    0x3, 0xe4, 0x0, 0x0, 0x0, 0xf, 0xfc, 0x0,
    0x70, 0x0, 0x7f, 0xff, 0x41, 0xe0, 0x0, 0xbc,
    0x47, 0xc2, 0xd0, 0x0, 0x7c, 0x47, 0xc7, 0x10,
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    0x4, 0x0, 0x0, 0x0, 0x0, 0x0, 0x0,
    /* U+0026 "&" */
    0x0, 0xbf, 0x0, 0x0, 0x2f, 0xfe, 0x0, 0x7,
    0xff, 0xfc, 0x1, 0xfe, 0x2f, 0xe0, 0x1f, 0xe0,
    0xbe, 0x1, 0x7f, 0xff, 0x90, 0xb, 0xff, 0xe0,
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    0x20, 0x0, 0x0, 0x1, 0x0, 0x0,
    /* U+0027 "'" */
    0x20, 0x7c, 0x7d, 0xbd, 0xbc, 0x8, 0x4, 0x0,
    0x4,
    /* U+0028 "(" */
    0x7, 0x40, 0xbe, 0xf, 0xd2, 0xfd, 0x3f, 0xa3,
    0xf4, 0x7f, 0xb, 0xf0, 0x7f, 0x8b, 0xf4, 0xbf,
    0x1b, 0xf1, 0x7f, 0x6, 0xf4, 0x6f, 0xc5, 0xfc,
    0xf, 0xd0, 0x45, 0x4, 0x50, 0x5, 0x0, 0x40,
    0x4,
    /* U+0029 ")" */
    0x7c, 0xb, 0xd0, 0x3f, 0x2, 0xf4, 0x1f, 0x82,
    0xfc, 0x3f, 0xc2, 0xfc, 0x3f, 0xd2, 0xfc, 0x2f,
    0xd3, 0xfd, 0x3f, 0x53, 0xf9, 0x3f, 0x9b, 0xe5,
    0x3d, 0x2, 0x0, 0x10, 0x0, 0x1,
    /* U+002A "*" */
    0x2, 0xc0, 0x7, 0xe0, 0x7f, 0xfe, 0xbf, 0xfa,
    0xf, 0xf1, 0x2f, 0xf1, 0x1c, 0xb8, 0x8, 0x20,
    0x4, 0x10, 0x4, 0x10, 0x0, 0x10, 0x0, 0x20,
    0x0, 0x0,
    /* U+002B "+" */
    0x0, 0x0, 0x0, 0x0, 0x7c, 0x0, 0x0, 0xfd,
    0x0, 0x0, 0x7d, 0x0, 0x0, 0x7e, 0x0, 0x3f,
    0xff, 0xf8, 0xbf, 0xff, 0xff, 0x4e, 0xff, 0x55,
    0x44, 0x7d, 0x1, 0x4, 0x7c, 0x1, 0x4, 0x7d,
    0x5, 0x0, 0xbc, 0x0, 0x0, 0x4, 0x0, 0x0,
    0x4, 0x0, 0x4, 0x4, 0x0, 0x0, 0x4, 0x0,
    0x0, 0x4, 0x0,
    /* U+002C "," */
    0x7f, 0xb, 0xf4, 0x2f, 0xc0, 0xb8, 0x2f, 0x47,
    0x90, 0x21, 0x1, 0x10, 0x10, 0x0, 0x0, 0x10,
    0x0,
    /* U+002D "-" */
    0x1, 0x40, 0x3f, 0xfd, 0x7f, 0xfe, 0xbf, 0xfe,
    0x80, 0x50, 0x40, 0x41, 0x0, 0x40, 0x40, 0x0,
    0x0, 0x0, 0x0, 0x0,
    /* U+002E "." */
    0x1c, 0x2f, 0xcf, 0xf4, 0x6c, 0x1, 0x0, 0x0,
    0x0,
    /* U+002F "/" */
    0x0, 0x34, 0x1, 0xe0, 0xe, 0x40, 0x79, 0x2,
    0xc4, 0xa, 0x0, 0x7c, 0x1, 0xc0, 0xb, 0x0,
    0x7c, 0x3, 0xd0, 0xd, 0x40, 0x35, 0x1, 0xd4,
    0xa, 0x40, 0x20, 0x0, 0x40, 0x0,
    /* U+0030 "0" */
    0x0, 0x34, 0x0, 0x0, 0x2f, 0xa8, 0x0, 0xff,
    0xff, 0x80, 0x3f, 0xff, 0xf0, 0x2f, 0xc8, 0xff,
    0xf, 0xe1, 0x2f, 0xe3, 0xfc, 0x4b, 0xfa, 0xff,
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    0x0,
    /* U+0031 "1" */
    0x0, 0x38, 0x0, 0xbc, 0x7, 0xfe, 0x7f, 0xfd,
    0xbf, 0xfe, 0x9f, 0xfe, 0x43, 0xff, 0x43, 0xfe,
    0x2, 0xfe, 0x2, 0xfe, 0x3, 0xfd, 0x3, 0xfd,
    0x1, 0xfd, 0x0, 0x54, 0x4, 0x50, 0x0, 0x40,
    0x0, 0x50,
    /* U+0032 "2" */
    0x1, 0xff, 0xd0, 0x1, 0xff, 0xfe, 0x2, 0xff,
    0xff, 0xd1, 0xfd, 0x7, 0xfc, 0xaf, 0x0, 0xff,
    0x12, 0x0, 0xbf, 0x40, 0x0, 0xbf, 0x90, 0x0,
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    0x0, 0x0, 0x40, 0x40, 0x0, 0x10,
    /* U+0033 "3" */
    0x6, 0x7e, 0x0, 0xf, 0xff, 0xe0, 0x7f, 0xff,
    0xf8, 0xbf, 0xab, 0xfc, 0x46, 0x3, 0xfc, 0x82,
    0xb, 0xf8, 0x1, 0x7f, 0xf0, 0x80, 0x57, 0xf8,
    0x24, 0x2, 0xfe, 0x7d, 0x3, 0xfd, 0x7f, 0xeb,
    0xfc, 0x2f, 0xff, 0xf8, 0xf, 0xff, 0x88, 0x8,
    0x82, 0x4, 0x8, 0x41, 0x4, 0x8, 0x1, 0x0,
    0x0, 0x1, 0x0,
    /* U+0034 "4" */
    0x0, 0x1, 0xb0, 0x0, 0x3, 0xfe, 0x0, 0x2,
    0xff, 0xc0, 0x3, 0xff, 0xf0, 0x2, 0xff, 0xf8,
    0x2, 0xf6, 0xff, 0x3, 0xf0, 0x3f, 0xc0, 0xff,
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    0x0, 0x40, 0x0, 0x0, 0x10, 0x0,
    /* U+0035 "5" */
    0x5, 0xbe, 0x90, 0x2f, 0xff, 0xf0, 0x2f, 0xff,
    0xf0, 0x3f, 0xc0, 0x20, 0x3f, 0x40, 0x10, 0x7f,
    0x80, 0x10, 0x3f, 0xfe, 0xa0, 0x3f, 0xff, 0xf4,
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    0x0, 0x0, 0x2, 0x0,
    /* U+0036 "6" */
    0x0, 0x1c, 0x0, 0x0, 0xff, 0xfd, 0x0, 0xff,
    0xef, 0xd0, 0xbf, 0x40, 0x60, 0x3f, 0x90, 0x0,
    0xf, 0xff, 0xf9, 0xb, 0xff, 0xff, 0xe2, 0xff,
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    0x0, 0x0, 0x0, 0x0, 0x0, 0x0,
    /* U+0037 "7" */
    0x3e, 0xef, 0x54, 0x1f, 0xff, 0xff, 0x8b, 0xff,
    0xff, 0xf2, 0x2, 0x7f, 0xf4, 0x80, 0x7, 0xf4,
    0x20, 0x2, 0xf5, 0x8, 0x3, 0xfc, 0x41, 0x2,
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    0x0, 0x0, 0x0,
    /* U+0038 "8" */
    0x1, 0xbf, 0xb0, 0x1, 0xff, 0xfe, 0x0, 0xff,
    0xff, 0xc0, 0xff, 0x5b, 0xf8, 0x7f, 0x80, 0xff,
    0x1b, 0xe0, 0x2f, 0xc4, 0xbd, 0x3f, 0x90, 0x7f,
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    0x0,
    /* U+0039 "9" */
    0x0, 0xe, 0x40, 0x2, 0xff, 0xfc, 0x2, 0xff,
    0xff, 0xe0, 0xbf, 0x97, 0xfc, 0x3f, 0xd0, 0x7f,
    0x1f, 0xf4, 0x3f, 0xc7, 0xff, 0x2f, 0xfd, 0x3f,
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    0x0, 0x0, 0x0,
    /* U+003A ":" */
    0x1d, 0xf, 0xcb, 0xf4, 0x34, 0x8, 0x1, 0x1,
    0x52, 0xfd, 0x7f, 0x17, 0x44, 0x80, 0x10, 0x48,
    0x2, 0x0, 0x0,
    /* U+003B ";" */
    0x6, 0x7, 0xf8, 0xbf, 0xc8, 0xe0, 0x81, 0x4,
    0x10, 0x6, 0x3, 0xf4, 0x3f, 0xc1, 0xfd, 0xf,
    0x90, 0xf4, 0x3c, 0x41, 0x44, 0x4, 0x40, 0x0,
    /* U+003C "<" */
    0x0, 0x0, 0x0, 0x0, 0x0, 0xb, 0x80, 0x0,
    0x3f, 0xf0, 0x3, 0xff, 0xc4, 0x17, 0xfc, 0x1,
    0x2f, 0xf4, 0x0, 0x87, 0xfc, 0x0, 0x10, 0x7f,
    0xf4, 0x0, 0x15, 0xff, 0xe0, 0x4, 0xa, 0xff,
    0x80, 0x1, 0xa, 0xe0, 0x0, 0x40, 0x4, 0x0,
    0x10, 0x1, 0x0, 0x0, 0x0, 0x40, 0x0, 0x0,
    0x0, 0x0, 0x0, 0x4,
    /* U+003D "=" */
    0x0, 0x4, 0x10, 0xb, 0xff, 0xff, 0xc3, 0xff,
    0xff, 0xe0, 0x20, 0x18, 0x10, 0x4, 0x0, 0x0,
    0xb, 0xff, 0xff, 0xda, 0xff, 0xff, 0xf5, 0x8,
    0x9, 0x30, 0x1, 0x0, 0x8, 0x0, 0x40, 0x2,
    0x0, 0x20, 0x0, 0x80, 0x8, 0x0, 0x20, 0x0,
    0x0, 0x8, 0x0, 0x0, 0x2, 0x0,
    /* U+003E ">" */
    0x7f, 0x40, 0x0, 0x2f, 0xf0, 0x0, 0x6, 0x7f,
    0xd0, 0x0, 0x4a, 0xff, 0xa0, 0x10, 0x23, 0xff,
    0x0, 0x4, 0xff, 0xc0, 0x2, 0xbf, 0x50, 0x1b,
    0xfc, 0x84, 0x7f, 0xf1, 0x10, 0x2e, 0x20, 0x44,
    0x2, 0x4, 0x11, 0x0, 0x40, 0x0, 0x40, 0x10,
    0x0, 0x20, 0x4, 0x0, 0x0, 0x0,
    /* U+003F "?" */
    0x0, 0xbd, 0x0, 0x1f, 0xff, 0xd0, 0xbf, 0xff,
    0xf0, 0xbe, 0xf, 0xfc, 0xa8, 0x7, 0xf8, 0x40,
    0x2f, 0xf4, 0x40, 0xff, 0xc4, 0x80, 0xf9, 0x4,
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    0x0, 0x0, 0x0, 0x0,
    /* U+0040 "@" */
    0x0, 0xb, 0xff, 0x80, 0x0, 0x0, 0x3f, 0xea,
    0xe4, 0x0, 0x3, 0xfe, 0x2, 0xf8, 0x0, 0xfd,
    0x4, 0x2, 0xf8, 0xb, 0x90, 0x0, 0x4, 0xf0,
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    0x0, 0x0, 0x0, 0x0, 0x0, 0x0,
    /* U+0041 "A" */
    0x0, 0x0, 0x0, 0x0, 0x7, 0xfc, 0x0, 0x0,
    0xbf, 0xe0, 0x0, 0xf, 0xff, 0x0, 0x3, 0xff,
    0xf0, 0x0, 0x3f, 0xff, 0x40, 0x7, 0xff, 0xfc,
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    0x0, 0x1, 0x0, 0x0, 0x0, 0x0,
    /* U+0042 "B" */
    0x1f, 0xff, 0xf4, 0x3, 0xff, 0xff, 0xf0, 0x7f,
    0xff, 0xff, 0x47, 0xfd, 0x2f, 0xf4, 0x7f, 0x80,
    0x7f, 0x4b, 0xf8, 0x2f, 0xe0, 0xbf, 0xff, 0xfe,
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    0x10, 0x0, 0x40, 0x1, 0x0, 0x4,
    /* U+0043 "C" */
    0x0, 0xbf, 0xf8, 0x0, 0x1f, 0xff, 0xfe, 0x1,
    0xff, 0xff, 0xfd, 0xb, 0xfc, 0x2f, 0xfc, 0x3f,
    0xd0, 0x2b, 0xe0, 0xff, 0x0, 0x40, 0xb, 0xf8,
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    0x1, 0x0, 0x0,
    /* U+0044 "D" */
    0x2, 0xcb, 0xc0, 0x0, 0x6f, 0xbf, 0x90, 0x3,
    0xff, 0xff, 0xe0, 0x1f, 0xfe, 0x7f, 0xf0, 0xbf,
    0xc8, 0xbf, 0xc2, 0xfe, 0x11, 0xbf, 0x47, 0xfc,
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    0x20, 0x0, 0x0,
    /* U+0045 "E" */
    0x1f, 0xff, 0xed, 0x2f, 0xff, 0xff, 0x8b, 0xff,
    0xbe, 0x90, 0xff, 0x44, 0x4, 0x7f, 0xe0, 0x0,
    0x2f, 0xff, 0xfe, 0xb, 0xff, 0xff, 0x81, 0xff,
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    0x0, 0x0, 0x0, 0x0, 0x0,
    /* U+0046 "F" */
    0x1b, 0xeb, 0x91, 0xff, 0xff, 0xe7, 0xff, 0xff,
    0x6f, 0xf8, 0x30, 0xbf, 0x40, 0x41, 0xff, 0x99,
    0xf, 0xff, 0xfc, 0x2f, 0xff, 0xf4, 0x7f, 0xfd,
    0x81, 0xfe, 0x11, 0xb, 0xfc, 0x4, 0x2f, 0xf0,
    0x10, 0x3f, 0xc0, 0x40, 0xf5, 0x2, 0x0, 0x80,
    0x0, 0x1, 0x0, 0x0, 0x4, 0x0, 0x0, 0x20,
    0x0, 0x0, 0x40, 0x0, 0x0,
    /* U+0047 "G" */
    0x1, 0xcf, 0xf8, 0x0, 0xb, 0xff, 0xfd, 0x0,
    0x3f, 0xff, 0xf8, 0xb, 0xfe, 0x56, 0xf0, 0x3f,
    0xd4, 0x1, 0x82, 0xff, 0x10, 0x0, 0xb, 0xfc,
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    0x4, 0x0, 0x0,
    /* U+0048 "H" */
    0x3f, 0x40, 0xf, 0x81, 0xfe, 0x0, 0x7f, 0x47,
    0xfc, 0x3, 0xfe, 0x2f, 0xf0, 0xf, 0xfd, 0xbf,
    0xd0, 0x3f, 0xe6, 0xff, 0xff, 0xff, 0x8b, 0xff,
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    0x10, 0x0, 0x8, 0x0, 0x0, 0x0, 0x10, 0x0,
    /* U+0049 "I" */
    0x1f, 0x7, 0xfd, 0x7f, 0xc3, 0xfd, 0x3f, 0xd7,
    0xfc, 0x7f, 0xc3, 0xfd, 0xbf, 0xcb, 0xfc, 0x7f,
    0xeb, 0xfe, 0x7f, 0xd2, 0xe9, 0x48, 0x40, 0x40,
    0x8, 0x0, 0x80, 0x8, 0x0,
    /* U+004A "J" */
    0x0, 0x0, 0xe0, 0x0, 0x3, 0xfc, 0x0, 0x3,
    0xfc, 0x0, 0x7, 0xfd, 0x0, 0x3, 0xfd, 0x0,
    0x7, 0xfc, 0x0, 0xb, 0xfc, 0x0, 0xb, 0xfd,
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    0x40, 0x0, 0x0, 0x0, 0x0, 0x0, 0x0,
    /* U+004B "K" */
    0x1f, 0x40, 0x2e, 0x3, 0xf8, 0xf, 0xe0, 0x3f,
    0xc2, 0xfc, 0xb, 0xff, 0xff, 0xc0, 0xff, 0xff,
    0xd8, 0x7, 0xff, 0xfc, 0x80, 0x7f, 0xff, 0xf8,
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    0x0, 0x1, 0x0, 0x0, 0x0, 0x40,
    /* U+004C "L" */
    0x1f, 0x0, 0x0, 0x3f, 0x80, 0x0, 0x7f, 0xd0,
    0x0, 0xbf, 0xe0, 0x0, 0x7f, 0xa0, 0x0, 0x3f,
    0xd0, 0x0, 0x7f, 0xc0, 0x0, 0x3f, 0xc0, 0x0,
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    0x0, 0x0, 0x40, 0x40,
    /* U+004D "M" */
    0x0, 0x0, 0x0, 0x0, 0xf, 0xf0, 0x0, 0xff,
    0x8b, 0xff, 0x0, 0x7f, 0xf2, 0xff, 0xe0, 0x2f,
    0xfd, 0xbf, 0xfc, 0xf, 0xff, 0x6f, 0xff, 0x7,
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    0x0, 0x0,
    /* U+004E "N" */
    0x3e, 0x0, 0xb, 0x8b, 0xfd, 0x1, 0xfd, 0x7f,
    0xe0, 0x1f, 0xe7, 0xff, 0x42, 0xfd, 0xff, 0xfd,
    0x2f, 0xd7, 0xff, 0xe2, 0xfe, 0xbf, 0xff, 0xff,
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    0x0, 0x0, 0x0, 0x0, 0x0, 0x0,
    /* U+004F "O" */
    0x0, 0xf, 0xd0, 0x0, 0x2, 0xff, 0xff, 0x40,
    0x7, 0xff, 0xff, 0xd0, 0xb, 0xff, 0xbf, 0xf0,
    0xf, 0xf1, 0x23, 0xfc, 0x2f, 0xd0, 0x12, 0xfd,
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    0x0, 0x0, 0x2, 0x0, 0x4, 0x0, 0x0, 0x0,
    /* U+0050 "P" */
    0x0, 0x0, 0x0, 0x0, 0xff, 0xf4, 0x0, 0x7f,
    0xff, 0xfc, 0x7, 0xff, 0xff, 0xf4, 0xbf, 0xe8,
    0xff, 0xc7, 0xfc, 0x43, 0xfd, 0x7f, 0x80, 0x3f,
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    0x0, 0x0,
    /* U+0051 "Q" */
    0x0, 0xf, 0xf0, 0x0, 0xb, 0xff, 0xfc, 0x0,
    0x7f, 0xff, 0xf8, 0xf, 0xfc, 0x7f, 0xfc, 0x7f,
    0xc1, 0x4f, 0xfa, 0xff, 0x4, 0x2f, 0xfb, 0xfc,
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    0xc, 0x0, 0x0, 0x0, 0x0, 0x0,
    /* U+0052 "R" */
    0x2, 0xf5, 0xd0, 0x3, 0xff, 0xff, 0xe0, 0x3f,
    0xff, 0xff, 0x83, 0xff, 0xef, 0xfc, 0x7f, 0xc4,
    0x7f, 0xcb, 0xfc, 0x3, 0xfc, 0xbf, 0xe5, 0xbf,
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    0x0, 0x0, 0x8, 0x0, 0x0, 0x0,
    /* U+0053 "S" */
    0x1, 0xff, 0xe0, 0x3, 0xff, 0xfe, 0x3, 0xff,
    0xff, 0xe1, 0xff, 0x46, 0xfd, 0xbf, 0xd0, 0x36,
    0x1b, 0xfd, 0x44, 0x44, 0xff, 0xfa, 0x42, 0x1f,
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    0x0, 0x20, 0x0, 0x0, 0x4, 0x0,
    /* U+0054 "T" */
    0x3f, 0xff, 0xff, 0xb, 0xff, 0xff, 0xfd, 0xbf,
    0xff, 0xff, 0xc2, 0x1f, 0xff, 0xa8, 0x10, 0xbf,
    0x81, 0x41, 0x7, 0xfc, 0x14, 0x10, 0xbf, 0x81,
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    0x0, 0x4, 0x0, 0x0, 0x0, 0x40, 0x0,
    /* U+0055 "U" */
    0x3f, 0x0, 0x1e, 0x3, 0xf8, 0x3, 0xfc, 0x7f,
    0xc0, 0x3f, 0xe7, 0xfc, 0x3, 0xfd, 0xbf, 0x40,
    0x3f, 0xcb, 0xf8, 0x3, 0xfd, 0xff, 0xc0, 0x7f,
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    0x0, 0x0,
    /* U+0056 "V" */
    0x3f, 0x0, 0x1e, 0x1f, 0xd0, 0x1f, 0xdb, 0xf4,
    0xf, 0xf2, 0xfe, 0x3, 0xf8, 0x6f, 0xc0, 0xfe,
    0x17, 0xf0, 0xbf, 0x81, 0xff, 0x3f, 0xe0, 0x5f,
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    0x0, 0x44, 0x0,
    /* U+0057 "W" */
    0x1d, 0x0, 0x0, 0x2, 0xc2, 0xfc, 0x7, 0xf0,
    0x2f, 0x8b, 0xf0, 0x3f, 0xe1, 0xff, 0x2f, 0xd0,
    0xff, 0x43, 0xfc, 0x7f, 0x3, 0xfe, 0xf, 0xf0,
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    0x4, 0x0, 0x0,
    /* U+0058 "X" */
    0x2f, 0x40, 0x2c, 0x3f, 0xc1, 0xfc, 0x1f, 0xfb,
    0xfe, 0x1f, 0xff, 0xf9, 0x1f, 0xff, 0xf1, 0x12,
    0xff, 0xd0, 0x0, 0xff, 0xc0, 0x2, 0xff, 0xc0,
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    0x0, 0x1, 0x40, 0x0,
    /* U+0059 "Y" */
    0xd, 0x0, 0x1d, 0x1f, 0xc0, 0x2f, 0xcf, 0xf8,
    0x1f, 0xf5, 0xff, 0xc7, 0xf9, 0x1f, 0xff, 0xfc,
    0x41, 0xff, 0xfd, 0x10, 0x7f, 0xfd, 0x4, 0x27,
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    0x0,
    /* U+005A "Z" */
    0x0, 0x0, 0x0, 0x0, 0xe9, 0x39, 0xf0, 0x3f,
    0xff, 0xff, 0x87, 0xff, 0xff, 0xfc, 0xf, 0xff,
    0xff, 0x80, 0x0, 0xbf, 0xd4, 0x0, 0x2f, 0xf5,
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    0x0, 0x40, 0x0, 0x0, 0x4, 0x0,
    /* U+005B "[" */
    0xf, 0xd0, 0x7f, 0xf8, 0x7f, 0xec, 0x7f, 0x88,
    0x7f, 0x88, 0x3f, 0x8, 0x7f, 0x8, 0xbf, 0x88,
    0xbf, 0x84, 0x3f, 0x80, 0x7f, 0x80, 0x7f, 0x80,
    0x3f, 0x80, 0x3f, 0x40, 0x7f, 0xd0, 0x3f, 0xfc,
    0x3f, 0xfc, 0x11, 0x48, 0x10, 0x4, 0x10, 0x4,
    /* U+005C "\\" */
    0x70, 0x1, 0xd0, 0x3, 0x80, 0xa, 0x0, 0x1c,
    0x0, 0x78, 0x0, 0xe0, 0x5, 0xc0, 0x17, 0x80,
    0xf, 0x0, 0x6d, 0x0, 0x34, 0x0, 0xa0, 0x2,
    0xd0, 0x5, 0x80, 0x1, 0x0, 0x4, 0x0, 0x10,
    0x0, 0x40, 0x0,
    /* U+005D "]" */
    0x1e, 0x42, 0xff, 0xc7, 0xff, 0x57, 0xfc, 0x43,
    0xf5, 0xf, 0xd4, 0xbf, 0x2, 0xfd, 0x7, 0xf0,
    0x1f, 0xc0, 0xbf, 0x42, 0xfe, 0xb, 0xf0, 0x1f,
    0xc2, 0xff, 0xaf, 0xfd, 0xaf, 0x84, 0x8, 0x10,
    0x10, 0x0, 0x40, 0x1, 0x0, 0x4, 0x0, 0x10,
    0x0, 0x40, 0x1, 0x0, 0x4, 0x0, 0x10, 0x0,
    /* U+005E "^" */
    0x0, 0x0, 0x0, 0x7f, 0x80, 0xf, 0xfe, 0x2,
    0xf7, 0xf8, 0x79, 0x17, 0xe9, 0x1, 0x42, 0x80,
    0x14, 0x14, 0x1, 0x11, 0x0, 0x10, 0x10, 0x1,
    0x1, 0x0, 0x10, 0x10, 0x1, 0x1, 0x0, 0x0,
    0x0, 0x0, 0x0, 0x0, 0x0, 0x0,
    /* U+005F "_" */
    0x0, 0x1, 0x0, 0xff, 0xff, 0xdb, 0xff, 0xfe,
    0x48, 0x34, 0x50, 0x10, 0x41, 0x0, 0x40, 0x5,
    0x0, 0x0, 0x0, 0x1, 0x0, 0x0,
    /* U+0061 "a" */
    0x1, 0xfe, 0x70, 0xb, 0xff, 0xf8, 0x2f, 0xab,
    0xfd, 0x2, 0x1, 0xff, 0x1, 0xbf, 0xff, 0x1f,
    0xff, 0xfd, 0xbf, 0xd3, 0xfd, 0xff, 0x83, 0xfe,
    0xbf, 0xef, 0xfe, 0x5f, 0xfd, 0xfe, 0x43, 0x84,
    0x51, 0x42, 0x4, 0x1, 0x1, 0x4, 0x2, 0x1,
    0x8, 0x1, 0x2, 0x0, 0x0, 0x1, 0x0, 0x0,
    /* U+0062 "b" */
    0xd, 0x0, 0x0, 0x3f, 0x0, 0x0, 0xbf, 0x0,
    0x0, 0xbf, 0x40, 0x0, 0x7f, 0xff, 0xf0, 0x7f,
    0xff, 0xf8, 0x7f, 0xff, 0xfd, 0x7f, 0xca, 0xfe,
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    0x0, 0x4,
    /* U+0063 "c" */
    0x0, 0x3d, 0x0, 0xb, 0xff, 0xe0, 0x1f, 0xff,
    0xfc, 0x7f, 0xc4, 0xbc, 0x3f, 0x44, 0x4, 0x7f,
    0x40, 0x4, 0xff, 0x40, 0x0, 0x7f, 0xd1, 0xb4,
    0x4f, 0xff, 0xf8, 0x87, 0xff, 0xf8, 0x82, 0x5a,
    0x44, 0x1, 0x2, 0x4, 0x1, 0x1, 0x4, 0x2,
    0x1, 0x0, 0x0, 0x1, 0x0, 0x0, 0x2, 0x0,
    /* U+0064 "d" */
    0x0, 0x0, 0x78, 0x0, 0x0, 0x3f, 0x80, 0x0,
    0xf, 0xf0, 0x0, 0x3, 0xf8, 0x3, 0xcb, 0xfe,
    0x3, 0xff, 0xff, 0x83, 0xff, 0xff, 0xd1, 0xfe,
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    0x0, 0x0,
    /* U+0065 "e" */
    0x0, 0x7e, 0x0, 0xf, 0xff, 0xe0, 0x3f, 0xff,
    0xf8, 0x7f, 0xc5, 0xfd, 0xbf, 0xc2, 0xfd, 0xff,
    0xff, 0xfd, 0x7f, 0xc2, 0x84, 0x3f, 0x40, 0x0,
    0x7f, 0xfb, 0xf8, 0x4b, 0xff, 0xf9, 0x45, 0x3a,
    0x11, 0x0, 0x20, 0x0, 0x10, 0x20, 0x1, 0x10,
    0x10, 0x0, 0x50, 0x0, 0x0, 0x0, 0x0, 0x0,
    /* U+0066 "f" */
    0x1, 0xbe, 0x1, 0xff, 0xc0, 0xbf, 0x50, 0x3f,
    0xd0, 0x1f, 0xf8, 0x2f, 0xff, 0xd9, 0xff, 0xf9,
    0x3f, 0xe1, 0x4f, 0xf0, 0x53, 0xfc, 0x14, 0xff,
    0x1, 0x3f, 0xc0, 0xb, 0xf0, 0x3, 0xfc, 0x0,
    0x9d, 0x0, 0x2, 0x40, 0x0, 0x40, 0x0, 0x10,
    0x0, 0x4, 0x0, 0x0, 0x0,
    /* U+0067 "g" */
    0x7, 0xf0, 0xbc, 0x7, 0xff, 0xbf, 0x82, 0xff,
    0xff, 0xe1, 0xff, 0x8b, 0xf8, 0x7f, 0x10, 0xff,
    0x1f, 0xd4, 0x3f, 0xcf, 0xf8, 0x1f, 0xf2, 0xff,
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    0x40,
    /* U+0068 "h" */
    0x0, 0x0, 0x0, 0xf, 0xc0, 0x0, 0x7, 0xf4,
    0x0, 0x2, 0xfd, 0x0, 0x0, 0x7f, 0xc0, 0x0,
    0x2f, 0xff, 0xff, 0x7, 0xff, 0xff, 0xc0, 0xff,
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    0x0,
    /* U+0069 "i" */
    0x3d, 0x3, 0xf0, 0xe, 0x0, 0x40, 0x1f, 0x3,
    0xf4, 0x7f, 0x8b, 0xf8, 0x7f, 0xc3, 0xfc, 0x7f,
    0xcb, 0xf4, 0xbf, 0x85, 0xfc, 0x8, 0x40, 0x84,
    0x0, 0x40, 0x4, 0x0, 0x0,
    /* U+006A "j" */
    0x0, 0x50, 0x2f, 0xc0, 0xbe, 0x0, 0x70, 0x0,
    0x40, 0xf, 0x80, 0x7f, 0x82, 0xfd, 0xb, 0xf4,
    0x1f, 0xd0, 0x3f, 0x81, 0xff, 0x7, 0xf8, 0xf,
    0xd0, 0x7f, 0x43, 0xfc, 0x3f, 0xfa, 0xff, 0xd5,
    0xd1, 0x2, 0x4, 0x44, 0x20, 0x10, 0x40, 0x1,
    0x0, 0x4, 0x0, 0x10, 0x0, 0x40, 0x2, 0x0,
    0x0,
    /* U+006B "k" */
    0x9, 0x0, 0x0, 0xbc, 0x0, 0xb, 0xf0, 0x0,
    0x1f, 0xe0, 0x0, 0xbf, 0x82, 0xd2, 0xfe, 0x1f,
    0x47, 0xff, 0xfc, 0x2f, 0xff, 0xe0, 0xbf, 0xff,
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    0x0, 0x0, 0x0, 0x0, 0x0, 0x4, 0x0, 0x0,
    /* U+006C "l" */
    0x1d, 0xf, 0xcb, 0xf3, 0xfc, 0xbf, 0x9f, 0xdf,
    0xf2, 0xfe, 0xbf, 0xaf, 0xdb, 0xf7, 0xfe, 0xbf,
    0xab, 0x48, 0x50, 0x14, 0x4, 0x11, 0x0, 0x80,
    /* U+006D "m" */
    0x0, 0x0, 0x0, 0x0, 0x1, 0xd2, 0x1f, 0x45,
    0x0, 0xb, 0xee, 0xff, 0xba, 0xf9, 0x2f, 0xff,
    0xff, 0xff, 0xfc, 0x7f, 0xff, 0xff, 0xff, 0xf1,
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    0x0, 0x0, 0x0, 0x0,
    /* U+006E "n" */
    0x2c, 0x7, 0xe0, 0x7f, 0xff, 0xf4, 0xbf, 0xeb,
    0xfd, 0x7f, 0x87, 0xfd, 0x7f, 0x81, 0xff, 0xbf,
    0x81, 0xff, 0xff, 0x42, 0xff, 0x7f, 0x42, 0xff,
    0x7f, 0xc2, 0xff, 0x7f, 0x81, 0x7e, 0x41, 0x0,
    0x19, 0x41, 0x0, 0x5, 0x1, 0x0, 0x4, 0x1,
    0x0, 0x0, 0x1, 0x0, 0x0, 0x1, 0x0, 0x0,
    0x1, 0x0, 0x0,
    /* U+006F "o" */
    0x2, 0xff, 0xd0, 0x7, 0xff, 0xff, 0x2, 0xfd,
    0xaf, 0xe0, 0xfe, 0x13, 0xfc, 0x3f, 0x84, 0xff,
    0x3f, 0xe1, 0x7f, 0xcf, 0xfc, 0x4f, 0xf2, 0xbf,
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    0x0, 0x0, 0x0,
    /* U+0070 "p" */
    0x0, 0x1, 0x0, 0x1f, 0xaf, 0xf8, 0x7, 0xff,
    0xff, 0x80, 0xff, 0xff, 0xf8, 0xbf, 0x48, 0xfe,
    0x2f, 0xd1, 0x3f, 0xd7, 0xfc, 0xf, 0xf5, 0xff,
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    0x40, 0x4, 0x0, 0x20, 0x0, 0x0,
    /* U+0071 "q" */
    0xb, 0xff, 0xf4, 0x7, 0xff, 0xff, 0x4b, 0xff,
    0xbf, 0xf2, 0xff, 0xb, 0xf8, 0xff, 0x42, 0xfe,
    0x3f, 0xd0, 0xbf, 0xcb, 0xff, 0xbf, 0xe1, 0xff,
    0xff, 0xf8, 0x2b, 0xff, 0xfe, 0x4, 0xcf, 0xff,
    0xc0, 0x21, 0x1f, 0xf0, 0x4, 0x47, 0xf8, 0x1,
    0x10, 0xfc, 0x0, 0x40, 0x5, 0x0, 0x10, 0x0,
    0x40, 0x8, 0x0, 0x10, 0x0, 0x0, 0x4, 0x0,
    /* U+0072 "r" */
    0x0, 0x0, 0x7, 0x4b, 0xe7, 0xff, 0xfb, 0xff,
    0xfd, 0xbf, 0xf8, 0x4f, 0xf0, 0x17, 0xf8, 0x5,
    0xff, 0x1, 0xbf, 0xc0, 0x7f, 0xd0, 0x6, 0xe4,
    0x0, 0x41, 0x0, 0x10, 0x80, 0x4, 0x20, 0x1,
    0x8, 0x0, 0x42, 0x0, 0x0, 0x0, 0x4, 0x0,
    0x0,
    /* U+0073 "s" */
    0x7, 0xff, 0xc0, 0x7f, 0xff, 0xd3, 0xfd, 0x2,
    0x5f, 0xf8, 0x4, 0x1f, 0xff, 0xe0, 0x26, 0xff,
    0xd0, 0x40, 0xbf, 0xdf, 0x90, 0xfe, 0xbf, 0xff,
    0xf9, 0x2f, 0xfc, 0x10, 0x4, 0x10, 0x40, 0x20,
    0x41, 0x0, 0x1, 0x4, 0x0, 0x4, 0x0, 0x4,
    0x10, 0x0, 0x0, 0x0, 0x0, 0x0, 0x0, 0x0,
    0x0, 0x0,
    /* U+0074 "t" */
    0x1, 0xd0, 0x0, 0x3f, 0x80, 0xb, 0xfc, 0x0,
    0xff, 0x80, 0x1f, 0xff, 0x8b, 0xff, 0xfc, 0x4f,
    0xfc, 0x84, 0xbf, 0x88, 0x47, 0xf4, 0x84, 0x7f,
    0x80, 0x4b, 0xf8, 0x8, 0xbf, 0xe0, 0x7, 0xff,
    0xc0, 0x4b, 0xf8, 0x4, 0x24, 0x40, 0x40, 0x4,
    0x4, 0x10, 0x80, 0x0, 0x8, 0x0, 0x10, 0x80,
    0x40, 0x8,
    /* U+0075 "u" */
    0x38, 0x0, 0x38, 0x2f, 0xe0, 0x7f, 0xf, 0xf4,
    0x2f, 0xe2, 0xfd, 0xb, 0xfc, 0xbf, 0x41, 0xfe,
    0x1f, 0xd0, 0x7f, 0xcb, 0xf8, 0x3f, 0xf2, 0xff,
    0xef, 0xfc, 0xaf, 0xff, 0xff, 0x13, 0xfe, 0xff,
    0x44, 0x2, 0x0, 0x81, 0x0, 0x80, 0x10, 0x40,
    0x10, 0x0, 0x50, 0x4, 0x0, 0x0, 0x2, 0x0,
    0x0, 0x0, 0x80, 0x0, 0x0, 0x10, 0x0, 0x0,
    /* U+0076 "v" */
    0xb4, 0x2, 0x83, 0xf0, 0x1f, 0xcb, 0xf0, 0x7f,
    0x5f, 0xc2, 0xf9, 0x3f, 0xff, 0xc4, 0xff, 0xff,
    0x15, 0xff, 0xf4, 0x57, 0xff, 0xd1, 0x47, 0xff,
    0x0, 0x2f, 0xf4, 0x0, 0x42, 0x50, 0x1, 0x4,
    0x40, 0x4, 0x10, 0x0, 0x20, 0x40, 0x0, 0x41,
    0x0, 0x0, 0x4, 0x0, 0x4, 0x0, 0x0,
    /* U+0077 "w" */
    0x0, 0x0, 0x0, 0x0, 0x1d, 0x0, 0xf4, 0x7,
    0x4b, 0xe0, 0xff, 0x43, 0xf5, 0xfc, 0x3f, 0xf0,
    0xfd, 0x7f, 0xff, 0xff, 0xfe, 0xf, 0xff, 0xff,
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    0x0,
    /* U+0078 "x" */
    0x7e, 0xf, 0x47, 0xff, 0xfc, 0x6f, 0xff, 0xc0,
    0xff, 0xe4, 0xf, 0xfc, 0x40, 0xff, 0xf4, 0x3f,
    0xff, 0xb, 0xff, 0xf8, 0xbf, 0x8f, 0xc9, 0x84,
    0xb8, 0x84, 0x47, 0x0, 0x40, 0x20, 0x44, 0x42,
    0x0, 0x0, 0x20, 0x0, 0x2, 0x0, 0x0, 0x20,
    0x0, 0x2, 0x0,
    /* U+0079 "y" */
    0x78, 0x3, 0xf2, 0xf8, 0x1f, 0xcb, 0xf0, 0xfe,
    0x1f, 0xff, 0xf8, 0x3f, 0xff, 0xd0, 0x7f, 0xfd,
    0x40, 0xff, 0xf9, 0x3, 0xff, 0xe4, 0x3, 0xff,
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    0x80, 0x0,
    /* U+007A "z" */
    0xe, 0xbf, 0x50, 0xf, 0xff, 0xfc, 0xa, 0xff,
    0xf8, 0x4, 0x3f, 0xd4, 0x0, 0xbf, 0x84, 0x3,
    0xfc, 0x4, 0xb, 0xfd, 0x0, 0x2f, 0xff, 0xf4,
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    0x0,
    /* U+007B "{" */
    0x0, 0xb8, 0x2, 0xfe, 0x7, 0xfd, 0x7, 0xe1,
    0x3, 0xf1, 0x3, 0xd1, 0xb, 0xe0, 0x3f, 0xe0,
    0xbf, 0x80, 0x7f, 0xd0, 0x1b, 0xe0, 0x13, 0xe0,
    0x7, 0xe0, 0xb, 0xe0, 0xb, 0xf4, 0xb, 0xfd,
    0x4, 0xfd, 0x0, 0x20, 0x0, 0x10, 0x0, 0x10,
    0x0, 0x10, 0x0, 0x10, 0x0, 0x10, 0x0, 0x20,
    0x0, 0x0,
    /* U+007C "|" */
    0x24, 0x7c, 0x7c, 0x7c, 0xbd, 0xfd, 0xbd, 0xbc,
    0xbd, 0x7e, 0x7d, 0xbc, 0x7c, 0xbc, 0xbc, 0xbd,
    0xfc, 0x7c, 0x3a, 0x21, 0x21, 0x10, 0x10, 0x10,
    /* U+007D "}" */
    0x10, 0x0, 0x3e, 0x0, 0x7f, 0xd0, 0x1f, 0xe0,
    0xb, 0xe0, 0x7, 0xf0, 0xf, 0xe0, 0xf, 0xe0,
    0x6, 0xfe, 0x1, 0xff, 0x3, 0xf8, 0x7, 0xd4,
    0xb, 0xd4, 0xb, 0xd4, 0xf, 0xd4, 0xf, 0xe4,
    0xbf, 0xc0, 0x3f, 0x80, 0x20, 0x40, 0x20, 0x40,
    0x20, 0x40, 0x10, 0x0, 0x20, 0x0,
    /* U+007E "~" */
    0xf, 0xb4, 0x0, 0x47, 0xff, 0xff, 0xfd, 0x3c,
    0x6f, 0xff, 0xc2, 0x0, 0x22, 0x8, 0x10, 0x1,
    0x0, 0x41, 0x0, 0x10, 0x4, 0x0, 0x1, 0x0,
    0x40, 0x0, 0x10, 0x8, 0x0, 0x1, 0x0, 0x0,
    /* U+00C6 "Æ" */
    0x0, 0xf, 0xff, 0xff, 0xfe, 0x0, 0x1f, 0xff,
    0xff, 0xff, 0xc0, 0x7, 0xff, 0xff, 0x5b, 0x20,
    0x3, 0xfe, 0xff, 0xc0, 0x44, 0x0, 0xfd, 0x3f,
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    0x0, 0x0, 0x0, 0x0,
    /* U+00E6 "æ" */
    0x0, 0x0, 0x0, 0x0, 0x0, 0x2, 0xe4, 0xb,
    0xe4, 0x1, 0xbf, 0xff, 0xff, 0xf4, 0xf, 0xf9,
    0xff, 0xff, 0xf4, 0x2, 0x3, 0xfe, 0xf, 0xf0,
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    0x80, 0x0, 0x0, 0x0, 0x0, 0x0
};
/*---------------------
 *  GLYPH DESCRIPTION
 *--------------------*/
static const lv_font_fmt_txt_glyph_dsc_t creepy_glyph_dsc[] = {
    {.bitmap_index = 0, .adv_w = 0, .box_w = 0, .box_h = 0, .ofs_x = 0, .ofs_y = 0} /* id = 0 reserved */,
    {.bitmap_index = 0, .adv_w = 128, .box_w = 0, .box_h = 0, .ofs_x = 0, .ofs_y = 0},
    {.bitmap_index = 0, .adv_w = 80, .box_w = 5, .box_h = 17, .ofs_x = 0, .ofs_y = -3},
    {.bitmap_index = 22, .adv_w = 114, .box_w = 7, .box_h = 10, .ofs_x = 0, .ofs_y = 4},
    {.bitmap_index = 40, .adv_w = 232, .box_w = 15, .box_h = 19, .ofs_x = 0, .ofs_y = -5},
    {.bitmap_index = 112, .adv_w = 199, .box_w = 13, .box_h = 20, .ofs_x = 0, .ofs_y = -6},
    {.bitmap_index = 177, .adv_w = 320, .box_w = 20, .box_h = 19, .ofs_x = 0, .ofs_y = -5},
    {.bitmap_index = 272, .adv_w = 223, .box_w = 14, .box_h = 20, .ofs_x = 0, .ofs_y = -6},
    {.bitmap_index = 342, .adv_w = 58, .box_w = 4, .box_h = 9, .ofs_x = 0, .ofs_y = 4},
    {.bitmap_index = 351, .adv_w = 94, .box_w = 6, .box_h = 22, .ofs_x = 0, .ofs_y = -8},
    {.bitmap_index = 384, .adv_w = 92, .box_w = 6, .box_h = 20, .ofs_x = 0, .ofs_y = -6},
    {.bitmap_index = 414, .adv_w = 131, .box_w = 8, .box_h = 13, .ofs_x = 0, .ofs_y = 1},
    {.bitmap_index = 440, .adv_w = 193, .box_w = 12, .box_h = 17, .ofs_x = 0, .ofs_y = -5},
    {.bitmap_index = 491, .adv_w = 85, .box_w = 6, .box_h = 11, .ofs_x = 0, .ofs_y = -7},
    {.bitmap_index = 508, .adv_w = 127, .box_w = 8, .box_h = 10, .ofs_x = 0, .ofs_y = -2},
    {.bitmap_index = 528, .adv_w = 75, .box_w = 5, .box_h = 7, .ofs_x = 0, .ofs_y = -3},
    {.bitmap_index = 537, .adv_w = 111, .box_w = 7, .box_h = 17, .ofs_x = 0, .ofs_y = -3},
    {.bitmap_index = 567, .adv_w = 209, .box_w = 13, .box_h = 20, .ofs_x = 0, .ofs_y = -6},
    {.bitmap_index = 632, .adv_w = 130, .box_w = 8, .box_h = 17, .ofs_x = 0, .ofs_y = -3},
    {.bitmap_index = 666, .adv_w = 196, .box_w = 13, .box_h = 19, .ofs_x = 0, .ofs_y = -5},
    {.bitmap_index = 728, .adv_w = 190, .box_w = 12, .box_h = 17, .ofs_x = 0, .ofs_y = -3},
    {.bitmap_index = 779, .adv_w = 210, .box_w = 13, .box_h = 19, .ofs_x = 0, .ofs_y = -5},
    {.bitmap_index = 841, .adv_w = 185, .box_w = 12, .box_h = 20, .ofs_x = 0, .ofs_y = -6},
    {.bitmap_index = 901, .adv_w = 207, .box_w = 13, .box_h = 19, .ofs_x = 0, .ofs_y = -5},
    {.bitmap_index = 963, .adv_w = 197, .box_w = 13, .box_h = 18, .ofs_x = 0, .ofs_y = -4},
    {.bitmap_index = 1022, .adv_w = 203, .box_w = 13, .box_h = 20, .ofs_x = 0, .ofs_y = -6},
    {.bitmap_index = 1087, .adv_w = 207, .box_w = 13, .box_h = 18, .ofs_x = 0, .ofs_y = -4},
    {.bitmap_index = 1146, .adv_w = 73, .box_w = 5, .box_h = 15, .ofs_x = 0, .ofs_y = -5},
    {.bitmap_index = 1165, .adv_w = 89, .box_w = 6, .box_h = 16, .ofs_x = 0, .ofs_y = -6},
    {.bitmap_index = 1189, .adv_w = 196, .box_w = 13, .box_h = 16, .ofs_x = 0, .ofs_y = -4},
    {.bitmap_index = 1241, .adv_w = 206, .box_w = 13, .box_h = 14, .ofs_x = 0, .ofs_y = -4},
    {.bitmap_index = 1287, .adv_w = 198, .box_w = 13, .box_h = 14, .ofs_x = 0, .ofs_y = -4},
    {.bitmap_index = 1333, .adv_w = 181, .box_w = 12, .box_h = 20, .ofs_x = 0, .ofs_y = -6},
    {.bitmap_index = 1393, .adv_w = 303, .box_w = 19, .box_h = 23, .ofs_x = 0, .ofs_y = -9},
    {.bitmap_index = 1503, .adv_w = 218, .box_w = 14, .box_h = 20, .ofs_x = 0, .ofs_y = -5},
    {.bitmap_index = 1573, .adv_w = 215, .box_w = 14, .box_h = 20, .ofs_x = 0, .ofs_y = -6},
    {.bitmap_index = 1643, .adv_w = 232, .box_w = 15, .box_h = 20, .ofs_x = 0, .ofs_y = -6},
    {.bitmap_index = 1718, .adv_w = 228, .box_w = 15, .box_h = 20, .ofs_x = 0, .ofs_y = -6},
    {.bitmap_index = 1793, .adv_w = 196, .box_w = 13, .box_h = 21, .ofs_x = 0, .ofs_y = -7},
    {.bitmap_index = 1862, .adv_w = 177, .box_w = 11, .box_h = 19, .ofs_x = 0, .ofs_y = -5},
    {.bitmap_index = 1915, .adv_w = 237, .box_w = 15, .box_h = 20, .ofs_x = 0, .ofs_y = -6},
    {.bitmap_index = 1990, .adv_w = 233, .box_w = 15, .box_h = 19, .ofs_x = 0, .ofs_y = -5},
    {.bitmap_index = 2062, .adv_w = 92, .box_w = 6, .box_h = 19, .ofs_x = 0, .ofs_y = -5},
    {.bitmap_index = 2091, .adv_w = 187, .box_w = 12, .box_h = 21, .ofs_x = 0, .ofs_y = -7},
    {.bitmap_index = 2154, .adv_w = 216, .box_w = 14, .box_h = 20, .ofs_x = 0, .ofs_y = -6},
    {.bitmap_index = 2224, .adv_w = 181, .box_w = 12, .box_h = 20, .ofs_x = 0, .ofs_y = -6},
    {.bitmap_index = 2284, .adv_w = 272, .box_w = 17, .box_h = 21, .ofs_x = 0, .ofs_y = -6},
    {.bitmap_index = 2374, .adv_w = 223, .box_w = 14, .box_h = 20, .ofs_x = 0, .ofs_y = -6},
    {.bitmap_index = 2444, .adv_w = 259, .box_w = 16, .box_h = 20, .ofs_x = 0, .ofs_y = -6},
    {.bitmap_index = 2524, .adv_w = 218, .box_w = 14, .box_h = 21, .ofs_x = 0, .ofs_y = -6},
    {.bitmap_index = 2598, .adv_w = 242, .box_w = 15, .box_h = 25, .ofs_x = 0, .ofs_y = -11},
    {.bitmap_index = 2692, .adv_w = 224, .box_w = 14, .box_h = 20, .ofs_x = 0, .ofs_y = -6},
    {.bitmap_index = 2762, .adv_w = 202, .box_w = 13, .box_h = 19, .ofs_x = 0, .ofs_y = -5},
    {.bitmap_index = 2824, .adv_w = 220, .box_w = 14, .box_h = 18, .ofs_x = 0, .ofs_y = -4},
    {.bitmap_index = 2887, .adv_w = 220, .box_w = 14, .box_h = 21, .ofs_x = 0, .ofs_y = -7},
    {.bitmap_index = 2961, .adv_w = 202, .box_w = 13, .box_h = 18, .ofs_x = 0, .ofs_y = -4},
    {.bitmap_index = 3020, .adv_w = 293, .box_w = 19, .box_h = 19, .ofs_x = 0, .ofs_y = -5},
    {.bitmap_index = 3111, .adv_w = 190, .box_w = 12, .box_h = 20, .ofs_x = 0, .ofs_y = -6},
    {.bitmap_index = 3171, .adv_w = 202, .box_w = 13, .box_h = 20, .ofs_x = 0, .ofs_y = -6},
    {.bitmap_index = 3236, .adv_w = 215, .box_w = 14, .box_h = 20, .ofs_x = 0, .ofs_y = -5},
    {.bitmap_index = 3306, .adv_w = 119, .box_w = 8, .box_h = 20, .ofs_x = 0, .ofs_y = -6},
    {.bitmap_index = 3346, .adv_w = 110, .box_w = 7, .box_h = 20, .ofs_x = 0, .ofs_y = -6},
    {.bitmap_index = 3381, .adv_w = 109, .box_w = 7, .box_h = 27, .ofs_x = 0, .ofs_y = -13},
    {.bitmap_index = 3429, .adv_w = 158, .box_w = 10, .box_h = 15, .ofs_x = 0, .ofs_y = -1},
    {.bitmap_index = 3467, .adv_w = 170, .box_w = 11, .box_h = 8, .ofs_x = 0, .ofs_y = -9},
    {.bitmap_index = 3489, .adv_w = 193, .box_w = 12, .box_h = 16, .ofs_x = 0, .ofs_y = -6},
    {.bitmap_index = 3537, .adv_w = 194, .box_w = 12, .box_h = 22, .ofs_x = 0, .ofs_y = -8},
    {.bitmap_index = 3603, .adv_w = 180, .box_w = 12, .box_h = 16, .ofs_x = 0, .ofs_y = -6},
    {.bitmap_index = 3651, .adv_w = 198, .box_w = 13, .box_h = 25, .ofs_x = 0, .ofs_y = -11},
    {.bitmap_index = 3733, .adv_w = 187, .box_w = 12, .box_h = 16, .ofs_x = 0, .ofs_y = -6},
    {.bitmap_index = 3781, .adv_w = 141, .box_w = 9, .box_h = 20, .ofs_x = 0, .ofs_y = -6},
    {.bitmap_index = 3826, .adv_w = 197, .box_w = 13, .box_h = 20, .ofs_x = 0, .ofs_y = -10},
    {.bitmap_index = 3891, .adv_w = 199, .box_w = 13, .box_h = 20, .ofs_x = 0, .ofs_y = -5},
    {.bitmap_index = 3956, .adv_w = 87, .box_w = 6, .box_h = 19, .ofs_x = 0, .ofs_y = -5},
    {.bitmap_index = 3985, .adv_w = 111, .box_w = 7, .box_h = 28, .ofs_x = 0, .ofs_y = -13},
    {.bitmap_index = 4034, .adv_w = 172, .box_w = 11, .box_h = 23, .ofs_x = 0, .ofs_y = -9},
    {.bitmap_index = 4098, .adv_w = 79, .box_w = 5, .box_h = 19, .ofs_x = 0, .ofs_y = -5},
    {.bitmap_index = 4122, .adv_w = 300, .box_w = 19, .box_h = 21, .ofs_x = 0, .ofs_y = -10},
    {.bitmap_index = 4222, .adv_w = 193, .box_w = 12, .box_h = 17, .ofs_x = 0, .ofs_y = -7},
    {.bitmap_index = 4273, .adv_w = 199, .box_w = 13, .box_h = 18, .ofs_x = 0, .ofs_y = -8},
    {.bitmap_index = 4332, .adv_w = 203, .box_w = 13, .box_h = 19, .ofs_x = 0, .ofs_y = -8},
    {.bitmap_index = 4394, .adv_w = 199, .box_w = 13, .box_h = 17, .ofs_x = 0, .ofs_y = -7},
    {.bitmap_index = 4450, .adv_w = 144, .box_w = 9, .box_h = 18, .ofs_x = 0, .ofs_y = -7},
    {.bitmap_index = 4491, .adv_w = 179, .box_w = 11, .box_h = 18, .ofs_x = 0, .ofs_y = -8},
    {.bitmap_index = 4541, .adv_w = 148, .box_w = 10, .box_h = 20, .ofs_x = 0, .ofs_y = -6},
    {.bitmap_index = 4591, .adv_w = 199, .box_w = 13, .box_h = 17, .ofs_x = 0, .ofs_y = -7},
    {.bitmap_index = 4647, .adv_w = 171, .box_w = 11, .box_h = 17, .ofs_x = 0, .ofs_y = -7},
    {.bitmap_index = 4694, .adv_w = 267, .box_w = 17, .box_h = 19, .ofs_x = 0, .ofs_y = -8},
    {.bitmap_index = 4775, .adv_w = 151, .box_w = 10, .box_h = 17, .ofs_x = 0, .ofs_y = -7},
    {.bitmap_index = 4818, .adv_w = 167, .box_w = 11, .box_h = 21, .ofs_x = 0, .ofs_y = -11},
    {.bitmap_index = 4876, .adv_w = 180, .box_w = 12, .box_h = 19, .ofs_x = 0, .ofs_y = -9},
    {.bitmap_index = 4933, .adv_w = 125, .box_w = 8, .box_h = 25, .ofs_x = 0, .ofs_y = -11},
    {.bitmap_index = 4983, .adv_w = 61, .box_w = 4, .box_h = 24, .ofs_x = 0, .ofs_y = -10},
    {.bitmap_index = 5007, .adv_w = 130, .box_w = 8, .box_h = 23, .ofs_x = 0, .ofs_y = -9},
    {.bitmap_index = 5053, .adv_w = 220, .box_w = 14, .box_h = 9, .ofs_x = 0, .ofs_y = -2},
    {.bitmap_index = 5085, .adv_w = 329, .box_w = 21, .box_h = 22, .ofs_x = 0, .ofs_y = -8},
    {.bitmap_index = 5201, .adv_w = 298, .box_w = 19, .box_h = 18, .ofs_x = 0, .ofs_y = -7}
};
/*---------------------
 *  CHARACTER MAPPING
 *--------------------*/
static const uint16_t creepy_unicode_list_2[] = {
    0x0, 0x20
};
/*Collect the unicode lists and glyph_id offsets*/
static const lv_font_fmt_txt_cmap_t creepy_cmaps[] =
{
    {
        .range_start = 32, .range_length = 64, .glyph_id_start = 1,
        .unicode_list = NULL, .glyph_id_ofs_list = NULL, .list_length = 0, .type = LV_FONT_FMT_TXT_CMAP_FORMAT0_TINY
    },
    {
        .range_start = 97, .range_length = 30, .glyph_id_start = 65,
        .unicode_list = NULL, .glyph_id_ofs_list = NULL, .list_length = 0, .type = LV_FONT_FMT_TXT_CMAP_FORMAT0_TINY
    },
    {
        .range_start = 198, .range_length = 33, .glyph_id_start = 95,
        .unicode_list = creepy_unicode_list_2, .glyph_id_ofs_list = NULL, .list_length = 2, .type = LV_FONT_FMT_TXT_CMAP_SPARSE_TINY
    }
};
/*-----------------
 *    KERNING
 *----------------*/
/*Pair left and right glyphs for kerning*/
static const uint8_t creepy_kern_pair_glyph_ids[] =
{
    2, 4,
    2, 12,
    2, 14,
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    96, 96
};
/* Kerning between the respective left and right glyphs
 * 4.4 format which needs to scaled with `kern_scale`*/
static const int8_t creepy_kern_pair_values[] =
{
    -11, -10, -11, -9, -10, -4, -4, -7,
    -4, -9, -29, -8, -15, -7, -11, -23,
    -14, -10, -17, -14, -19, -14, -39, -9,
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    -10, -24, -15, -8
};
/*Collect the kern pair's data in one place*/
static const lv_font_fmt_txt_kern_pair_t creepy_kern_pairs =
{
    .glyph_ids = creepy_kern_pair_glyph_ids,
    .values = creepy_kern_pair_values,
    .pair_cnt = 2732,
    .glyph_ids_size = 0
};
/*--------------------
 *  ALL CUSTOM DATA
 *--------------------*/
/*Store all the custom data of the font*/
static lv_font_fmt_txt_glyph_cache_t creepy_cache;
static const lv_font_fmt_txt_dsc_t creepy_font_dsc = {
    .glyph_bitmap = creepy_glyph_bitmap,
    .glyph_dsc = creepy_glyph_dsc,
    .cmaps = creepy_cmaps,
    .kern_dsc = &creepy_kern_pairs,
    .kern_scale = 16,
    .cmap_num = 3,
    .bpp = 2,
    .kern_classes = 0,
    .bitmap_format = 0,
    .cache = &creepy_cache
};
/*-----------------
 *  PUBLIC FONT
 *----------------*/
/*Initialize a public general font descriptor*/
const lv_font_t creepy = {
    .get_glyph_dsc = lv_font_get_glyph_dsc_fmt_txt,    /*Function pointer to get glyph's data*/
    .get_glyph_bitmap = lv_font_get_bitmap_fmt_txt,    /*Function pointer to get glyph's bitmap*/
    .line_height = 28,          /*The maximum line height required by the font*/
    .base_line = 13,             /*Baseline measured from the bottom of the line*/

    .subpx = LV_FONT_SUBPX_NONE,
    .underline_position = -1,
    .underline_thickness = 1,
    .dsc = &creepy_font_dsc,          /*The custom font data. Will be accessed by `get_glyph_bitmap/dsc` */
};
#endif

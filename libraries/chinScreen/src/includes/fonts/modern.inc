/*******************************************************************************
 * Size: 18 px
 * Bpp: 2
 ******************************************************************************/


#ifdef __has_include

    #if __has_include("lvgl.h")
         #ifndef LV_LVGL_H_INCLUDE_SIMPLE
             #define LV_LVGL_H_INCLUDE_SIMPLE
         #endif
     #endif
 #endif

 #ifdef LV_LVGL_H_INCLUDE_SIMPLE
     #include "lvgl.h"
 #else
     #include "../lvgl-8.3.11/lvgl.h"
 #endif

 #ifndef MODERN
 #define MODERN 1
 #endif

 #if MODERN

/*-----------------
 *    BITMAPS
 *----------------*/
/*Store the image of the glyphs*/
static LV_ATTRIBUTE_LARGE_CONST const uint8_t modern_glyph_bitmap[] = {
    /* U+0020 " " */
    /* U+0021 "!" */
    0x11, 0x11, 0x11, 0x11, 0x11, 0x0, 0x70,
    /* U+0022 "\"" */
    0x88, 0x88, 0x88, 0x0,
    /* U+0023 "#" */
    0x0, 0x0, 0x0, 0x81, 0x40, 0x20, 0x40, 0x4,
    0x20, 0x4, 0x8, 0x1b, 0xab, 0x90, 0x80, 0x40,
    0x20, 0x50, 0x8, 0x10, 0x2a, 0xae, 0x81, 0x2,
    0x0, 0x40, 0x80, 0x20, 0x10, 0x8, 0x14, 0x0,
    0x0, 0x0,
    /* U+0024 "$" */
    0x2, 0x0, 0x1b, 0xa0, 0x52, 0x4, 0x82, 0x0,
    0x82, 0x0, 0x26, 0x0, 0x7, 0x90, 0x2, 0x18,
    0x2, 0x5, 0x2, 0x1, 0x42, 0x8, 0x2b, 0x90,
    0x2, 0x0,
    /* U+0025 "%" */
    0x68, 0x0, 0x20, 0x81, 0x8, 0x11, 0x40, 0xa1,
    0x40, 0x1, 0x40, 0x1, 0x46, 0x41, 0x41, 0x10,
    0x40, 0x45, 0x0, 0x19, 0x0,
    /* U+0026 "&" */
    0xa, 0xaa, 0x80, 0x10, 0x0, 0x2, 0x0, 0x0,
    0x4, 0x0, 0x0, 0x80, 0x0, 0x29, 0x0, 0x8,
    0x20, 0x2, 0x0, 0x41, 0x20, 0x8, 0x52, 0x0,
    0x18, 0x20, 0x2, 0x81, 0x40, 0x28, 0x6, 0x68,
    0x80,
    /* U+0027 "'" */
    0x88, 0x80,
    /* U+0028 "(" */
    0x0, 0x52, 0x14, 0x41, 0x8, 0x20, 0x82, 0x8,
    0x10, 0x40, 0x42, 0x5,
    /* U+0029 ")" */
    0x0, 0x81, 0x42, 0x8, 0x20, 0x82, 0x8, 0x20,
    0x82, 0x8, 0x21, 0x48,
    /* U+002A "*" */
    0x4, 0x0, 0x40, 0x5a, 0x50, 0x90, 0x11, 0x0,
    0x0,
    /* U+002B "+" */
    0x4, 0x2, 0x6, 0xe4, 0x20, 0x8, 0x0,
    /* U+002C "," */
    0xa, 0x25, 0x80,
    /* U+002D "-" */
    0x6a, 0x0,
    /* U+002E "." */
    0xa,
    /* U+002F "/" */
    0x0, 0x4, 0x0, 0x10, 0x2, 0x0, 0x8, 0x0,
    0x40, 0x2, 0x0, 0x4, 0x0, 0x80, 0x2, 0x0,
    0x10, 0x0, 0x80, 0x1, 0x0, 0x10, 0x0, 0x80,
    0x0, 0x0, 0x0,
    /* U+0030 "0" */
    0xa, 0xa0, 0x20, 0x8, 0x20, 0x4, 0x40, 0x2,
    0x80, 0x2, 0x80, 0x2, 0x80, 0x2, 0x80, 0x2,
    0x80, 0x2, 0x40, 0x2, 0x20, 0x4, 0x20, 0x8,
    0xa, 0xa0,
    /* U+0031 "1" */
    0x8, 0x31, 0xca, 0x28, 0x20, 0x82, 0x8, 0x20,
    0x82, 0x8,
    /* U+0032 "2" */
    0x1a, 0xa0, 0x10, 0x8, 0x80, 0x4, 0x20, 0x1,
    0x0, 0x8, 0x0, 0x14, 0x0, 0x50, 0x2, 0x0,
    0x8, 0x0, 0x20, 0x0, 0x80, 0x0, 0x80, 0x0,
    0xaa, 0xa8,
    /* U+0033 "3" */
    0xa, 0xab, 0x40, 0x0, 0x40, 0x0, 0x80, 0x0,
    0x80, 0x0, 0x40, 0x0, 0x1a, 0x0, 0x0, 0x20,
    0x0, 0x2, 0x0, 0x0, 0x80, 0x0, 0x20, 0x0,
    0x8, 0x80, 0x8, 0x6, 0xa8, 0x0,
    /* U+0034 "4" */
    0x0, 0x30, 0x0, 0x60, 0x0, 0x90, 0x2, 0x10,
    0x1, 0x10, 0x8, 0x10, 0x10, 0x10, 0x20, 0x10,
    0x6a, 0xb9, 0x0, 0x10, 0x0, 0x10, 0x0, 0x10,
    0x0, 0x10,
    /* U+0035 "5" */
    0xe, 0xa8, 0x2, 0x0, 0x0, 0x80, 0x0, 0x20,
    0x0, 0xa, 0xa0, 0x0, 0x1, 0x40, 0x0, 0x20,
    0x0, 0x1, 0x0, 0x0, 0x80, 0x0, 0x20, 0x0,
    0x14, 0x80, 0x8, 0xa, 0xa4, 0x0,
    /* U+0036 "6" */
    0x0, 0x0, 0x0, 0x6, 0x40, 0x8, 0x0, 0x8,
    0x0, 0x8, 0x0, 0x2, 0x0, 0x1, 0x0, 0x0,
    0x86, 0x90, 0x20, 0x2, 0x8, 0x0, 0x52, 0x0,
    0x8, 0x80, 0x1, 0x8, 0x2, 0x0, 0xaa, 0x0,
    /* U+0037 "7" */
    0x6a, 0xac, 0x0, 0x4, 0x0, 0x20, 0x0, 0x10,
    0x0, 0x80, 0x0, 0x80, 0x1, 0x0, 0x2, 0x0,
    0x2, 0x0, 0x5, 0x0, 0x4, 0x0, 0x8, 0x0,
    0x8, 0x0,
    /* U+0038 "8" */
    0x6, 0xa0, 0x4, 0x2, 0x1, 0x0, 0x20, 0x40,
    0x8, 0x20, 0x2, 0x5, 0x2, 0x1, 0x81, 0x81,
    0x40, 0x8, 0x80, 0x1, 0x60, 0x0, 0x18, 0x0,
    0x10, 0x80, 0x8, 0xa, 0xa8, 0x0,
    /* U+0039 "9" */
    0x6, 0xa4, 0x8, 0x0, 0x82, 0x0, 0x20, 0x80,
    0x1, 0x20, 0x0, 0x45, 0x0, 0x10, 0x2a, 0x10,
    0x0, 0x8, 0x0, 0x1, 0x0, 0x2, 0x0, 0x1,
    0x40, 0x1, 0x40, 0x6, 0x0, 0x0, 0x0, 0x0,
    /* U+003A ":" */
    0x60, 0x0, 0x70,
    /* U+003B ";" */
    0x30, 0x0, 0x32, 0x21, 0x0,
    /* U+003C "<" */
    0x0, 0x0, 0x0, 0x50, 0x5, 0x0, 0x50, 0x5,
    0x0, 0x50, 0x2, 0x0, 0x5, 0x0, 0x5, 0x0,
    0x5, 0x0, 0x5, 0x0, 0x5, 0x0, 0x0,
    /* U+003D "=" */
    0x2a, 0x82, 0xa8,
    /* U+003E ">" */
    0x0, 0x1, 0x40, 0x1, 0x40, 0x1, 0x40, 0x2,
    0x0, 0x2, 0x0, 0x2, 0x0, 0x20, 0x2, 0x0,
    0x20, 0x1, 0x40, 0x14, 0x0, 0x0, 0x0,
    /* U+003F "?" */
    0x6, 0xa8, 0x4, 0x0, 0x82, 0x0, 0x20, 0x50,
    0x4, 0x0, 0x2, 0x0, 0x1, 0x40, 0x1, 0x40,
    0x1, 0x40, 0x0, 0x80, 0x0, 0x40, 0x0, 0x0,
    0x0, 0x0, 0x0, 0x3, 0x40, 0x0,
    /* U+0040 "@" */
    0x2, 0xa0, 0x0, 0x80, 0x80, 0x20, 0x2, 0x4,
    0x0, 0x20, 0x80, 0x0, 0x48, 0x2, 0xa4, 0x80,
    0x10, 0x8, 0x1, 0xa8, 0x80, 0x0, 0x4, 0x0,
    0x0, 0x20, 0x0, 0x41, 0x40, 0x14, 0x6, 0xa8,
    0x0,
    /* U+0041 "A" */
    0x0, 0x0, 0x0, 0x4, 0x0, 0x0, 0x90, 0x0,
    0xa, 0x0, 0x1, 0x10, 0x0, 0x20, 0x40, 0x2,
    0x8, 0x0, 0x40, 0x40, 0x8, 0x2, 0x0, 0x40,
    0x20, 0x10, 0x1, 0x42, 0x0, 0x8, 0x10, 0x0,
    0x84, 0xaa, 0xa9,
    /* U+0042 "B" */
    0x2a, 0xa0, 0x4, 0x2, 0x1, 0x0, 0x20, 0x40,
    0x8, 0x10, 0x2, 0x4, 0x2, 0x1, 0x1, 0x80,
    0x40, 0x8, 0x10, 0x0, 0x44, 0x0, 0x11, 0x0,
    0x14, 0x40, 0x8, 0x2a, 0xa4, 0x0,
    /* U+0043 "C" */
    0xa, 0xa8, 0x8, 0x0, 0x81, 0x0, 0x5, 0x0,
    0x0, 0x80, 0x0, 0x20, 0x0, 0x8, 0x0, 0x2,
    0x0, 0x0, 0x80, 0x0, 0x10, 0x0, 0x1, 0x0,
    0x4, 0x80, 0x8, 0xa, 0xa8, 0x0,
    /* U+0044 "D" */
    0x2a, 0x80, 0x4, 0x5, 0x1, 0x0, 0x50, 0x40,
    0x8, 0x10, 0x0, 0x44, 0x0, 0x21, 0x0, 0x8,
    0x40, 0x2, 0x10, 0x0, 0x44, 0x0, 0x81, 0x0,
    0x50, 0x40, 0x50, 0x2a, 0x80, 0x0,
    /* U+0045 "E" */
    0x2a, 0xab, 0x4, 0x2, 0x1, 0x2, 0x0, 0x42,
    0x0, 0x12, 0x0, 0x6, 0xaa, 0x1, 0x0, 0x0,
    0x40, 0x0, 0x10, 0x0, 0x4, 0x0, 0x1, 0x0,
    0x0, 0x40, 0x0, 0x2a, 0xaa, 0x0,
    /* U+0046 "F" */
    0x2a, 0xab, 0x4, 0x2, 0x1, 0x2, 0x0, 0x42,
    0x0, 0x12, 0x0, 0x6, 0xaa, 0x1, 0x0, 0x0,
    0x40, 0x0, 0x10, 0x0, 0x4, 0x0, 0x1, 0x0,
    0x0, 0x40, 0x0, 0x10, 0x0, 0x0,
    /* U+0047 "G" */
    0xa, 0xa8, 0x8, 0x0, 0x81, 0x0, 0x5, 0x0,
    0x0, 0x80, 0x0, 0x20, 0x0, 0x8, 0x0, 0xaa,
    0x0, 0x2, 0x80, 0x0, 0x90, 0x0, 0x21, 0x0,
    0x8, 0x80, 0x8, 0xa, 0xa8, 0x0,
    /* U+0048 "H" */
    0x10, 0x0, 0x44, 0x0, 0x11, 0x0, 0x4, 0x40,
    0x1, 0x10, 0x0, 0x44, 0x0, 0x12, 0xaa, 0xa4,
    0x40, 0x1, 0x10, 0x0, 0x44, 0x0, 0x11, 0x0,
    0x4, 0x40, 0x1, 0x10, 0x0, 0x40,
    /* U+0049 "I" */
    0x11, 0x11, 0x11, 0x11, 0x11, 0x11, 0x10,
    /* U+004A "J" */
    0x0, 0x1, 0x0, 0x1, 0x0, 0x1, 0x0, 0x1,
    0x0, 0x1, 0x0, 0x1, 0x0, 0x1, 0x0, 0x1,
    0x0, 0x1, 0x0, 0x1, 0x40, 0x4, 0x20, 0x8,
    0xa, 0xa0,
    /* U+004B "K" */
    0x10, 0x2, 0x41, 0x0, 0x50, 0x10, 0x14, 0x1,
    0x5, 0x0, 0x11, 0x40, 0x1, 0x50, 0x0, 0x18,
    0x0, 0x1, 0x20, 0x0, 0x10, 0x80, 0x1, 0x2,
    0x0, 0x10, 0x8, 0x1, 0x0, 0x20, 0x10, 0x0,
    0x80,
    /* U+004C "L" */
    0x10, 0x0, 0x4, 0x0, 0x1, 0x0, 0x0, 0x40,
    0x0, 0x10, 0x0, 0x4, 0x0, 0x1, 0x0, 0x0,
    0x40, 0x0, 0x10, 0x0, 0x4, 0x0, 0x1, 0x0,
    0x0, 0x40, 0x0, 0x2a, 0xaa, 0x0,
    /* U+004D "M" */
    0x20, 0x0, 0x33, 0x0, 0x7, 0x14, 0x0, 0xa1,
    0x80, 0x6, 0x11, 0x2, 0x21, 0x20, 0x22, 0x11,
    0x44, 0x21, 0x8, 0x82, 0x10, 0x60, 0x21, 0x2,
    0x2, 0x10, 0x0, 0x21, 0x0, 0x2, 0x16, 0xaa,
    0xb0,
    /* U+004E "N" */
    0x20, 0x0, 0x88, 0x0, 0x21, 0x80, 0x8, 0x44,
    0x2, 0x12, 0x0, 0x84, 0x10, 0x21, 0x8, 0x8,
    0x40, 0x82, 0x10, 0x10, 0x84, 0x2, 0x21, 0x0,
    0x58, 0x40, 0xa, 0x16, 0xaa, 0x80,
    /* U+004F "O" */
    0xa, 0xa8, 0x8, 0x0, 0x81, 0x0, 0x5, 0x0,
    0x2, 0x80, 0x0, 0xa0, 0x0, 0x28, 0x0, 0xa,
    0x0, 0x2, 0x80, 0x0, 0x90, 0x0, 0x21, 0x0,
    0x4, 0x80, 0x8, 0xa, 0xa8, 0x0,
    /* U+0050 "P" */
    0x2a, 0xa0, 0x10, 0x8, 0x10, 0x2, 0x10, 0x2,
    0x10, 0x2, 0x10, 0x8, 0x10, 0x10, 0x10, 0x0,
    0x10, 0x0, 0x10, 0x0, 0x10, 0x0, 0x10, 0x0,
    0x10, 0x0,
    /* U+0051 "Q" */
    0xa, 0xa8, 0x8, 0x0, 0x81, 0x0, 0x15, 0x0,
    0x2, 0x80, 0x0, 0xa0, 0x0, 0x28, 0x0, 0xa,
    0x0, 0x2, 0x80, 0x0, 0x90, 0x0, 0x25, 0x0,
    0x4, 0x80, 0x8, 0x9, 0x1, 0x0, 0x60, 0x0,
    0x8, 0x0, 0x1, 0x0, 0x0, 0x28, 0x0,
    /* U+0052 "R" */
    0x2a, 0xa0, 0x10, 0x8, 0x10, 0x2, 0x10, 0x2,
    0x10, 0x2, 0x10, 0x8, 0x10, 0x20, 0x10, 0x20,
    0x10, 0x4, 0x10, 0x8, 0x10, 0x8, 0x10, 0x1,
    0x16, 0xaa,
    /* U+0053 "S" */
    0x6, 0xa8, 0x0, 0x40, 0x20, 0x10, 0x0, 0x42,
    0x0, 0x20, 0x4, 0x0, 0x0, 0x20, 0x0, 0x0,
    0x64, 0x0, 0x0, 0x20, 0x0, 0x0, 0x80, 0x0,
    0x8, 0x20, 0x0, 0x81, 0x40, 0x4, 0x6, 0xaa,
    0x0,
    /* U+0054 "T" */
    0x6a, 0xea, 0x80, 0x8, 0x0, 0x0, 0x80, 0x0,
    0x8, 0x0, 0x0, 0x80, 0x0, 0x8, 0x0, 0x0,
    0x80, 0x0, 0x8, 0x0, 0x0, 0x80, 0x0, 0x8,
    0x0, 0x0, 0x80, 0x0, 0x8, 0x0, 0x0, 0x80,
    0x0,
    /* U+0055 "U" */
    0x4a, 0xaa, 0xc4, 0x0, 0x8, 0x40, 0x0, 0x84,
    0x0, 0x8, 0x40, 0x0, 0x84, 0x0, 0x8, 0x40,
    0x0, 0x84, 0x0, 0x8, 0x40, 0x0, 0x81, 0x0,
    0x8, 0x20, 0x0, 0x81, 0x40, 0x20, 0x6, 0xa8,
    0x0,
    /* U+0056 "V" */
    0x4a, 0xaa, 0x91, 0x0, 0x8, 0x20, 0x0, 0x81,
    0x0, 0x14, 0x4, 0x2, 0x0, 0x80, 0x20, 0x4,
    0x4, 0x0, 0x10, 0x80, 0x2, 0x4, 0x0, 0x11,
    0x0, 0x0, 0xa0, 0x0, 0x9, 0x0, 0x0, 0x40,
    0x0, 0x0, 0x0,
    /* U+0057 "W" */
    0x4a, 0xaa, 0xaa, 0xb0, 0x40, 0x0, 0x0, 0x82,
    0x0, 0x0, 0x5, 0x4, 0x0, 0x0, 0x20, 0x4,
    0x0, 0x0, 0x80, 0x20, 0x4, 0x4, 0x0, 0x40,
    0x60, 0x20, 0x0, 0x42, 0x40, 0x40, 0x2, 0x4,
    0x84, 0x0, 0x4, 0x42, 0x20, 0x0, 0xa, 0x5,
    0x40, 0x0, 0x24, 0xc, 0x0, 0x0, 0x40, 0x10,
    0x0, 0x0, 0x0, 0x0, 0x0,
    /* U+0058 "X" */
    0x20, 0x2, 0x5, 0x2, 0x0, 0x80, 0x80, 0x14,
    0x80, 0x2, 0x10, 0x0, 0x70, 0x0, 0xc, 0x0,
    0x9, 0x40, 0x1, 0x20, 0x2, 0x1, 0x0, 0x40,
    0x80, 0x80, 0x4, 0x10, 0x2, 0x0,
    /* U+0059 "Y" */
    0x86, 0xaa, 0x92, 0x0, 0x8, 0x14, 0x1, 0x0,
    0x80, 0x20, 0x1, 0x8, 0x0, 0x21, 0x40, 0x0,
    0xa0, 0x0, 0x4, 0x0, 0x0, 0x40, 0x0, 0x4,
    0x0, 0x0, 0x40, 0x0, 0x4, 0x0, 0x0, 0x40,
    0x0,
    /* U+005A "Z" */
    0x2a, 0xaa, 0x0, 0x4, 0x0, 0x8, 0x0, 0x20,
    0x0, 0x20, 0x0, 0x80, 0x0, 0x40, 0x2, 0x0,
    0x1, 0x0, 0x8, 0x0, 0x4, 0x0, 0x20, 0x0,
    0x3a, 0xaa,
    /* U+005B "[" */
    0x24, 0x41, 0x4, 0x10, 0x41, 0x4, 0x10, 0x41,
    0x4, 0x24,
    /* U+005C "\\" */
    0x0, 0x0, 0x80, 0x1, 0x0, 0x1, 0x0, 0x8,
    0x0, 0x10, 0x0, 0x20, 0x0, 0x80, 0x0, 0x40,
    0x2, 0x0, 0x4, 0x0, 0x8, 0x0, 0x20, 0x0,
    0x50, 0x0, 0x40,
    /* U+005D "]" */
    0x28, 0x20, 0x82, 0x8, 0x20, 0x82, 0x8, 0x20,
    0x82, 0x28,
    /* U+005E "^" */
    0x0, 0x0, 0xa0, 0x20, 0x80, 0x0,
    /* U+005F "_" */
    0x2a, 0xaa, 0x0,
    /* U+0061 "a" */
    0x0, 0x40, 0x0, 0x9, 0x0, 0x0, 0x60, 0x0,
    0x21, 0x40, 0x2, 0x8, 0x0, 0x40, 0x40, 0x8,
    0x1, 0x0, 0x40, 0x20, 0x20, 0x1, 0x42, 0x0,
    0x8, 0x42, 0xaa, 0xc0,
    /* U+0062 "b" */
    0x6a, 0x90, 0x50, 0x14, 0x50, 0x8, 0x50, 0x8,
    0x50, 0x14, 0x50, 0x24, 0x50, 0x8, 0x50, 0x2,
    0x50, 0x2, 0x50, 0x8, 0x6a, 0xa0,
    /* U+0063 "c" */
    0xa, 0xa8, 0x20, 0x1, 0x40, 0x0, 0x80, 0x0,
    0x80, 0x0, 0x80, 0x0, 0x80, 0x0, 0x80, 0x0,
    0x40, 0x0, 0x20, 0x1, 0xa, 0xa8,
    /* U+0064 "d" */
    0x6a, 0x80, 0x50, 0x24, 0x50, 0x8, 0x50, 0x2,
    0x50, 0x2, 0x50, 0x2, 0x50, 0x2, 0x50, 0x2,
    0x50, 0x8, 0x50, 0x24, 0x6a, 0x80,
    /* U+0065 "e" */
    0xa, 0xa8, 0x20, 0x2, 0x40, 0x8, 0x80, 0x20,
    0x80, 0x80, 0x81, 0x0, 0x80, 0x0, 0x80, 0x0,
    0x40, 0x0, 0x20, 0x1, 0xa, 0xa8,
    /* U+0066 "f" */
    0x6, 0xa8, 0x8, 0x0, 0x81, 0x0, 0x51, 0x0,
    0x50, 0x40, 0x90, 0x10, 0x6a, 0x84, 0x0, 0x1,
    0x0, 0x0, 0x40, 0x0, 0x10, 0x0, 0x4, 0x0,
    0x0,
    /* U+0067 "g" */
    0xa, 0xa8, 0x20, 0x2, 0x40, 0x8, 0x80, 0x10,
    0x80, 0x0, 0x80, 0x0, 0x80, 0x1, 0x80, 0x2,
    0x40, 0x2, 0x20, 0x2, 0xa, 0xaa, 0x0, 0x2,
    0x0, 0x2, 0x0, 0x5, 0x2, 0xa4,
    /* U+0068 "h" */
    0x50, 0x4, 0x50, 0x4, 0x50, 0x4, 0x50, 0x4,
    0x50, 0x4, 0x6a, 0xa8, 0x50, 0x4, 0x50, 0x4,
    0x50, 0x4, 0x50, 0x4, 0x50, 0x4,
    /* U+0069 "i" */
    0x55, 0x55, 0x55, 0x55, 0x55, 0x50,
    /* U+006A "j" */
    0x0, 0x4, 0x0, 0x4, 0x0, 0x4, 0x0, 0x4,
    0x0, 0x4, 0x0, 0x4, 0x0, 0x4, 0x0, 0x4,
    0x0, 0x4, 0x0, 0x4, 0x0, 0x4, 0x0, 0x8,
    0x10, 0x8, 0x20, 0x8, 0xa, 0xa0,
    /* U+006B "k" */
    0x50, 0x8, 0x14, 0x8, 0x5, 0x8, 0x1, 0x49,
    0x0, 0x55, 0x0, 0x16, 0x0, 0x5, 0x20, 0x1,
    0x42, 0x0, 0x50, 0x20, 0x14, 0x2, 0x5, 0x0,
    0x20,
    /* U+006C "l" */
    0x50, 0x1, 0x40, 0x5, 0x0, 0x14, 0x0, 0x50,
    0x1, 0x40, 0x5, 0x0, 0x14, 0x0, 0x50, 0x1,
    0x40, 0x6, 0xaa, 0x40,
    /* U+006D "m" */
    0x60, 0x0, 0x35, 0x80, 0xa, 0x52, 0x2, 0x25,
    0x8, 0x82, 0x50, 0x60, 0x25, 0x0, 0x2, 0x50,
    0x0, 0x25, 0x0, 0x2, 0x50, 0x0, 0x25, 0x0,
    0x2, 0x56, 0xaa, 0xa0,
    /* U+006E "n" */
    0x60, 0x2, 0x60, 0x2, 0x58, 0x2, 0x55, 0x2,
    0x52, 0x2, 0x50, 0x42, 0x50, 0x42, 0x50, 0x22,
    0x50, 0x16, 0x50, 0xa, 0x50, 0x2,
    /* U+006F "o" */
    0xa, 0xa8, 0x8, 0x0, 0x84, 0x0, 0x12, 0x0,
    0x1, 0x80, 0x0, 0xa0, 0x0, 0x28, 0x0, 0xa,
    0x0, 0x1, 0x40, 0x1, 0x8, 0x0, 0x80, 0xaa,
    0x80,
    /* U+0070 "p" */
    0x6a, 0xa0, 0x50, 0x8, 0x50, 0x1, 0x50, 0x2,
    0x50, 0x2, 0x50, 0x8, 0x50, 0x20, 0x50, 0x0,
    0x50, 0x0, 0x50, 0x0, 0x50, 0x0, 0x50, 0x0,
    0x50, 0x0, 0x50, 0x0, 0x50, 0x0,
    /* U+0071 "q" */
    0xa, 0xa8, 0x8, 0x0, 0x85, 0x0, 0x16, 0x0,
    0x1, 0x80, 0x0, 0xa0, 0x0, 0x28, 0x0, 0xa,
    0x0, 0x1, 0x40, 0x1, 0x48, 0x0, 0x80, 0xa0,
    0x0, 0x2, 0x0, 0x0, 0x80, 0x0, 0x10, 0x0,
    0x2, 0x80,
    /* U+0072 "r" */
    0x6a, 0x90, 0x50, 0x14, 0x50, 0x8, 0x50, 0x8,
    0x50, 0x14, 0x50, 0x50, 0x50, 0x20, 0x50, 0x20,
    0x50, 0x4, 0x50, 0x8, 0x50, 0x5,
    /* U+0073 "s" */
    0x1a, 0xa0, 0x40, 0x0, 0x80, 0x0, 0x80, 0x0,
    0x20, 0x0, 0x6, 0x80, 0x0, 0x18, 0x0, 0x4,
    0x0, 0x1, 0x0, 0x8, 0x6a, 0xa0,
    /* U+0074 "t" */
    0x6a, 0xea, 0x40, 0x20, 0x0, 0x8, 0x0, 0x2,
    0x0, 0x0, 0x80, 0x0, 0x20, 0x0, 0x8, 0x0,
    0x2, 0x0, 0x0, 0x80, 0x0, 0x20, 0x0, 0x8,
    0x0,
    /* U+0075 "u" */
    0x40, 0x2, 0x10, 0x0, 0x84, 0x0, 0x21, 0x0,
    0x8, 0x40, 0x2, 0x10, 0x0, 0x84, 0x0, 0x21,
    0x0, 0x8, 0x10, 0x2, 0x8, 0x2, 0x0, 0xaa,
    0x0,
    /* U+0076 "v" */
    0x40, 0x0, 0x41, 0x0, 0x8, 0x20, 0x1, 0x40,
    0x40, 0x20, 0x8, 0x1, 0x0, 0x40, 0x40, 0x2,
    0x8, 0x0, 0x21, 0x40, 0x0, 0x60, 0x0, 0x9,
    0x0, 0x0, 0x40, 0x0,
    /* U+0077 "w" */
    0x46, 0xaa, 0xaa, 0xa8, 0x40, 0x0, 0x0, 0x42,
    0x0, 0x0, 0x2, 0x1, 0x0, 0x40, 0x14, 0x8,
    0x3, 0x0, 0x80, 0x10, 0x12, 0x1, 0x0, 0x20,
    0x88, 0x10, 0x0, 0x85, 0x4, 0x80, 0x0, 0x60,
    0x25, 0x0, 0x2, 0x40, 0x60, 0x0, 0x4, 0x0,
    0x40, 0x0,
    /* U+0078 "x" */
    0x20, 0x8, 0x4, 0x4, 0x8, 0x20, 0x2, 0x50,
    0x1, 0x80, 0x1, 0x80, 0x2, 0x40, 0x8, 0x20,
    0x8, 0x14, 0x20, 0x8, 0x10, 0x1,
    /* U+0079 "y" */
    0x46, 0xaa, 0xc1, 0x0, 0x8, 0x20, 0x1, 0x41,
    0x40, 0x20, 0x8, 0x2, 0x0, 0x40, 0x40, 0x1,
    0x8, 0x0, 0x21, 0x40, 0x1, 0x60, 0x0, 0xa,
    0x0, 0x0, 0x80, 0x0, 0x4, 0x0, 0x0, 0x40,
    0x0, 0x4, 0x0, 0x0, 0x40, 0x0,
    /* U+007A "z" */
    0x2a, 0xac, 0x0, 0x8, 0x0, 0x20, 0x0, 0x10,
    0x0, 0x80, 0x0, 0x40, 0x2, 0x0, 0x5, 0x0,
    0x8, 0x0, 0x10, 0x0, 0x3a, 0xa9,
    /* U+007B "{" */
    0x0, 0x0, 0x80, 0x40, 0x20, 0x8, 0x2, 0x0,
    0x40, 0x80, 0x20, 0x8, 0x0, 0x40, 0x20, 0x8,
    0x2, 0x0, 0x40, 0x8, 0x0, 0x0,
    /* U+007C "|" */
    0x1, 0x11, 0x11, 0x11, 0x11, 0x11, 0x11, 0x11,
    /* U+007D "}" */
    0x0, 0x8, 0x0, 0x40, 0x20, 0x8, 0x2, 0x0,
    0x80, 0x4, 0x2, 0x0, 0x40, 0x80, 0x20, 0x8,
    0x2, 0x0, 0x40, 0x80, 0x0, 0x0,
    /* U+007E "~" */
    0x20, 0x51, 0x80,
    /* U+00C0 "À" */
    0x0, 0x0, 0x0, 0x14, 0x0, 0x0, 0x40, 0x0,
    0x1, 0x0, 0x0, 0x40, 0x0, 0x9, 0x0, 0x0,
    0xa0, 0x0, 0x11, 0x0, 0x2, 0x4, 0x0, 0x20,
    0x80, 0x4, 0x4, 0x0, 0x80, 0x20, 0x4, 0x2,
    0x1, 0x0, 0x14, 0x20, 0x0, 0x81, 0x0, 0x8,
    0x4a, 0xaa, 0x90,
    /* U+00C2 "Â" */
    0x0, 0x0, 0x0, 0x9, 0x0, 0x1, 0x50, 0x0,
    0x10, 0x40, 0x0, 0x40, 0x0, 0x9, 0x0, 0x0,
    0xa0, 0x0, 0x11, 0x0, 0x2, 0x4, 0x0, 0x20,
    0x80, 0x4, 0x4, 0x0, 0x80, 0x20, 0x4, 0x2,
    0x1, 0x0, 0x14, 0x20, 0x0, 0x81, 0x0, 0x8,
    0x4a, 0xaa, 0x90,
    /* U+00C4 "Ä" */
    0x7, 0xc, 0x0, 0x0, 0x0, 0x0, 0x0, 0x0,
    0x9, 0x0, 0x0, 0xa0, 0x0, 0x15, 0x0, 0x2,
    0x4, 0x0, 0x20, 0x80, 0x4, 0x4, 0x0, 0x80,
    0x20, 0x4, 0x2, 0x1, 0x0, 0x14, 0x20, 0x0,
    0x81, 0x0, 0x8, 0x4a, 0xaa, 0x90,
    /* U+00C6 "Æ" */
    0x0, 0x1e, 0xaa, 0xd0, 0x2, 0x40, 0x14, 0x0,
    0x14, 0x5, 0x0, 0x8, 0x42, 0x0, 0x0, 0x44,
    0x80, 0x0, 0x20, 0x5a, 0xa0, 0x2, 0x4, 0x0,
    0x0, 0x40, 0x40, 0x0, 0x8, 0x4, 0x0, 0x1,
    0x0, 0x40, 0x0, 0x20, 0x4, 0x0, 0x5, 0x0,
    0x40, 0x0, 0xaa, 0xe, 0xaa, 0x80,
    /* U+00C7 "Ç" */
    0xa, 0xa8, 0x8, 0x0, 0x81, 0x0, 0x5, 0x0,
    0x0, 0x80, 0x0, 0x20, 0x0, 0x8, 0x0, 0x2,
    0x0, 0x0, 0x80, 0x0, 0x10, 0x0, 0x1, 0x0,
    0x4, 0x80, 0x8, 0xa, 0xa8, 0x0, 0x30, 0x0,
    0x8, 0x0, 0x2, 0x0, 0x0, 0x0, 0x0,
    /* U+00C8 "È" */
    0x0, 0x0, 0x0, 0x80, 0x0, 0x8, 0x0, 0x0,
    0x0, 0x2a, 0xab, 0x4, 0x2, 0x1, 0x2, 0x0,
    0x42, 0x0, 0x12, 0x0, 0x6, 0xaa, 0x1, 0x0,
    0x0, 0x40, 0x0, 0x10, 0x0, 0x4, 0x0, 0x1,
    0x0, 0x0, 0x40, 0x0, 0x2a, 0xaa, 0x0,
    /* U+00C9 "É" */
    0x0, 0x0, 0x0, 0x8, 0x0, 0x8, 0x0, 0x0,
    0x0, 0x2a, 0xab, 0x4, 0x2, 0x1, 0x2, 0x0,
    0x42, 0x0, 0x12, 0x0, 0x6, 0xaa, 0x1, 0x0,
    0x0, 0x40, 0x0, 0x10, 0x0, 0x4, 0x0, 0x1,
    0x0, 0x0, 0x40, 0x0, 0x2a, 0xaa, 0x0,
    /* U+00CA "Ê" */
    0x0, 0x0, 0x0, 0x20, 0x0, 0x22, 0x0, 0x10,
    0x10, 0x2a, 0xab, 0x4, 0x2, 0x1, 0x2, 0x0,
    0x42, 0x0, 0x12, 0x0, 0x6, 0xaa, 0x1, 0x0,
    0x0, 0x40, 0x0, 0x10, 0x0, 0x4, 0x0, 0x1,
    0x0, 0x0, 0x40, 0x0, 0x2a, 0xaa, 0x0,
    /* U+00CB "Ë" */
    0xa, 0x18, 0x0, 0x0, 0x2, 0xaa, 0xb0, 0x40,
    0x20, 0x10, 0x20, 0x4, 0x20, 0x1, 0x20, 0x0,
    0x6a, 0xa0, 0x10, 0x0, 0x4, 0x0, 0x1, 0x0,
    0x0, 0x40, 0x0, 0x10, 0x0, 0x4, 0x0, 0x2,
    0xaa, 0xa0,
    /* U+00CE "Î" */
    0x0, 0x0, 0x50, 0x5, 0x41, 0x4, 0x1, 0x0,
    0x10, 0x1, 0x0, 0x10, 0x1, 0x0, 0x10, 0x1,
    0x0, 0x10, 0x1, 0x0, 0x10, 0x1, 0x0, 0x10,
    0x1, 0x0,
    /* U+00CF "Ï" */
    0x30, 0xc0, 0x0, 0x1, 0x0, 0x10, 0x1, 0x0,
    0x10, 0x1, 0x0, 0x10, 0x1, 0x0, 0x10, 0x1,
    0x0, 0x10, 0x1, 0x0, 0x10, 0x1, 0x0,
    /* U+00D4 "Ô" */
    0x0, 0x80, 0x0, 0x58, 0x0, 0x50, 0x40, 0x2a,
    0xa0, 0x20, 0x2, 0x4, 0x0, 0x14, 0x0, 0xa,
    0x0, 0x2, 0x80, 0x0, 0xa0, 0x0, 0x28, 0x0,
    0xa, 0x0, 0x2, 0x40, 0x0, 0x84, 0x0, 0x12,
    0x0, 0x20, 0x2a, 0xa0,
    /* U+00D6 "Ö" */
    0xa, 0x18, 0x0, 0x0, 0x0, 0xaa, 0x80, 0x80,
    0x8, 0x10, 0x0, 0x50, 0x0, 0x28, 0x0, 0xa,
    0x0, 0x2, 0x80, 0x0, 0xa0, 0x0, 0x28, 0x0,
    0x9, 0x0, 0x2, 0x10, 0x0, 0x48, 0x0, 0x80,
    0xaa, 0x80,
    /* U+00DB "Û" */
    0x0, 0x0, 0x0, 0x9, 0x0, 0x1, 0x60, 0x0,
    0x10, 0x40, 0x40, 0x0, 0x84, 0x0, 0x8, 0x40,
    0x0, 0x84, 0x0, 0x8, 0x40, 0x0, 0x84, 0x0,
    0x8, 0x40, 0x0, 0x84, 0x0, 0x8, 0x40, 0x0,
    0x81, 0x0, 0x8, 0x20, 0x0, 0x81, 0x40, 0x20,
    0x6, 0xa8, 0x0,
    /* U+00DC "Ü" */
    0x7, 0xc, 0x0, 0x0, 0x0, 0x40, 0x0, 0x84,
    0x0, 0x8, 0x40, 0x0, 0x84, 0x0, 0x8, 0x40,
    0x0, 0x84, 0x0, 0x8, 0x40, 0x0, 0x84, 0x0,
    0x8, 0x40, 0x0, 0x81, 0x0, 0x8, 0x20, 0x0,
    0x81, 0x40, 0x20, 0x6, 0xa8, 0x0,
    /* U+00E0 "à" */
    0x1, 0x0, 0x0, 0x14, 0x0, 0x0, 0x50, 0x0,
    0x0, 0x0, 0x0, 0x40, 0x0, 0x9, 0x0, 0x0,
    0x60, 0x0, 0x21, 0x40, 0x2, 0x8, 0x0, 0x40,
    0x40, 0x8, 0x1, 0x0, 0x40, 0x20, 0x20, 0x1,
    0x42, 0x0, 0x8, 0x42, 0xaa, 0xc0,
    /* U+00E2 "â" */
    0x0, 0x0, 0x0, 0xa, 0x0, 0x2, 0x8, 0x0,
    0x0, 0x0, 0x0, 0x40, 0x0, 0x9, 0x0, 0x0,
    0x60, 0x0, 0x21, 0x40, 0x2, 0x8, 0x0, 0x40,
    0x40, 0x8, 0x1, 0x0, 0x40, 0x20, 0x20, 0x1,
    0x42, 0x0, 0x8, 0x42, 0xaa, 0xc0,
    /* U+00E4 "ä" */
    0x7, 0xc, 0x0, 0x0, 0x0, 0x0, 0x0, 0x0,
    0x9, 0x0, 0x0, 0x60, 0x0, 0x11, 0x0, 0x2,
    0x8, 0x0, 0x40, 0x80, 0x8, 0x1, 0x0, 0x40,
    0x20, 0x20, 0x1, 0x42, 0x0, 0x8, 0x42, 0xaa,
    0xc0,
    /* U+00E6 "æ" */
    0x0, 0x22, 0xa9, 0x0, 0x2a, 0x0, 0x20, 0xb,
    0x0, 0x20, 0x4, 0x80, 0x20, 0x2, 0x20, 0x60,
    0x1, 0x48, 0x10, 0x0, 0x82, 0x0, 0x0, 0x50,
    0x80, 0x0, 0x20, 0x20, 0x0, 0x4, 0x2, 0x0,
    0xa, 0xa0, 0x2a, 0xa0,
    /* U+00E7 "ç" */
    0xa, 0xa8, 0x20, 0x1, 0x40, 0x0, 0x80, 0x0,
    0x80, 0x0, 0x80, 0x0, 0x80, 0x0, 0x80, 0x0,
    0x40, 0x0, 0x20, 0x1, 0xa, 0xa8, 0x0, 0xc0,
    0x0, 0x80, 0x0, 0x40, 0x0, 0x0,
    /* U+00E8 "è" */
    0x0, 0x0, 0x2, 0x0, 0x0, 0x80, 0x0, 0x0,
    0xa, 0xa8, 0x20, 0x2, 0x40, 0x8, 0x80, 0x20,
    0x80, 0x80, 0x81, 0x0, 0x80, 0x0, 0x80, 0x0,
    0x40, 0x0, 0x20, 0x1, 0xa, 0xa8,
    /* U+00E9 "é" */
    0x0, 0x10, 0x0, 0x50, 0x0, 0x40, 0x0, 0x0,
    0xa, 0xa8, 0x20, 0x2, 0x40, 0x8, 0x80, 0x20,
    0x80, 0x80, 0x81, 0x0, 0x80, 0x0, 0x80, 0x0,
    0x40, 0x0, 0x20, 0x1, 0xa, 0xa8,
    /* U+00EA "ê" */
    0x0, 0x40, 0x2, 0x80, 0x5, 0x20, 0x0, 0x0,
    0xa, 0xa8, 0x20, 0x2, 0x40, 0x8, 0x80, 0x20,
    0x80, 0x80, 0x81, 0x0, 0x80, 0x0, 0x80, 0x0,
    0x40, 0x0, 0x20, 0x1, 0xa, 0xa8,
    /* U+00EB "ë" */
    0xd, 0x24, 0x0, 0x0, 0xa, 0xa8, 0x20, 0x2,
    0x40, 0x8, 0x80, 0x20, 0x80, 0x80, 0x81, 0x0,
    0x80, 0x0, 0x80, 0x0, 0x40, 0x0, 0x20, 0x1,
    0xa, 0xa8,
    /* U+00EE "î" */
    0x4, 0x0, 0xa0, 0x20, 0x80, 0x0, 0x5, 0x0,
    0x50, 0x5, 0x0, 0x50, 0x5, 0x0, 0x50, 0x5,
    0x0, 0x50, 0x5, 0x0, 0x50, 0x5, 0x0,
    /* U+00EF "ï" */
    0x30, 0xc0, 0x0, 0x5, 0x0, 0x50, 0x5, 0x0,
    0x50, 0x5, 0x0, 0x50, 0x5, 0x0, 0x50, 0x5,
    0x0, 0x50, 0x5, 0x0,
    /* U+00F4 "ô" */
    0x0, 0x40, 0x0, 0x64, 0x0, 0x52, 0x0, 0x0,
    0x0, 0xa, 0xa8, 0x8, 0x0, 0x84, 0x0, 0x12,
    0x0, 0x1, 0x80, 0x0, 0xa0, 0x0, 0x28, 0x0,
    0xa, 0x0, 0x1, 0x40, 0x1, 0x8, 0x0, 0x80,
    0xaa, 0x80,
    /* U+00F6 "ö" */
    0x9, 0x28, 0x0, 0x0, 0x0, 0xaa, 0x80, 0x80,
    0x8, 0x40, 0x1, 0x20, 0x0, 0x18, 0x0, 0xa,
    0x0, 0x2, 0x80, 0x0, 0xa0, 0x0, 0x14, 0x0,
    0x10, 0x80, 0x8, 0xa, 0xa8, 0x0,
    /* U+00FB "û" */
    0x0, 0x40, 0x0, 0x94, 0x0, 0x42, 0x0, 0x0,
    0x0, 0x40, 0x2, 0x10, 0x0, 0x84, 0x0, 0x21,
    0x0, 0x8, 0x40, 0x2, 0x10, 0x0, 0x84, 0x0,
    0x21, 0x0, 0x8, 0x10, 0x2, 0x8, 0x2, 0x0,
    0xaa, 0x0,
    /* U+00FC "ü" */
    0xd, 0x24, 0x0, 0x0, 0x4, 0x0, 0x21, 0x0,
    0x8, 0x40, 0x2, 0x10, 0x0, 0x84, 0x0, 0x21,
    0x0, 0x8, 0x40, 0x2, 0x10, 0x0, 0x81, 0x0,
    0x20, 0x80, 0x20, 0xa, 0xa0, 0x0,
    /* U+00FF "ÿ" */
    0x7, 0xc, 0x0, 0x0, 0x0, 0x40, 0x0, 0x41,
    0x0, 0x8, 0x20, 0x1, 0x41, 0x40, 0x20, 0x8,
    0x1, 0x0, 0x40, 0x40, 0x1, 0x8, 0x0, 0x21,
    0x40, 0x1, 0x60, 0x0, 0xa, 0x0, 0x0, 0x80,
    0x0, 0x4, 0x0, 0x0, 0x40, 0x0, 0x4, 0x0,
    0x0, 0x40, 0x0,
    /* U+0152 "Œ" */
    0xa, 0xab, 0xaa, 0xa8, 0x20, 0x2, 0x0, 0x20,
    0x10, 0x2, 0x0, 0x40, 0x40, 0x2, 0x5, 0x0,
    0x80, 0x2, 0x14, 0x0, 0x80, 0x2, 0x2a, 0x90,
    0x80, 0x2, 0x0, 0x0, 0x80, 0x2, 0x0, 0x0,
    0x80, 0x2, 0x0, 0x0, 0x40, 0x2, 0x0, 0x0,
    0x10, 0x2, 0x0, 0x0, 0x20, 0x2, 0x0, 0x0,
    0xa, 0xab, 0xaa, 0xa4,
    /* U+0153 "œ" */
    0xa, 0xa8, 0xa, 0xa4, 0x20, 0x2, 0x20, 0x2,
    0x40, 0x1, 0x80, 0x8, 0x80, 0x0, 0xc0, 0x20,
    0x80, 0x0, 0x81, 0x80, 0x80, 0x0, 0x81, 0x0,
    0x80, 0x0, 0x80, 0x0, 0x80, 0x0, 0xc0, 0x0,
    0x40, 0x1, 0x80, 0x0, 0x20, 0x2, 0x20, 0x0,
    0xa, 0xa8, 0xa, 0xa8,
    /* U+0178 "Ÿ" */
    0x7, 0xc, 0x0, 0x0, 0x0, 0x80, 0x0, 0x52,
    0x0, 0x8, 0x14, 0x1, 0x0, 0x80, 0x20, 0x1,
    0x8, 0x0, 0x11, 0x40, 0x0, 0xa0, 0x0, 0x4,
    0x0, 0x0, 0x40, 0x0, 0x4, 0x0, 0x0, 0x40,
    0x0, 0x4, 0x0, 0x0, 0x40, 0x0
};
/*---------------------
 *  GLYPH DESCRIPTION
 *--------------------*/
static const lv_font_fmt_txt_glyph_dsc_t modern_glyph_dsc[] = {
    {.bitmap_index = 0, .adv_w = 0, .box_w = 0, .box_h = 0, .ofs_x = 0, .ofs_y = 0} /* id = 0 reserved */,
    {.bitmap_index = 0, .adv_w = 85, .box_w = 0, .box_h = 0, .ofs_x = 0, .ofs_y = 0},
    {.bitmap_index = 0, .adv_w = 69, .box_w = 2, .box_h = 13, .ofs_x = 1, .ofs_y = 0},
    {.bitmap_index = 7, .adv_w = 88, .box_w = 4, .box_h = 4, .ofs_x = 1, .ofs_y = 9},
    {.bitmap_index = 11, .adv_w = 168, .box_w = 9, .box_h = 15, .ofs_x = 1, .ofs_y = -1},
    {.bitmap_index = 45, .adv_w = 151, .box_w = 8, .box_h = 13, .ofs_x = 1, .ofs_y = 0},
    {.bitmap_index = 71, .adv_w = 168, .box_w = 9, .box_h = 9, .ofs_x = 1, .ofs_y = 2},
    {.bitmap_index = 92, .adv_w = 169, .box_w = 10, .box_h = 13, .ofs_x = 0, .ofs_y = 0},
    {.bitmap_index = 125, .adv_w = 56, .box_w = 2, .box_h = 4, .ofs_x = 1, .ofs_y = 9},
    {.bitmap_index = 127, .adv_w = 71, .box_w = 3, .box_h = 16, .ofs_x = 1, .ofs_y = -1},
    {.bitmap_index = 139, .adv_w = 71, .box_w = 3, .box_h = 16, .ofs_x = 0, .ofs_y = -1},
    {.bitmap_index = 151, .adv_w = 126, .box_w = 6, .box_h = 6, .ofs_x = 1, .ofs_y = 7},
    {.bitmap_index = 160, .adv_w = 112, .box_w = 5, .box_h = 5, .ofs_x = 1, .ofs_y = 2},
    {.bitmap_index = 167, .adv_w = 65, .box_w = 2, .box_h = 6, .ofs_x = 1, .ofs_y = -4},
    {.bitmap_index = 170, .adv_w = 105, .box_w = 5, .box_h = 1, .ofs_x = 1, .ofs_y = 4},
    {.bitmap_index = 172, .adv_w = 65, .box_w = 2, .box_h = 2, .ofs_x = 1, .ofs_y = 0},
    {.bitmap_index = 173, .adv_w = 118, .box_w = 7, .box_h = 15, .ofs_x = 0, .ofs_y = -1},
    {.bitmap_index = 200, .adv_w = 163, .box_w = 8, .box_h = 13, .ofs_x = 1, .ofs_y = 0},
    {.bitmap_index = 226, .adv_w = 75, .box_w = 3, .box_h = 13, .ofs_x = 0, .ofs_y = 0},
    {.bitmap_index = 236, .adv_w = 152, .box_w = 8, .box_h = 13, .ofs_x = 1, .ofs_y = 0},
    {.bitmap_index = 262, .adv_w = 160, .box_w = 9, .box_h = 13, .ofs_x = 0, .ofs_y = 0},
    {.bitmap_index = 292, .adv_w = 132, .box_w = 8, .box_h = 13, .ofs_x = 0, .ofs_y = 0},
    {.bitmap_index = 318, .adv_w = 153, .box_w = 9, .box_h = 13, .ofs_x = 0, .ofs_y = 0},
    {.bitmap_index = 348, .adv_w = 151, .box_w = 9, .box_h = 14, .ofs_x = 0, .ofs_y = 0},
    {.bitmap_index = 380, .adv_w = 119, .box_w = 8, .box_h = 13, .ofs_x = 0, .ofs_y = 0},
    {.bitmap_index = 406, .adv_w = 168, .box_w = 9, .box_h = 13, .ofs_x = 1, .ofs_y = 0},
    {.bitmap_index = 436, .adv_w = 152, .box_w = 9, .box_h = 14, .ofs_x = 0, .ofs_y = -1},
    {.bitmap_index = 468, .adv_w = 70, .box_w = 2, .box_h = 6, .ofs_x = 1, .ofs_y = 1},
    {.bitmap_index = 471, .adv_w = 75, .box_w = 2, .box_h = 9, .ofs_x = 1, .ofs_y = -2},
    {.bitmap_index = 476, .adv_w = 126, .box_w = 7, .box_h = 13, .ofs_x = 0, .ofs_y = 0},
    {.bitmap_index = 499, .adv_w = 126, .box_w = 6, .box_h = 2, .ofs_x = 1, .ofs_y = 5},
    {.bitmap_index = 502, .adv_w = 126, .box_w = 7, .box_h = 13, .ofs_x = 1, .ofs_y = 0},
    {.bitmap_index = 525, .adv_w = 146, .box_w = 9, .box_h = 13, .ofs_x = 0, .ofs_y = 0},
    {.bitmap_index = 555, .adv_w = 182, .box_w = 10, .box_h = 13, .ofs_x = 1, .ofs_y = 0},
    {.bitmap_index = 588, .adv_w = 157, .box_w = 10, .box_h = 14, .ofs_x = 0, .ofs_y = 0},
    {.bitmap_index = 623, .adv_w = 167, .box_w = 9, .box_h = 13, .ofs_x = 1, .ofs_y = 0},
    {.bitmap_index = 653, .adv_w = 169, .box_w = 9, .box_h = 13, .ofs_x = 1, .ofs_y = 0},
    {.bitmap_index = 683, .adv_w = 171, .box_w = 9, .box_h = 13, .ofs_x = 1, .ofs_y = 0},
    {.bitmap_index = 713, .adv_w = 166, .box_w = 9, .box_h = 13, .ofs_x = 1, .ofs_y = 0},
    {.bitmap_index = 743, .adv_w = 158, .box_w = 9, .box_h = 13, .ofs_x = 1, .ofs_y = 0},
    {.bitmap_index = 773, .adv_w = 177, .box_w = 9, .box_h = 13, .ofs_x = 1, .ofs_y = 0},
    {.bitmap_index = 803, .adv_w = 178, .box_w = 9, .box_h = 13, .ofs_x = 1, .ofs_y = 0},
    {.bitmap_index = 833, .adv_w = 66, .box_w = 2, .box_h = 13, .ofs_x = 1, .ofs_y = 0},
    {.bitmap_index = 840, .adv_w = 145, .box_w = 8, .box_h = 13, .ofs_x = 0, .ofs_y = 0},
    {.bitmap_index = 866, .adv_w = 165, .box_w = 10, .box_h = 13, .ofs_x = 1, .ofs_y = 0},
    {.bitmap_index = 899, .adv_w = 153, .box_w = 9, .box_h = 13, .ofs_x = 1, .ofs_y = 0},
    {.bitmap_index = 929, .adv_w = 204, .box_w = 10, .box_h = 13, .ofs_x = 1, .ofs_y = 0},
    {.bitmap_index = 962, .adv_w = 183, .box_w = 9, .box_h = 13, .ofs_x = 1, .ofs_y = 0},
    {.bitmap_index = 992, .adv_w = 179, .box_w = 9, .box_h = 13, .ofs_x = 1, .ofs_y = 0},
    {.bitmap_index = 1022, .adv_w = 151, .box_w = 8, .box_h = 13, .ofs_x = 1, .ofs_y = 0},
    {.bitmap_index = 1048, .adv_w = 179, .box_w = 9, .box_h = 17, .ofs_x = 1, .ofs_y = -4},
    {.bitmap_index = 1087, .adv_w = 158, .box_w = 8, .box_h = 13, .ofs_x = 1, .ofs_y = 0},
    {.bitmap_index = 1113, .adv_w = 162, .box_w = 10, .box_h = 13, .ofs_x = 0, .ofs_y = 0},
    {.bitmap_index = 1146, .adv_w = 153, .box_w = 10, .box_h = 13, .ofs_x = 0, .ofs_y = 0},
    {.bitmap_index = 1179, .adv_w = 186, .box_w = 10, .box_h = 13, .ofs_x = 1, .ofs_y = 0},
    {.bitmap_index = 1212, .adv_w = 157, .box_w = 10, .box_h = 14, .ofs_x = 0, .ofs_y = -1},
    {.bitmap_index = 1247, .adv_w = 231, .box_w = 15, .box_h = 14, .ofs_x = 0, .ofs_y = -1},
    {.bitmap_index = 1300, .adv_w = 139, .box_w = 9, .box_h = 13, .ofs_x = 0, .ofs_y = 0},
    {.bitmap_index = 1330, .adv_w = 157, .box_w = 10, .box_h = 13, .ofs_x = 0, .ofs_y = 0},
    {.bitmap_index = 1363, .adv_w = 138, .box_w = 8, .box_h = 13, .ofs_x = 0, .ofs_y = 0},
    {.bitmap_index = 1389, .adv_w = 75, .box_w = 3, .box_h = 13, .ofs_x = 1, .ofs_y = 0},
    {.bitmap_index = 1399, .adv_w = 118, .box_w = 7, .box_h = 15, .ofs_x = 0, .ofs_y = -1},
    {.bitmap_index = 1426, .adv_w = 75, .box_w = 3, .box_h = 13, .ofs_x = 0, .ofs_y = 0},
    {.bitmap_index = 1436, .adv_w = 93, .box_w = 6, .box_h = 4, .ofs_x = 0, .ofs_y = 11},
    {.bitmap_index = 1442, .adv_w = 145, .box_w = 9, .box_h = 1, .ofs_x = 0, .ofs_y = -2},
    {.bitmap_index = 1445, .adv_w = 155, .box_w = 10, .box_h = 11, .ofs_x = 0, .ofs_y = 0},
    {.bitmap_index = 1473, .adv_w = 154, .box_w = 8, .box_h = 11, .ofs_x = 1, .ofs_y = 0},
    {.bitmap_index = 1495, .adv_w = 155, .box_w = 8, .box_h = 11, .ofs_x = 1, .ofs_y = 0},
    {.bitmap_index = 1517, .adv_w = 159, .box_w = 8, .box_h = 11, .ofs_x = 1, .ofs_y = 0},
    {.bitmap_index = 1539, .adv_w = 158, .box_w = 8, .box_h = 11, .ofs_x = 1, .ofs_y = 0},
    {.bitmap_index = 1561, .adv_w = 165, .box_w = 9, .box_h = 11, .ofs_x = 1, .ofs_y = 0},
    {.bitmap_index = 1586, .adv_w = 164, .box_w = 8, .box_h = 15, .ofs_x = 1, .ofs_y = -4},
    {.bitmap_index = 1616, .adv_w = 158, .box_w = 8, .box_h = 11, .ofs_x = 1, .ofs_y = 0},
    {.bitmap_index = 1638, .adv_w = 63, .box_w = 2, .box_h = 11, .ofs_x = 1, .ofs_y = 0},
    {.bitmap_index = 1644, .adv_w = 124, .box_w = 8, .box_h = 15, .ofs_x = -1, .ofs_y = -4},
    {.bitmap_index = 1674, .adv_w = 148, .box_w = 9, .box_h = 11, .ofs_x = 1, .ofs_y = 0},
    {.bitmap_index = 1699, .adv_w = 129, .box_w = 7, .box_h = 11, .ofs_x = 1, .ofs_y = 0},
    {.bitmap_index = 1719, .adv_w = 202, .box_w = 10, .box_h = 11, .ofs_x = 1, .ofs_y = 0},
    {.bitmap_index = 1747, .adv_w = 166, .box_w = 8, .box_h = 11, .ofs_x = 1, .ofs_y = 0},
    {.bitmap_index = 1769, .adv_w = 175, .box_w = 9, .box_h = 11, .ofs_x = 1, .ofs_y = 0},
    {.bitmap_index = 1794, .adv_w = 152, .box_w = 8, .box_h = 15, .ofs_x = 1, .ofs_y = -4},
    {.bitmap_index = 1824, .adv_w = 175, .box_w = 9, .box_h = 15, .ofs_x = 1, .ofs_y = -4},
    {.bitmap_index = 1858, .adv_w = 149, .box_w = 8, .box_h = 11, .ofs_x = 1, .ofs_y = 0},
    {.bitmap_index = 1880, .adv_w = 149, .box_w = 8, .box_h = 11, .ofs_x = 1, .ofs_y = 0},
    {.bitmap_index = 1902, .adv_w = 141, .box_w = 9, .box_h = 11, .ofs_x = 0, .ofs_y = 0},
    {.bitmap_index = 1927, .adv_w = 169, .box_w = 9, .box_h = 11, .ofs_x = 1, .ofs_y = 0},
    {.bitmap_index = 1952, .adv_w = 154, .box_w = 10, .box_h = 11, .ofs_x = 0, .ofs_y = 0},
    {.bitmap_index = 1980, .adv_w = 241, .box_w = 15, .box_h = 11, .ofs_x = 0, .ofs_y = 0},
    {.bitmap_index = 2022, .adv_w = 132, .box_w = 8, .box_h = 11, .ofs_x = 0, .ofs_y = 0},
    {.bitmap_index = 2044, .adv_w = 154, .box_w = 10, .box_h = 15, .ofs_x = 0, .ofs_y = -4},
    {.bitmap_index = 2082, .adv_w = 133, .box_w = 8, .box_h = 11, .ofs_x = 0, .ofs_y = 0},
    {.bitmap_index = 2104, .adv_w = 78, .box_w = 5, .box_h = 17, .ofs_x = 0, .ofs_y = -2},
    {.bitmap_index = 2126, .adv_w = 65, .box_w = 2, .box_h = 16, .ofs_x = 1, .ofs_y = -1},
    {.bitmap_index = 2134, .adv_w = 78, .box_w = 5, .box_h = 17, .ofs_x = 0, .ofs_y = -2},
    {.bitmap_index = 2156, .adv_w = 104, .box_w = 5, .box_h = 2, .ofs_x = 1, .ofs_y = 11},
    {.bitmap_index = 2159, .adv_w = 157, .box_w = 10, .box_h = 17, .ofs_x = 0, .ofs_y = 0},
    {.bitmap_index = 2202, .adv_w = 157, .box_w = 10, .box_h = 17, .ofs_x = 0, .ofs_y = 0},
    {.bitmap_index = 2245, .adv_w = 157, .box_w = 10, .box_h = 15, .ofs_x = 0, .ofs_y = 0},
    {.bitmap_index = 2283, .adv_w = 232, .box_w = 14, .box_h = 13, .ofs_x = 0, .ofs_y = 0},
    {.bitmap_index = 2329, .adv_w = 169, .box_w = 9, .box_h = 17, .ofs_x = 1, .ofs_y = -4},
    {.bitmap_index = 2368, .adv_w = 166, .box_w = 9, .box_h = 17, .ofs_x = 1, .ofs_y = 0},
    {.bitmap_index = 2407, .adv_w = 166, .box_w = 9, .box_h = 17, .ofs_x = 1, .ofs_y = 0},
    {.bitmap_index = 2446, .adv_w = 166, .box_w = 9, .box_h = 17, .ofs_x = 1, .ofs_y = 0},
    {.bitmap_index = 2485, .adv_w = 166, .box_w = 9, .box_h = 15, .ofs_x = 1, .ofs_y = 0},
    {.bitmap_index = 2519, .adv_w = 66, .box_w = 6, .box_h = 17, .ofs_x = -1, .ofs_y = 0},
    {.bitmap_index = 2545, .adv_w = 66, .box_w = 6, .box_h = 15, .ofs_x = -1, .ofs_y = 0},
    {.bitmap_index = 2568, .adv_w = 179, .box_w = 9, .box_h = 16, .ofs_x = 1, .ofs_y = 0},
    {.bitmap_index = 2604, .adv_w = 179, .box_w = 9, .box_h = 15, .ofs_x = 1, .ofs_y = 0},
    {.bitmap_index = 2638, .adv_w = 186, .box_w = 10, .box_h = 17, .ofs_x = 1, .ofs_y = 0},
    {.bitmap_index = 2681, .adv_w = 186, .box_w = 10, .box_h = 15, .ofs_x = 1, .ofs_y = 0},
    {.bitmap_index = 2719, .adv_w = 155, .box_w = 10, .box_h = 15, .ofs_x = 0, .ofs_y = 0},
    {.bitmap_index = 2757, .adv_w = 155, .box_w = 10, .box_h = 15, .ofs_x = 0, .ofs_y = 0},
    {.bitmap_index = 2795, .adv_w = 155, .box_w = 10, .box_h = 13, .ofs_x = 0, .ofs_y = 0},
    {.bitmap_index = 2828, .adv_w = 218, .box_w = 13, .box_h = 11, .ofs_x = 0, .ofs_y = 0},
    {.bitmap_index = 2864, .adv_w = 155, .box_w = 8, .box_h = 15, .ofs_x = 1, .ofs_y = -4},
    {.bitmap_index = 2894, .adv_w = 158, .box_w = 8, .box_h = 15, .ofs_x = 1, .ofs_y = 0},
    {.bitmap_index = 2924, .adv_w = 158, .box_w = 8, .box_h = 15, .ofs_x = 1, .ofs_y = 0},
    {.bitmap_index = 2954, .adv_w = 158, .box_w = 8, .box_h = 15, .ofs_x = 1, .ofs_y = 0},
    {.bitmap_index = 2984, .adv_w = 158, .box_w = 8, .box_h = 13, .ofs_x = 1, .ofs_y = 0},
    {.bitmap_index = 3010, .adv_w = 63, .box_w = 6, .box_h = 15, .ofs_x = -1, .ofs_y = 0},
    {.bitmap_index = 3033, .adv_w = 63, .box_w = 6, .box_h = 13, .ofs_x = -1, .ofs_y = 0},
    {.bitmap_index = 3053, .adv_w = 175, .box_w = 9, .box_h = 15, .ofs_x = 1, .ofs_y = 0},
    {.bitmap_index = 3087, .adv_w = 175, .box_w = 9, .box_h = 13, .ofs_x = 1, .ofs_y = 0},
    {.bitmap_index = 3117, .adv_w = 169, .box_w = 9, .box_h = 15, .ofs_x = 1, .ofs_y = 0},
    {.bitmap_index = 3151, .adv_w = 169, .box_w = 9, .box_h = 13, .ofs_x = 1, .ofs_y = 0},
    {.bitmap_index = 3181, .adv_w = 154, .box_w = 10, .box_h = 17, .ofs_x = 0, .ofs_y = -4},
    {.bitmap_index = 3224, .adv_w = 269, .box_w = 16, .box_h = 13, .ofs_x = 1, .ofs_y = 0},
    {.bitmap_index = 3276, .adv_w = 283, .box_w = 16, .box_h = 11, .ofs_x = 1, .ofs_y = 0},
    {.bitmap_index = 3320, .adv_w = 157, .box_w = 10, .box_h = 15, .ofs_x = 0, .ofs_y = 0}
};
/*---------------------
 *  CHARACTER MAPPING
 *--------------------*/
static const uint16_t modern_unicode_list_2[] = {
    0x0, 0x2, 0x4, 0x6, 0x7, 0x8, 0x9, 0xa,
    0xb, 0xe, 0xf, 0x14, 0x16, 0x1b, 0x1c, 0x20,
    0x22, 0x24, 0x26, 0x27, 0x28, 0x29, 0x2a, 0x2b,
    0x2e, 0x2f, 0x34, 0x36, 0x3b, 0x3c, 0x3f, 0x92,
    0x93, 0xb8
};
/*Collect the unicode lists and glyph_id offsets*/
static const lv_font_fmt_txt_cmap_t modern_cmaps[] =
{
    {
        .range_start = 32, .range_length = 64, .glyph_id_start = 1,
        .unicode_list = NULL, .glyph_id_ofs_list = NULL, .list_length = 0, .type = LV_FONT_FMT_TXT_CMAP_FORMAT0_TINY
    },
    {
        .range_start = 97, .range_length = 30, .glyph_id_start = 65,
        .unicode_list = NULL, .glyph_id_ofs_list = NULL, .list_length = 0, .type = LV_FONT_FMT_TXT_CMAP_FORMAT0_TINY
    },
    {
        .range_start = 192, .range_length = 185, .glyph_id_start = 95,
        .unicode_list = modern_unicode_list_2, .glyph_id_ofs_list = NULL, .list_length = 34, .type = LV_FONT_FMT_TXT_CMAP_SPARSE_TINY
    }
};
/*--------------------
 *  ALL CUSTOM DATA
 *--------------------*/
/*Store all the custom data of the font*/
static lv_font_fmt_txt_glyph_cache_t modern_cache;
static const lv_font_fmt_txt_dsc_t modern_font_dsc = {
    .glyph_bitmap = modern_glyph_bitmap,
    .glyph_dsc = modern_glyph_dsc,
    .cmaps = modern_cmaps,
    .kern_dsc = NULL,
    .kern_scale = 0,
    .cmap_num = 3,
    .bpp = 2,
    .kern_classes = 0,
    .bitmap_format = 0,
    .cache = &modern_cache
};
/*-----------------
 *  PUBLIC FONT
 *----------------*/
/*Initialize a public general font descriptor*/
const lv_font_t modern = {
    .get_glyph_dsc = lv_font_get_glyph_dsc_fmt_txt,    /*Function pointer to get glyph's data*/
    .get_glyph_bitmap = lv_font_get_bitmap_fmt_txt,    /*Function pointer to get glyph's bitmap*/
    .line_height = 21,          /*The maximum line height required by the font*/
    .base_line = 4,             /*Baseline measured from the bottom of the line*/

    .subpx = LV_FONT_SUBPX_NONE,
    .underline_position = -1,
    .underline_thickness = 1,
    .dsc = &modern_font_dsc,          /*The custom font data. Will be accessed by `get_glyph_bitmap/dsc` */
};
#endif

/*******************************************************************************
 * Size: 20 px
 * Bpp: 2
 ******************************************************************************/


#ifdef __has_include

    #if __has_include("lvgl.h")
         #ifndef LV_LVGL_H_INCLUDE_SIMPLE
             #define LV_LVGL_H_INCLUDE_SIMPLE
         #endif
     #endif
 #endif

 #ifdef LV_LVGL_H_INCLUDE_SIMPLE
     #include "lvgl.h"
 #else
     #include "../lvgl-8.3.11/lvgl.h"
 #endif

 #ifndef MONSTER_20
 #define MONSTER_20 1
 #endif

 #if MONSTER_20

/*-----------------
 *    BITMAPS
 *----------------*/
/*Store the image of the glyphs*/
static LV_ATTRIBUTE_LARGE_CONST const uint8_t monster_20_glyph_bitmap[] = {
    /* U+0020 " " */
    /* U+0021 "!" */
    0x0, 0x0, 0x1f, 0xd0, 0xbf, 0x3, 0xfc, 0xf,
    0xe0, 0x7f, 0x2, 0xfc, 0xb, 0xe0, 0x3f, 0x80,
    0xfd, 0x3, 0xf0, 0x5, 0x0, 0x7e, 0x2, 0xf4,
    0x7, 0xc0, 0x0, 0x0,
    /* U+0030 "0" */
    0x0, 0xf, 0xe0, 0x0, 0x3f, 0xff, 0x0, 0x7f,
    0xff, 0xe0, 0x3f, 0xfb, 0xfc, 0x1f, 0xf4, 0xff,
    0xf, 0xf0, 0x2f, 0xc3, 0xf0, 0xb, 0xf1, 0xfc,
    0x3, 0xfc, 0xbe, 0x1, 0xfd, 0x2f, 0x80, 0xff,
    0x7, 0xf5, 0xff, 0x40, 0xff, 0xff, 0x40, 0x2f,
    0xff, 0x40, 0x1, 0xfe, 0x0, 0x0,
    /* U+0031 "1" */
    0x2, 0x60, 0x2f, 0xc2, 0xff, 0x1f, 0xfc, 0x2f,
    0xe0, 0xbf, 0x42, 0xfc, 0xf, 0xf0, 0x3f, 0x80,
    0xfd, 0x3, 0xf0, 0x1f, 0xc0, 0x7e, 0x1, 0xb8,
    0x0, 0x0, 0x0,
    /* U+0032 "2" */
    0x0, 0x0, 0xf, 0xe0, 0x1f, 0xfc, 0xf, 0xfd,
    0xb, 0xfe, 0x0, 0xfe, 0x0, 0xfe, 0x0, 0xfd,
    0x3, 0xfc, 0x7, 0xf4, 0xf, 0xe0, 0x3f, 0x80,
    0x7f, 0xfd, 0x7f, 0xfd, 0xbf, 0xfc,
    /* U+0033 "3" */
    0x1, 0x90, 0x3, 0xfc, 0xb, 0xfe, 0xf, 0xfe,
    0x1, 0xfe, 0x1, 0xfc, 0xb, 0xf4, 0x1f, 0xf0,
    0x1f, 0xf0, 0x3, 0xf4, 0x7, 0xf4, 0x7f, 0xf0,
    0x7f, 0xc0, 0x7d, 0x0,
    /* U+0034 "4" */
    0x0, 0x0, 0x0, 0x0, 0x3f, 0xed, 0x0, 0xbf,
    0xfc, 0x1, 0xff, 0xf8, 0x3, 0xff, 0xf4, 0xf,
    0xff, 0xf0, 0x2f, 0xdb, 0xf0, 0x3f, 0xdf, 0xe0,
    0xbf, 0xff, 0xd0, 0x7f, 0xff, 0xc0, 0x2a, 0xbf,
    0xc0, 0x0, 0x2f, 0x80, 0x0, 0x2f, 0x80, 0x0,
    0x3f, 0x40, 0x0, 0x3b, 0x0, 0x0, 0x0, 0x0,
    /* U+0035 "5" */
    0x0, 0x0, 0x0, 0xbf, 0xfd, 0xf, 0xff, 0xc0,
    0xff, 0xf8, 0xf, 0xfa, 0x40, 0xfd, 0x0, 0x1f,
    0xc0, 0x0, 0xff, 0x40, 0xf, 0xfc, 0x0, 0x6f,
    0xe0, 0x0, 0xbe, 0x0, 0xf, 0xe0, 0x7b, 0xfc,
    0x7, 0xff, 0x40, 0x7f, 0xd0, 0x1, 0x50, 0x0,
    /* U+0036 "6" */
    0x0, 0x20, 0x0, 0x3f, 0xd0, 0x2f, 0xf0, 0x1f,
    0xf0, 0xf, 0xf0, 0xb, 0xf0, 0x3, 0xfb, 0xd1,
    0xfd, 0xfc, 0xbe, 0x7f, 0xaf, 0x47, 0xeb, 0xf2,
    0xf5, 0xff, 0xfc, 0x2f, 0xfc, 0x2, 0xf8, 0x0,
    /* U+0037 "7" */
    0x0, 0x0, 0xf, 0xff, 0xe7, 0xff, 0xf6, 0xff,
    0xfe, 0x2b, 0xfe, 0x0, 0xbf, 0x40, 0x3f, 0xc0,
    0x1f, 0xc0, 0xf, 0xe0, 0x3, 0xf0, 0x1, 0xfc,
    0x0, 0xbd, 0x0, 0x3f, 0x0, 0x1f, 0xc0, 0x1,
    0x90, 0x0,
    /* U+0038 "8" */
    0x0, 0x7f, 0x40, 0x2f, 0xfd, 0x7, 0xff, 0xf0,
    0xff, 0xff, 0xf, 0xcb, 0xe0, 0xfe, 0xfd, 0xf,
    0xff, 0x80, 0xbf, 0xe0, 0x2f, 0xfe, 0x7, 0xf7,
    0xf0, 0xbe, 0x3f, 0xb, 0xff, 0xe0, 0x3f, 0xfc,
    0x1, 0xfe, 0x0,
    /* U+0039 "9" */
    0x1, 0xb9, 0x0, 0xbf, 0xf8, 0x2f, 0xff, 0xd3,
    0xff, 0xfe, 0x7f, 0xf, 0xfb, 0xe0, 0xbf, 0x7f,
    0x8f, 0xe3, 0xfd, 0xfd, 0xb, 0xaf, 0xc0, 0x7,
    0xf4, 0x0, 0xfe, 0x0, 0x2f, 0xc0, 0xb, 0xf0,
    0x1, 0xbc, 0x0,
    /* U+003F "?" */
    0x3f, 0xd0, 0x7f, 0xf8, 0x3f, 0xfc, 0x17, 0xfc,
    0x2, 0xfc, 0x2, 0xfc, 0x7, 0xf8, 0xf, 0xf0,
    0x2f, 0xc0, 0x3f, 0x40, 0x14, 0x0, 0x7f, 0x0,
    0xbe, 0x0, 0x7d, 0x0,
    /* U+0041 "A" */
    0x0, 0x0, 0x0, 0x0, 0xb, 0xe0, 0x0, 0x7f,
    0xc0, 0x3, 0xff, 0x0, 0x2f, 0xfc, 0x0, 0xff,
    0xf0, 0xb, 0xff, 0xc0, 0x3f, 0xff, 0x3, 0xfa,
    0xfc, 0x1f, 0xcb, 0xf0, 0xff, 0xbf, 0xc7, 0xff,
    0xff, 0x2f, 0xff, 0xfc, 0xfc, 0x7, 0xfb, 0xc0,
    0x1f, 0x80, 0x0, 0x0,
    /* U+0042 "B" */
    0x0, 0x0, 0x0, 0x2f, 0xf9, 0x0, 0xff, 0xff,
    0x3, 0xff, 0xfd, 0xf, 0xff, 0xf4, 0x3f, 0x4f,
    0xd2, 0xfc, 0x7f, 0xb, 0xff, 0xf0, 0x3f, 0xff,
    0xc0, 0xfd, 0x7f, 0x83, 0xf0, 0xfe, 0x1f, 0xcb,
    0xf8, 0x7f, 0xff, 0xc2, 0xff, 0xfd, 0xb, 0xdf,
    0x80, 0x0, 0x0, 0x0,
    /* U+0043 "C" */
    0x0, 0x0, 0x0, 0x1, 0xfd, 0x0, 0xff, 0xc0,
    0x3f, 0xfc, 0xf, 0xfe, 0x41, 0xff, 0x40, 0x3f,
    0xd0, 0x7, 0xf4, 0x0, 0xbf, 0x0, 0xb, 0xe0,
    0x0, 0xbf, 0x0, 0x7, 0xf8, 0x0, 0x3f, 0xfc,
    0x1, 0xff, 0xc0, 0x2, 0xf8, 0x0,
    /* U+0044 "D" */
    0x0, 0x0, 0x0, 0xf, 0xff, 0x80, 0x1f, 0xff,
    0xf0, 0x1f, 0xff, 0xf8, 0x1b, 0xdb, 0xfc, 0x1f,
    0xc2, 0xfc, 0x2f, 0xc1, 0xfd, 0x2f, 0x81, 0xfc,
    0x3f, 0x82, 0xfc, 0x3f, 0x43, 0xf8, 0x3f, 0x7,
    0xf4, 0x7f, 0x1f, 0xe0, 0x7f, 0xff, 0xc0, 0xbf,
    0xff, 0x0, 0xbe, 0xf8, 0x0, 0x0, 0x0, 0x0,
    /* U+0045 "E" */
    0x0, 0x0, 0x1, 0xff, 0xfd, 0x1f, 0xff, 0xc1,
    0xff, 0xfc, 0x1f, 0xea, 0x40, 0xfe, 0x0, 0x1f,
    0xd0, 0x2, 0xfe, 0xd0, 0x3f, 0xfd, 0x3, 0xff,
    0x40, 0x3f, 0x0, 0x7, 0xf0, 0x0, 0x7f, 0xfc,
    0xb, 0xff, 0xc0, 0xbf, 0xfc, 0x0, 0x0, 0x0,
    /* U+0046 "F" */
    0x0, 0x0, 0x0, 0xff, 0xff, 0x1f, 0xff, 0xe2,
    0xff, 0xfc, 0x1b, 0xf5, 0x41, 0xfd, 0x0, 0x2f,
    0xd0, 0x2, 0xff, 0xe0, 0x3f, 0xfd, 0x3, 0xfa,
    0x80, 0x3f, 0x0, 0x7, 0xf0, 0x0, 0xbe, 0x0,
    0xb, 0xd0, 0x0, 0xbc, 0x0, 0x0,
    /* U+0047 "G" */
    0x0, 0x0, 0x0, 0x0, 0xbf, 0x0, 0x1f, 0xfc,
    0x1, 0xff, 0xf0, 0xf, 0xfe, 0x0, 0xbf, 0x80,
    0x3, 0xf8, 0x0, 0x1f, 0xc3, 0xfd, 0xbe, 0x1f,
    0xf2, 0xf4, 0x6f, 0x8b, 0xd0, 0xbe, 0x1f, 0x83,
    0xf0, 0x3f, 0xff, 0x40, 0xbf, 0xf8, 0x0, 0x7f,
    0x40, 0x0,
    /* U+0048 "H" */
    0x0, 0x0, 0x0, 0x2, 0xbc, 0x1f, 0xd0, 0xfe,
    0xb, 0xf0, 0x3f, 0x83, 0xf8, 0x1f, 0xd0, 0xfd,
    0x7, 0xf0, 0x7f, 0x2, 0xfc, 0x1f, 0xc0, 0xff,
    0x5f, 0xe0, 0x3f, 0xff, 0xf4, 0xf, 0xef, 0xfc,
    0x3, 0xf0, 0x7f, 0x1, 0xfc, 0x1f, 0xc0, 0x7e,
    0xb, 0xe0, 0x2f, 0x42, 0xf4, 0xb, 0xc0, 0xfc,
    0x0, 0x0, 0x0, 0x0,
    /* U+0049 "I" */
    0x0, 0x0, 0x2e, 0xc0, 0xff, 0x3, 0xf8, 0x1f,
    0xe0, 0xbf, 0x43, 0xfc, 0xf, 0xf0, 0x3f, 0x80,
    0xfd, 0x7, 0xf0, 0x1f, 0xc0, 0x7f, 0x2, 0xf8,
    0x5, 0x80, 0x0,
    /* U+004A "J" */
    0x0, 0x0, 0x0, 0x3f, 0x90, 0xf, 0xf0, 0x3,
    0xfc, 0x1, 0xfe, 0x0, 0xbf, 0x40, 0x2f, 0xc0,
    0xf, 0xf0, 0x3, 0xf8, 0x0, 0xfd, 0x0, 0x3f,
    0x40, 0x1f, 0xc0, 0x7f, 0xf0, 0x1f, 0xf4, 0xb,
    0xe0, 0x0,
    /* U+004B "K" */
    0x0, 0x0, 0x0, 0xe, 0xe0, 0xe4, 0xf, 0xe2,
    0xfc, 0x1f, 0xd7, 0xf8, 0x2f, 0xdf, 0xe0, 0x2f,
    0xff, 0xc0, 0x3f, 0xff, 0x0, 0x3f, 0xfe, 0x0,
    0x3f, 0xff, 0x0, 0x3f, 0xbf, 0x40, 0x7f, 0x3f,
    0xc0, 0x7f, 0x2f, 0xd0, 0xbe, 0xf, 0xe0, 0xbd,
    0xf, 0xf0, 0xbc, 0x7, 0x50, 0x0, 0x0, 0x0,
    /* U+004C "L" */
    0x0, 0x0, 0xb, 0xb0, 0xf, 0xf0, 0xf, 0xe0,
    0x1f, 0xd0, 0x2f, 0xc0, 0x2f, 0xc0, 0x3f, 0xc0,
    0x3f, 0x80, 0x3f, 0x40, 0x3f, 0x0, 0x3f, 0x0,
    0x7f, 0xfe, 0xbf, 0xfe, 0xbf, 0xfe, 0x0, 0x0,
    /* U+004D "M" */
    0x0, 0x2b, 0x0, 0xb4, 0x0, 0x1f, 0xd0, 0x7f,
    0x0, 0xb, 0xf4, 0x3f, 0xd0, 0x3, 0xfe, 0x1f,
    0xf4, 0x2, 0xff, 0xcf, 0xfe, 0x0, 0xff, 0xf7,
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    0x40, 0xf4, 0xf, 0xc0, 0x0, 0x0, 0x0, 0x0,
    /* U+004E "N" */
    0x7, 0xa0, 0xe, 0xd0, 0xbf, 0x41, 0xfc, 0xf,
    0xfc, 0x2f, 0xc0, 0xff, 0xd3, 0xf8, 0x1f, 0xff,
    0x3f, 0x42, 0xff, 0xf7, 0xf0, 0x3f, 0xff, 0xff,
    0x3, 0xff, 0xff, 0xe0, 0x3f, 0x6f, 0xfe, 0x3,
    0xf0, 0xff, 0xd0, 0x7f, 0xb, 0xfc, 0x7, 0xe0,
    0x3f, 0xc0, 0xbe, 0x1, 0xfc, 0xb, 0x90, 0xf,
    0x80, 0x0, 0x0, 0x0, 0x0,
    /* U+004F "O" */
    0x0, 0xf, 0xe0, 0x0, 0x3f, 0xff, 0x0, 0x3f,
    0xff, 0xe0, 0x3f, 0xfb, 0xfc, 0x1f, 0xf4, 0xff,
    0xf, 0xf0, 0x2f, 0xc3, 0xf0, 0xb, 0xf1, 0xfc,
    0x3, 0xfc, 0xbe, 0x1, 0xfd, 0x2f, 0x80, 0xff,
    0x7, 0xf5, 0xbf, 0x40, 0xff, 0xff, 0x80, 0x2f,
    0xff, 0x40, 0x1, 0xfe, 0x0, 0x0,
    /* U+0050 "P" */
    0x0, 0x0, 0x0, 0xbf, 0xfe, 0x2, 0xff, 0xff,
    0xf, 0xff, 0xfd, 0x1f, 0xeb, 0xf4, 0xbf, 0xf,
    0xd3, 0xfc, 0x7f, 0xf, 0xfb, 0xf8, 0x3f, 0xff,
    0xc0, 0xfe, 0xf8, 0x7, 0xf1, 0x0, 0x1f, 0x80,
    0x0, 0xbe, 0x0, 0x2, 0xf4, 0x0, 0xa, 0xc0,
    0x0, 0x0, 0x0, 0x0,
    /* U+0051 "Q" */
    0x0, 0xf, 0xd0, 0x0, 0xfb, 0xf4, 0x7, 0xff,
    0xfc, 0xf, 0xff, 0xfe, 0x1f, 0xf0, 0xfe, 0x3f,
    0xc0, 0xbf, 0x7f, 0x40, 0xbe, 0xbf, 0x0, 0xbd,
    0xbe, 0x2, 0xfc, 0xbd, 0xf, 0xf8, 0x7f, 0xf,
    0xf0, 0x3f, 0xff, 0xf4, 0x1f, 0xff, 0xfc, 0x7,
    0xf8, 0xfd, 0x0, 0x0, 0x0,
    /* U+0052 "R" */
    0x0, 0x0, 0x0, 0xbf, 0xf9, 0x3, 0xff, 0xfe,
    0xb, 0xff, 0xfc, 0x1f, 0xef, 0xf4, 0xbf, 0xf,
    0xd3, 0xfc, 0x7f, 0xf, 0xfb, 0xf4, 0x3f, 0xff,
    0x40, 0xff, 0xfc, 0x3, 0xf7, 0xf4, 0x1f, 0x8b,
    0xf0, 0x7e, 0x1f, 0xc2, 0xf0, 0x2f, 0x46, 0x80,
    0x3e, 0x0, 0x0, 0x0,
    /* U+0053 "S" */
    0x0, 0x0, 0x0, 0x2f, 0xe0, 0x7f, 0xf8, 0x7f,
    0xfc, 0x2f, 0xfa, 0xf, 0xf4, 0x2, 0xff, 0x0,
    0x7f, 0xe0, 0xb, 0xfc, 0x0, 0xbf, 0x40, 0xf,
    0xe0, 0x47, 0xf4, 0x3f, 0xfc, 0x2f, 0xfc, 0x7,
    0xf8, 0x0, 0x0, 0x0,
    /* U+0054 "T" */
    0x0, 0x0, 0x7, 0xff, 0xfc, 0x7f, 0xff, 0xcb,
    0xff, 0xf8, 0x1f, 0xf5, 0x0, 0xbf, 0x0, 0xf,
    0xf0, 0x0, 0xfe, 0x0, 0xf, 0xe0, 0x0, 0xfd,
    0x0, 0x1f, 0xc0, 0x1, 0xfc, 0x0, 0x2f, 0x80,
    0x2, 0xf4, 0x0, 0x2f, 0x0, 0x0, 0x0, 0x0,
    /* U+0055 "U" */
    0x0, 0x0, 0x0, 0x3, 0xf8, 0x2f, 0xc0, 0xfe,
    0xf, 0xf0, 0x7f, 0x87, 0xf4, 0x2f, 0xd2, 0xfc,
    0xf, 0xf0, 0xff, 0x3, 0xf8, 0x3f, 0x80, 0xfd,
    0x1f, 0xd0, 0x7f, 0x7, 0xf0, 0x1f, 0xc2, 0xfc,
    0xb, 0xf0, 0xfe, 0x2, 0xfd, 0xff, 0x80, 0xbf,
    0xff, 0xc0, 0x1f, 0xff, 0xf0, 0x2, 0xfe, 0xb8,
    0x0, 0x0, 0x0, 0x0,
    /* U+0056 "V" */
    0x0, 0x0, 0x2, 0xed, 0xf, 0xcb, 0xf4, 0xbf,
    0x1f, 0xd3, 0xf8, 0x7f, 0x4f, 0xd0, 0xfd, 0x7f,
    0x3, 0xfa, 0xf4, 0xf, 0xef, 0xc0, 0x3f, 0xfe,
    0x0, 0xbf, 0xf4, 0x1, 0xff, 0xc0, 0x3, 0xfe,
    0x0, 0xf, 0xf4, 0x0, 0x2f, 0xc0, 0x0, 0x6e,
    0x0, 0x0, 0x0, 0x0,
    /* U+0057 "W" */
    0x0, 0x0, 0x0, 0x0, 0xb, 0xf4, 0x3f, 0x41,
    0xfd, 0xbf, 0x47, 0xf8, 0x3f, 0xcb, 0xf4, 0xbf,
    0x83, 0xf4, 0x7f, 0x4f, 0xf8, 0xbf, 0x7, 0xf6,
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    0x40, 0x3e, 0x0, 0x0, 0x0, 0x0, 0x0, 0x0,
    /* U+0058 "X" */
    0x0, 0x0, 0x0, 0x3, 0xfc, 0x2f, 0xc0, 0xff,
    0x1f, 0xd0, 0x2f, 0xdf, 0xe0, 0x7, 0xff, 0xf0,
    0x0, 0xff, 0xf0, 0x0, 0x3f, 0xf4, 0x0, 0x7,
    0xf8, 0x0, 0x1, 0xfd, 0x0, 0x0, 0xff, 0x80,
    0x0, 0x7f, 0xf0, 0x0, 0x3f, 0xfc, 0x0, 0x2f,
    0xbf, 0x40, 0xf, 0xc7, 0xf0, 0xb, 0xd0, 0xbc,
    0x0, 0x0, 0x0, 0x0,
    /* U+0059 "Y" */
    0x0, 0x0, 0x0, 0x1b, 0xd0, 0xfe, 0xf, 0xe2,
    0xfc, 0xf, 0xe7, 0xf4, 0xb, 0xff, 0xe0, 0x7,
    0xff, 0xc0, 0x3, 0xff, 0x0, 0x2, 0xfd, 0x0,
    0x2, 0xfc, 0x0, 0x3, 0xf0, 0x0, 0xb, 0xe0,
    0x0, 0xf, 0xc0, 0x0, 0x2f, 0x40, 0x0, 0x3f,
    0x0, 0x0, 0xbc, 0x0, 0x0,
    /* U+005A "Z" */
    0x0, 0x0, 0x0, 0xff, 0xff, 0xf, 0xff, 0xe1,
    0xff, 0xfd, 0x5, 0xff, 0x40, 0xf, 0xf4, 0x2,
    0xfe, 0x0, 0x3f, 0xc0, 0xb, 0xf4, 0x0, 0xfe,
    0x0, 0x2f, 0xc0, 0x3, 0xf8, 0x0, 0x7f, 0xff,
    0xb, 0xff, 0xf0, 0xbf, 0xff, 0x0, 0x0, 0x0,
    /* U+0061 "a" */
    0x0, 0x0, 0x0, 0x3, 0xe0, 0x3, 0xf8, 0x1,
    0xfe, 0x0, 0xff, 0xc0, 0xbf, 0xf0, 0x3e, 0xfc,
    0x2f, 0x3f, 0xf, 0xef, 0x8b, 0xff, 0xe3, 0xe4,
    0xfa, 0xe0, 0x3e, 0x0, 0x0, 0x0,
    /* U+0062 "b" */
    0x0, 0x0, 0x3, 0xfe, 0x1, 0xff, 0xf0, 0xbf,
    0xfd, 0x1f, 0x5f, 0x4f, 0xdf, 0x83, 0xff, 0xc0,
    0xfa, 0xf8, 0x7d, 0x3e, 0x1f, 0x7f, 0x8b, 0xff,
    0xc2, 0xef, 0x80, 0x0, 0x0, 0x0,
    /* U+0063 "c" */
    0x0, 0x0, 0x0, 0xbd, 0x3, 0xfd, 0xf, 0xf8,
    0x2f, 0xc0, 0x3f, 0x0, 0xbc, 0x0, 0xbc, 0x0,
    0xbd, 0x0, 0x7f, 0x90, 0x2f, 0xe0, 0x6, 0x80,
    /* U+0064 "d" */
    0x0, 0x0, 0x1, 0xff, 0xd0, 0x2f, 0xff, 0x42,
    0xff, 0xfc, 0x2f, 0xf, 0xc3, 0xf0, 0xfc, 0x3f,
    0xf, 0xc3, 0xe0, 0xf8, 0x7d, 0x2f, 0x47, 0xdb,
    0xe0, 0xbf, 0xfc, 0xb, 0xbe, 0x0, 0x0, 0x0,
    0x0,
    /* U+0065 "e" */
    0x0, 0x0, 0x1f, 0xfe, 0x2f, 0xfc, 0x2f, 0xfc,
    0xf, 0x40, 0x2f, 0x40, 0x3f, 0xf0, 0x3f, 0xe0,
    0x7d, 0x0, 0x7e, 0x50, 0xbf, 0xf0, 0xbf, 0xe0,
    0x0, 0x0,
    /* U+0066 "f" */
    0x1f, 0xff, 0x3f, 0xfe, 0x2f, 0xe8, 0x2f, 0x40,
    0x3f, 0x90, 0x3f, 0xf0, 0x3f, 0x90, 0x7c, 0x0,
    0xbc, 0x0, 0xbc, 0x0, 0x74, 0x0,
    /* U+0067 "g" */
    0x0, 0x0, 0x0, 0x2f, 0x40, 0x7f, 0xd0, 0x3f,
    0xe0, 0x3f, 0x80, 0x1f, 0x85, 0x4b, 0xc7, 0xf6,
    0xf1, 0xfc, 0xb8, 0x3e, 0x1f, 0x6f, 0x3, 0xff,
    0x40, 0x3f, 0x40,
    /* U+0068 "h" */
    0x0, 0x0, 0x0, 0xfc, 0x3e, 0x1f, 0x87, 0xe2,
    0xf4, 0xbd, 0x3f, 0xf, 0xc3, 0xf0, 0xf8, 0x3f,
    0xff, 0x43, 0xef, 0xf0, 0x7c, 0x2f, 0x7, 0xc3,
    0xf0, 0xbc, 0x3e, 0xb, 0x83, 0xd0, 0x0, 0x0,
    0x0,
    /* U+0069 "i" */
    0x0, 0x3, 0xb1, 0xf8, 0xbd, 0x3f, 0x4f, 0xc3,
    0xf1, 0xf8, 0x7d, 0x2f, 0xb, 0xc2, 0xe0, 0x0,
    0x0,
    /* U+006A "j" */
    0x0, 0x0, 0xb, 0xe0, 0x3f, 0x40, 0xfc, 0x3,
    0xf0, 0x1f, 0x80, 0xbd, 0x2, 0xf4, 0xf, 0xc0,
    0x7f, 0x7, 0xf8, 0x2f, 0x40,
    /* U+006B "k" */
    0x0, 0x0, 0x1, 0xf8, 0x74, 0x2f, 0x9f, 0xc2,
    0xf7, 0xf0, 0x3f, 0xfc, 0x3, 0xff, 0x40, 0x3f,
    0xf0, 0x7, 0xef, 0x80, 0x7c, 0xfc, 0xb, 0xc7,
    0xe0, 0xbc, 0x3f, 0xb, 0x82, 0xa0, 0x0, 0x0,
    0x0,
    /* U+006C "l" */
    0x0, 0x0, 0x3e, 0x1, 0xf8, 0xb, 0xd0, 0x3f,
    0x0, 0xfc, 0x3, 0xf0, 0xf, 0x80, 0x7d, 0x1,
    0xf9, 0x4b, 0xff, 0x2f, 0xfc, 0x0, 0x0,
    /* U+006D "m" */
    0x0, 0x54, 0x9, 0x0, 0xf, 0x82, 0xf4, 0x2,
    0xfc, 0x3f, 0x40, 0x3f, 0xcb, 0xf8, 0x7, 0xfd,
    0xff, 0x80, 0xff, 0xff, 0xfc, 0x1f, 0xff, 0xff,
    0xc2, 0xf3, 0xfc, 0xfc, 0x3e, 0x3f, 0x8f, 0xc7,
    0xc2, 0xf0, 0xfc, 0xbc, 0x1e, 0xb, 0xc0, 0x0,
    0x0, 0x0,
    /* U+006E "n" */
    0xf, 0x80, 0xb8, 0x3f, 0x7, 0xd1, 0xff, 0x2f,
    0xb, 0xfc, 0xbc, 0x3f, 0xfb, 0xe0, 0xff, 0xff,
    0x83, 0xeb, 0xfd, 0x1f, 0x4f, 0xf0, 0x7c, 0x2f,
    0xc2, 0xf0, 0x3f, 0xb, 0x80, 0x78, 0x0, 0x0,
    0x0,
    /* U+006F "o" */
    0x0, 0x7e, 0x0, 0x7f, 0xfc, 0xf, 0xff, 0xd2,
    0xfc, 0x7e, 0x3f, 0x7, 0xe7, 0xc0, 0x7e, 0xbc,
    0xf, 0xcb, 0xc1, 0xf8, 0x7f, 0xbf, 0x3, 0xff,
    0xc0, 0xf, 0xe0, 0x0,
    /* U+0070 "p" */
    0x0, 0x0, 0xf, 0xff, 0x3, 0xff, 0xf0, 0xbe,
    0xfd, 0x3f, 0x1f, 0x4f, 0xcf, 0xc3, 0xff, 0xd1,
    0xff, 0xd0, 0x7c, 0x40, 0x2f, 0x0, 0xb, 0xc0,
    0x2, 0xa0, 0x0,
    /* U+0071 "q" */
    0x0, 0x7d, 0x0, 0x7f, 0xf8, 0xf, 0xff, 0xc2,
    0xfc, 0xbd, 0x3f, 0x7, 0xd7, 0xc0, 0x7c, 0xbc,
    0xf, 0xcb, 0xc7, 0xf4, 0x7e, 0x7f, 0x3, 0xff,
    0xf8, 0xb, 0xeb, 0xc0, 0x0, 0x0,
    /* U+0072 "r" */
    0x0, 0x0, 0xf, 0xfe, 0x3, 0xff, 0xe0, 0xbf,
    0xfc, 0x3f, 0x2f, 0xf, 0xcf, 0x83, 0xff, 0xc0,
    0xff, 0xd0, 0x7d, 0xf8, 0x1f, 0x2f, 0xb, 0x83,
    0xd1, 0x90, 0xb4, 0x0, 0x0, 0x0,
    /* U+0073 "s" */
    0x0, 0x0, 0xb, 0xf1, 0xff, 0x8f, 0xf9, 0x3f,
    0x40, 0xff, 0x1, 0xfe, 0x1, 0xfc, 0x3, 0xf0,
    0xaf, 0x8b, 0xfc, 0x2f, 0x80, 0x0, 0x0,
    /* U+0074 "t" */
    0x7f, 0xfc, 0x7f, 0xfc, 0x6f, 0xf8, 0xf, 0xc0,
    0x1f, 0xc0, 0x1f, 0x80, 0x2f, 0x40, 0x2f, 0x0,
    0x2f, 0x0, 0x3e, 0x0, 0x39, 0x0, 0x0, 0x0,
    /* U+0075 "u" */
    0x0, 0x0, 0x1, 0xf8, 0x7e, 0x2f, 0x8b, 0xd3,
    0xf4, 0xfc, 0x3f, 0xf, 0xc3, 0xf1, 0xf8, 0x7e,
    0x2f, 0x47, 0xd3, 0xf0, 0xbc, 0x3f, 0xb, 0xef,
    0xe0, 0xbf, 0xfd, 0x3, 0xfa, 0xc0, 0x0, 0x0,
    0x0,
    /* U+0076 "v" */
    0x0, 0x0, 0x2e, 0x87, 0xcb, 0xe3, 0xf1, 0xf8,
    0xf8, 0x7e, 0x7c, 0xf, 0xbe, 0x3, 0xff, 0x40,
    0xff, 0xc0, 0x2f, 0xe0, 0x7, 0xf4, 0x1, 0xfc,
    0x0, 0x3e, 0x0, 0x0, 0x0, 0x0,
    /* U+0077 "w" */
    0x0, 0x0, 0x0, 0x2, 0xf4, 0x7d, 0xf, 0xcb,
    0xd2, 0xf8, 0xbd, 0x2f, 0x4f, 0xe3, 0xf0, 0x7d,
    0xbf, 0x9f, 0x41, 0xfb, 0xff, 0xbc, 0x7, 0xff,
    0xff, 0xe0, 0xf, 0xfb, 0xff, 0x0, 0x3f, 0xcb,
    0xfc, 0x0, 0xfe, 0x1f, 0xd0, 0x2, 0xf0, 0x3f,
    0x0, 0x7, 0x80, 0xf8, 0x0, 0x0, 0x0, 0x0,
    0x0,
    /* U+0078 "x" */
    0x1f, 0x83, 0xe0, 0xfc, 0xfc, 0xf, 0xff, 0x0,
    0xbf, 0xd0, 0x7, 0xf8, 0x0, 0x3f, 0x0, 0x7,
    0xf0, 0x0, 0xff, 0x40, 0x1f, 0xf8, 0x3, 0xdb,
    0xc0, 0xb8, 0x3d, 0x0, 0x0, 0x0,
    /* U+0079 "y" */
    0x0, 0x0, 0x2, 0xf4, 0xbd, 0x1f, 0x9f, 0x80,
    0xff, 0xf0, 0xf, 0xfc, 0x0, 0x7f, 0x40, 0x3,
    0xe0, 0x0, 0xbc, 0x0, 0xf, 0x40, 0x2, 0xf0,
    0x0, 0x3c, 0x0, 0xb, 0x80, 0x0,
    /* U+007A "z" */
    0x0, 0x0, 0x1f, 0xff, 0x1f, 0xfe, 0x1b, 0xfd,
    0x3, 0xf8, 0x7, 0xf0, 0xf, 0xd0, 0x1f, 0x80,
    0x3f, 0x0, 0x7f, 0x50, 0xbf, 0xf4, 0xbf, 0xf4,
    0x0, 0x0
};
/*---------------------
 *  GLYPH DESCRIPTION
 *--------------------*/
static const lv_font_fmt_txt_glyph_dsc_t monster_20_glyph_dsc[] = {
    {.bitmap_index = 0, .adv_w = 0, .box_w = 0, .box_h = 0, .ofs_x = 0, .ofs_y = 0} /* id = 0 reserved */,
    {.bitmap_index = 0, .adv_w = 128, .box_w = 0, .box_h = 0, .ofs_x = 0, .ofs_y = 0},
    {.bitmap_index = 0, .adv_w = 108, .box_w = 7, .box_h = 16, .ofs_x = 0, .ofs_y = -1},
    {.bitmap_index = 28, .adv_w = 201, .box_w = 13, .box_h = 14, .ofs_x = 0, .ofs_y = 0},
    {.bitmap_index = 74, .adv_w = 107, .box_w = 7, .box_h = 15, .ofs_x = 0, .ofs_y = -1},
    {.bitmap_index = 101, .adv_w = 129, .box_w = 8, .box_h = 15, .ofs_x = 0, .ofs_y = 0},
    {.bitmap_index = 131, .adv_w = 129, .box_w = 8, .box_h = 14, .ofs_x = 0, .ofs_y = 0},
    {.bitmap_index = 159, .adv_w = 188, .box_w = 12, .box_h = 16, .ofs_x = 0, .ofs_y = -1},
    {.bitmap_index = 207, .adv_w = 157, .box_w = 10, .box_h = 16, .ofs_x = 0, .ofs_y = -1},
    {.bitmap_index = 247, .adv_w = 143, .box_w = 9, .box_h = 14, .ofs_x = 0, .ofs_y = 0},
    {.bitmap_index = 279, .adv_w = 146, .box_w = 9, .box_h = 15, .ofs_x = 0, .ofs_y = 0},
    {.bitmap_index = 313, .adv_w = 164, .box_w = 10, .box_h = 14, .ofs_x = 0, .ofs_y = 0},
    {.bitmap_index = 348, .adv_w = 163, .box_w = 10, .box_h = 14, .ofs_x = 0, .ofs_y = 0},
    {.bitmap_index = 383, .adv_w = 122, .box_w = 8, .box_h = 14, .ofs_x = 0, .ofs_y = 0},
    {.bitmap_index = 411, .adv_w = 180, .box_w = 11, .box_h = 16, .ofs_x = 0, .ofs_y = -1},
    {.bitmap_index = 455, .adv_w = 173, .box_w = 11, .box_h = 16, .ofs_x = 0, .ofs_y = -1},
    {.bitmap_index = 499, .adv_w = 156, .box_w = 10, .box_h = 15, .ofs_x = 0, .ofs_y = 0},
    {.bitmap_index = 537, .adv_w = 187, .box_w = 12, .box_h = 16, .ofs_x = 0, .ofs_y = -1},
    {.bitmap_index = 585, .adv_w = 155, .box_w = 10, .box_h = 16, .ofs_x = 0, .ofs_y = -1},
    {.bitmap_index = 625, .adv_w = 163, .box_w = 10, .box_h = 15, .ofs_x = 0, .ofs_y = 0},
    {.bitmap_index = 663, .adv_w = 172, .box_w = 11, .box_h = 15, .ofs_x = 0, .ofs_y = 0},
    {.bitmap_index = 705, .adv_w = 203, .box_w = 13, .box_h = 16, .ofs_x = 0, .ofs_y = -1},
    {.bitmap_index = 757, .adv_w = 103, .box_w = 7, .box_h = 15, .ofs_x = 0, .ofs_y = 0},
    {.bitmap_index = 784, .adv_w = 139, .box_w = 9, .box_h = 15, .ofs_x = 0, .ofs_y = 0},
    {.bitmap_index = 818, .adv_w = 186, .box_w = 12, .box_h = 16, .ofs_x = 0, .ofs_y = -1},
    {.bitmap_index = 866, .adv_w = 132, .box_w = 8, .box_h = 16, .ofs_x = 0, .ofs_y = -1},
    {.bitmap_index = 898, .adv_w = 264, .box_w = 17, .box_h = 15, .ofs_x = 0, .ofs_y = -1},
    {.bitmap_index = 962, .adv_w = 219, .box_w = 14, .box_h = 15, .ofs_x = 0, .ofs_y = -1},
    {.bitmap_index = 1015, .adv_w = 201, .box_w = 13, .box_h = 14, .ofs_x = 0, .ofs_y = 0},
    {.bitmap_index = 1061, .adv_w = 174, .box_w = 11, .box_h = 16, .ofs_x = 0, .ofs_y = -1},
    {.bitmap_index = 1105, .adv_w = 195, .box_w = 12, .box_h = 15, .ofs_x = 0, .ofs_y = -1},
    {.bitmap_index = 1150, .adv_w = 171, .box_w = 11, .box_h = 16, .ofs_x = 0, .ofs_y = -1},
    {.bitmap_index = 1194, .adv_w = 144, .box_w = 9, .box_h = 16, .ofs_x = 0, .ofs_y = -1},
    {.bitmap_index = 1230, .adv_w = 149, .box_w = 10, .box_h = 16, .ofs_x = 0, .ofs_y = -1},
    {.bitmap_index = 1270, .adv_w = 199, .box_w = 13, .box_h = 16, .ofs_x = 0, .ofs_y = -1},
    {.bitmap_index = 1322, .adv_w = 166, .box_w = 11, .box_h = 16, .ofs_x = 0, .ofs_y = -1},
    {.bitmap_index = 1366, .adv_w = 284, .box_w = 18, .box_h = 16, .ofs_x = 0, .ofs_y = -1},
    {.bitmap_index = 1438, .adv_w = 200, .box_w = 13, .box_h = 16, .ofs_x = 0, .ofs_y = -1},
    {.bitmap_index = 1490, .adv_w = 193, .box_w = 12, .box_h = 15, .ofs_x = 0, .ofs_y = 0},
    {.bitmap_index = 1535, .adv_w = 163, .box_w = 10, .box_h = 16, .ofs_x = 0, .ofs_y = -1},
    {.bitmap_index = 1575, .adv_w = 146, .box_w = 9, .box_h = 13, .ofs_x = 0, .ofs_y = -1},
    {.bitmap_index = 1605, .adv_w = 140, .box_w = 9, .box_h = 13, .ofs_x = 0, .ofs_y = -1},
    {.bitmap_index = 1635, .adv_w = 126, .box_w = 8, .box_h = 12, .ofs_x = 0, .ofs_y = 0},
    {.bitmap_index = 1659, .adv_w = 152, .box_w = 10, .box_h = 13, .ofs_x = 0, .ofs_y = -1},
    {.bitmap_index = 1692, .adv_w = 127, .box_w = 8, .box_h = 13, .ofs_x = 0, .ofs_y = -1},
    {.bitmap_index = 1718, .adv_w = 131, .box_w = 8, .box_h = 11, .ofs_x = 0, .ofs_y = 0},
    {.bitmap_index = 1740, .adv_w = 140, .box_w = 9, .box_h = 12, .ofs_x = 0, .ofs_y = 0},
    {.bitmap_index = 1767, .adv_w = 163, .box_w = 10, .box_h = 13, .ofs_x = 0, .ofs_y = -1},
    {.bitmap_index = 1800, .adv_w = 83, .box_w = 5, .box_h = 13, .ofs_x = 0, .ofs_y = -1},
    {.bitmap_index = 1817, .adv_w = 112, .box_w = 7, .box_h = 12, .ofs_x = 0, .ofs_y = 0},
    {.bitmap_index = 1838, .adv_w = 149, .box_w = 10, .box_h = 13, .ofs_x = 0, .ofs_y = -1},
    {.bitmap_index = 1871, .adv_w = 106, .box_w = 7, .box_h = 13, .ofs_x = 0, .ofs_y = -1},
    {.bitmap_index = 1894, .adv_w = 213, .box_w = 14, .box_h = 12, .ofs_x = 0, .ofs_y = -1},
    {.bitmap_index = 1936, .adv_w = 177, .box_w = 11, .box_h = 12, .ofs_x = 0, .ofs_y = -1},
    {.bitmap_index = 1969, .adv_w = 161, .box_w = 10, .box_h = 11, .ofs_x = 0, .ofs_y = 0},
    {.bitmap_index = 1997, .adv_w = 140, .box_w = 9, .box_h = 12, .ofs_x = 0, .ofs_y = 0},
    {.bitmap_index = 2024, .adv_w = 156, .box_w = 10, .box_h = 12, .ofs_x = 0, .ofs_y = -1},
    {.bitmap_index = 2054, .adv_w = 135, .box_w = 9, .box_h = 13, .ofs_x = 0, .ofs_y = -1},
    {.bitmap_index = 2084, .adv_w = 116, .box_w = 7, .box_h = 13, .ofs_x = 0, .ofs_y = -1},
    {.bitmap_index = 2107, .adv_w = 120, .box_w = 8, .box_h = 12, .ofs_x = 0, .ofs_y = -1},
    {.bitmap_index = 2131, .adv_w = 161, .box_w = 10, .box_h = 13, .ofs_x = 0, .ofs_y = -1},
    {.bitmap_index = 2164, .adv_w = 134, .box_w = 9, .box_h = 13, .ofs_x = 0, .ofs_y = -1},
    {.bitmap_index = 2194, .adv_w = 228, .box_w = 15, .box_h = 13, .ofs_x = 0, .ofs_y = -1},
    {.bitmap_index = 2243, .adv_w = 162, .box_w = 10, .box_h = 12, .ofs_x = 0, .ofs_y = -1},
    {.bitmap_index = 2273, .adv_w = 157, .box_w = 10, .box_h = 12, .ofs_x = 0, .ofs_y = 0},
    {.bitmap_index = 2303, .adv_w = 133, .box_w = 8, .box_h = 13, .ofs_x = 0, .ofs_y = -1}
};
/*---------------------
 *  CHARACTER MAPPING
 *--------------------*/
static const uint16_t monster_20_unicode_list_0[] = {
    0x0, 0x1, 0x10, 0x11, 0x12, 0x13, 0x14, 0x15,
    0x16, 0x17, 0x18, 0x19, 0x1f
};
/*Collect the unicode lists and glyph_id offsets*/
static const lv_font_fmt_txt_cmap_t monster_20_cmaps[] =
{
    {
        .range_start = 32, .range_length = 32, .glyph_id_start = 1,
        .unicode_list = monster_20_unicode_list_0, .glyph_id_ofs_list = NULL, .list_length = 13, .type = LV_FONT_FMT_TXT_CMAP_SPARSE_TINY
    },
    {
        .range_start = 65, .range_length = 26, .glyph_id_start = 14,
        .unicode_list = NULL, .glyph_id_ofs_list = NULL, .list_length = 0, .type = LV_FONT_FMT_TXT_CMAP_FORMAT0_TINY
    },
    {
        .range_start = 97, .range_length = 26, .glyph_id_start = 40,
        .unicode_list = NULL, .glyph_id_ofs_list = NULL, .list_length = 0, .type = LV_FONT_FMT_TXT_CMAP_FORMAT0_TINY
    }
};
/*--------------------
 *  ALL CUSTOM DATA
 *--------------------*/
/*Store all the custom data of the font*/
static lv_font_fmt_txt_glyph_cache_t monster_20_cache;
static const lv_font_fmt_txt_dsc_t monster_20_font_dsc = {
    .glyph_bitmap = monster_20_glyph_bitmap,
    .glyph_dsc = monster_20_glyph_dsc,
    .cmaps = monster_20_cmaps,
    .kern_dsc = NULL,
    .kern_scale = 0,
    .cmap_num = 3,
    .bpp = 2,
    .kern_classes = 0,
    .bitmap_format = 0,
    .cache = &monster_20_cache
};
/*-----------------
 *  PUBLIC FONT
 *----------------*/
/*Initialize a public general font descriptor*/
const lv_font_t monster_20 = {
    .get_glyph_dsc = lv_font_get_glyph_dsc_fmt_txt,    /*Function pointer to get glyph's data*/
    .get_glyph_bitmap = lv_font_get_bitmap_fmt_txt,    /*Function pointer to get glyph's bitmap*/
    .line_height = 16,          /*The maximum line height required by the font*/
    .base_line = 1,             /*Baseline measured from the bottom of the line*/

    .subpx = LV_FONT_SUBPX_NONE,
    .underline_position = -1,
    .underline_thickness = 1,
    .dsc = &monster_20_font_dsc,          /*The custom font data. Will be accessed by `get_glyph_bitmap/dsc` */
};
#endif

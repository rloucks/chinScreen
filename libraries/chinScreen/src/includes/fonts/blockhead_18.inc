/*******************************************************************************
 * Size: 17 px
 * Bpp: 2
 ******************************************************************************/


#ifdef __has_include

    #if __has_include("lvgl.h")
         #ifndef LV_LVGL_H_INCLUDE_SIMPLE
             #define LV_LVGL_H_INCLUDE_SIMPLE
         #endif
     #endif
 #endif

 #ifdef LV_LVGL_H_INCLUDE_SIMPLE
     #include "lvgl.h"
 #else
     #include "../lvgl-8.3.11/lvgl.h"
 #endif

 #ifndef BLOCKHEAD_18
 #define BLOCKHEAD_18 1
 #endif

 #if BLOCKHEAD_18

/*-----------------
 *    BITMAPS
 *----------------*/
/*Store the image of the glyphs*/
static LV_ATTRIBUTE_LARGE_CONST const uint8_t blockhead_18_glyph_bitmap[] = {
    /* U+0020 " " */
    /* U+002F "/" */
    0x0, 0x0, 0x3, 0xfe, 0x2, 0x7d, 0xd0, 0x91,
    0x78, 0x15, 0x45, 0x15, 0x0, 0x41, 0x10, 0x50,
    0x41, 0x10, 0x5, 0x50, 0x0,
    /* U+0030 "0" */
    0x0, 0x0, 0x3, 0xff, 0x2, 0xff, 0xf0, 0xc1,
    0x3c, 0x24, 0x17, 0x59, 0x44, 0x95, 0x10, 0x14,
    0x9f, 0x49, 0x2c, 0x3c, 0x3, 0xfd, 0x0, 0x4,
    0x0,
    /* U+0031 "1" */
    0x0, 0x3d, 0x1, 0xff, 0xc1, 0xff, 0xe0, 0xb4,
    0x3c, 0x24, 0x5b, 0x5, 0x95, 0x56, 0x51, 0x14,
    0x44, 0x4, 0x11, 0x4, 0x1, 0x54, 0x0, 0x0,
    0x0,
    /* U+0032 "2" */
    0x0, 0x0, 0x0, 0x15, 0x40, 0x0, 0x1, 0x1,
    0x0, 0x10, 0x15, 0x11, 0x5, 0x12, 0x18, 0x51,
    0x1, 0x42, 0x7f, 0x24, 0x15, 0x21, 0x0, 0x90,
    0x80, 0x1, 0x50, 0x0,
    /* U+0033 "3" */
    0x1, 0x90, 0x3, 0xff, 0x3, 0xff, 0xf0, 0x95,
    0x2d, 0x14, 0x17, 0x55, 0x44, 0xd5, 0x11, 0x14,
    0x44, 0x9, 0x11, 0x48, 0x2, 0x98, 0x0, 0x0,
    0x0,
    /* U+0034 "4" */
    0x0, 0x0, 0x0, 0x2e, 0x0, 0xf, 0xc0, 0x2f,
    0xf0, 0x1d, 0x3d, 0x9, 0xb, 0x85, 0x65, 0xe4,
    0xa5, 0x54, 0x11, 0x0, 0x4, 0x40, 0x0, 0x50,
    0x0,
    /* U+0035 "5" */
    0x1, 0xb4, 0x0, 0x1f, 0xfc, 0x0, 0xff, 0xfc,
    0x6, 0x41, 0xf4, 0x24, 0x2, 0xe1, 0xc9, 0x57,
    0xc7, 0x4, 0x1f, 0x1c, 0x4, 0xbc, 0x4, 0x3,
    0x80, 0x5, 0x50, 0x0,
    /* U+0036 "6" */
    0x2, 0xa4, 0x0, 0x40, 0x10, 0x10, 0x41, 0x1,
    0x52, 0x10, 0x55, 0x21, 0x85, 0x10, 0x0, 0x17,
    0xd0, 0x1, 0xaa, 0x0, 0x0, 0x0, 0x0, 0x0,
    0x0,
    /* U+0037 "7" */
    0x2, 0xfe, 0x0, 0x3f, 0xff, 0x0, 0xaa, 0xa9,
    0x5, 0xf3, 0x99, 0x40, 0x10, 0x54, 0x90, 0x51,
    0x80, 0x40, 0x4, 0x0, 0x55, 0x40,
    /* U+0038 "8" */
    0x0, 0x0, 0x2, 0xfe, 0x1, 0x55, 0x50, 0x80,
    0x8, 0x61, 0x12, 0x54, 0x0, 0x91, 0x14, 0x10,
    0x10, 0x10, 0x1, 0x50, 0x0,
    /* U+0039 "9" */
    0xb, 0xfe, 0x2, 0x94, 0x30, 0x30, 0x2, 0x42,
    0x14, 0x14, 0x50, 0x41, 0x46, 0x4, 0x14, 0x10,
    0x41, 0x0, 0x55, 0x40,
    /* U+003A ":" */
    0x0, 0x0, 0x0, 0x75, 0x40, 0x1f, 0x1, 0x2,
    0x80, 0x40, 0x13, 0x98, 0x85, 0xd, 0x8, 0x10,
    0x40, 0x40, 0x10, 0x20, 0x5, 0x58, 0x0,
    /* U+003B ";" */
    0x0, 0x50, 0xa, 0xff, 0x3, 0xff, 0xf0, 0x50,
    0x7c, 0x14, 0x17, 0x14, 0x40, 0x51, 0x10, 0x10,
    0x45, 0x10, 0x9, 0x50, 0x0, 0x0, 0x0,
    /* U+003C "<" */
    0x0, 0x0, 0x1, 0xf8, 0x3, 0xff, 0xd0, 0xa5,
    0x78, 0x24, 0x1b, 0x15, 0x45, 0x85, 0x10, 0x14,
    0x40, 0x4, 0x0, 0x0, 0x0, 0x54, 0x0,
    /* U+003D "=" */
    0x7, 0xf4, 0x1, 0xa6, 0x1, 0x0, 0xa0, 0x64,
    0x88, 0x51, 0x1, 0x54, 0x40, 0x1, 0x14, 0x0,
    0x10, 0x0, 0x0, 0x0, 0x0,
    /* U+003E ">" */
    0x2, 0xa4, 0x0, 0xff, 0xd0, 0x1e, 0xff, 0x2,
    0x1, 0x70, 0x70, 0x12, 0x87, 0x10, 0xc, 0xb0,
    0x3, 0xc7, 0x40, 0xb8, 0x5, 0x60, 0x0,
    /* U+003F "?" */
    0x7, 0xf4, 0x7, 0xff, 0x43, 0xff, 0xf0, 0x55,
    0x6d, 0x10, 0x13, 0x15, 0x48, 0x55, 0x10, 0x14,
    0x45, 0x4, 0x4, 0x14, 0x0, 0x50, 0x0,
    /* U+0040 "@" */
    0x1, 0x40, 0x3, 0xfd, 0x2, 0xb, 0xe0, 0x51,
    0x78, 0x54, 0x8, 0x45, 0x10, 0x11, 0x40, 0x90,
    0x44, 0x0, 0x9, 0x50, 0x0, 0x0, 0x0,
    /* U+0041 "A" */
    0x1, 0xba, 0x40, 0x7f, 0xff, 0x43, 0xff, 0xff,
    0x1f, 0x90, 0xac, 0x74, 0x1, 0x74, 0xd4, 0x0,
    0xc2, 0x44, 0x1, 0x45, 0x4, 0x8, 0x4, 0x14,
    0x40, 0x15, 0x55, 0x0,
    /* U+0042 "B" */
    0x0, 0x0, 0x0, 0x55, 0x50, 0x10, 0x0, 0x41,
    0x0, 0x4, 0x16, 0x95, 0x2, 0x10, 0x44, 0x52,
    0x44, 0x42, 0x4, 0x8, 0x10, 0x51, 0x0, 0x0,
    0x10, 0x5, 0x54, 0x0,
    /* U+0043 "C" */
    0x7, 0xf8, 0x7, 0xff, 0x43, 0x6f, 0xd0, 0xf9,
    0xe4, 0x2a, 0x64, 0x15, 0x6, 0x81, 0x10, 0x50,
    0x40, 0x10, 0x10, 0x44, 0x1, 0x54, 0x0,
    /* U+0044 "D" */
    0x1, 0xb8, 0x0, 0xbf, 0xf4, 0x1f, 0xff, 0xc3,
    0xf7, 0xfc, 0x35, 0x16, 0xc7, 0x1, 0x19, 0xb1,
    0x0, 0x5b, 0x10, 0x8, 0xb0, 0x43, 0xc7, 0x80,
    0xb8, 0x1, 0x50, 0x0,
    /* U+0045 "E" */
    0x0, 0x0, 0x0, 0x6a, 0x90, 0x10, 0x0, 0x1,
    0x44, 0x44, 0x15, 0x55, 0x41, 0x50, 0x41, 0x14,
    0x1, 0x54, 0x14, 0x55, 0x4, 0x41, 0x1, 0x85,
    0x24, 0x6, 0xa9, 0x0, 0x0, 0x0,
    /* U+0046 "F" */
    0x0, 0x50, 0x1, 0xff, 0x1, 0xff, 0xf0, 0xff,
    0xfd, 0x30, 0x3, 0x4d, 0x45, 0x95, 0x10, 0x25,
    0x45, 0x9, 0x10, 0x41, 0x0, 0x0, 0x40, 0x55,
    0x40,
    /* U+0047 "G" */
    0x2, 0xf4, 0x2, 0xff, 0x43, 0xef, 0xf0, 0xd2,
    0xfd, 0x31, 0x27, 0xd, 0x64, 0xc6, 0xb5, 0x65,
    0x81, 0x5, 0x10, 0x1, 0x1, 0x1, 0x0, 0x15,
    0x40, 0x0, 0x0,
    /* U+0048 "H" */
    0x1, 0xb8, 0x0, 0xff, 0xf8, 0x2f, 0xff, 0xc3,
    0xff, 0xfd, 0x7d, 0x2, 0xe7, 0x94, 0x9e, 0x64,
    0x41, 0x63, 0x40, 0x1d, 0x18, 0x51, 0x40, 0x0,
    0x0, 0x0, 0x0, 0x0,
    /* U+0049 "I" */
    0x1, 0xa4, 0x0, 0xbf, 0xf0, 0x2f, 0xff, 0x83,
    0xef, 0xfc, 0x35, 0x17, 0xc6, 0x41, 0x3d, 0xa1,
    0x3, 0xdb, 0x0, 0x3d, 0xb0, 0x43, 0xc7, 0xd1,
    0xbc, 0x0, 0x0, 0x0,
    /* U+004A "J" */
    0x0, 0x0, 0x0, 0xbf, 0x80, 0x1f, 0xff, 0x3,
    0xaa, 0xb4, 0x31, 0x6, 0x82, 0x10, 0x28, 0x51,
    0x1, 0x45, 0x14, 0x14, 0x11, 0x51, 0x1, 0x0,
    0x10, 0x5, 0x54, 0x0,
    /* U+004B "K" */
    0x1, 0xa4, 0x2, 0xff, 0x82, 0xef, 0xf0, 0xe0,
    0xfd, 0x39, 0x27, 0x19, 0x65, 0xd6, 0x61, 0x64,
    0x44, 0x8, 0x10, 0x1, 0x0, 0x1, 0x0, 0x55,
    0x0, 0x0, 0x0,
    /* U+004C "L" */
    0x7, 0xf8, 0x1, 0xff, 0xe0, 0x3f, 0xfb, 0x83,
    0xa4, 0x3c, 0x25, 0x12, 0x85, 0x61, 0x14, 0x51,
    0x1, 0x41, 0x10, 0x10, 0x0, 0x0, 0x0, 0x0,
    0x0, 0x0, 0x0, 0x0,
    /* U+004D "M" */
    0x6, 0xa4, 0x0, 0xff, 0xf0, 0x14, 0x1, 0x41,
    0x0, 0x4, 0x61, 0x8, 0x96, 0x14, 0x49, 0x60,
    0x0, 0xc1, 0xe, 0x4, 0x10, 0x40, 0x0, 0x55,
    0x50,
    /* U+004E "N" */
    0x0, 0x0, 0x1, 0xbf, 0xc1, 0xff, 0xe0, 0x90,
    0x2c, 0x25, 0x17, 0x18, 0x64, 0xd6, 0x56, 0x64,
    0x81, 0x8, 0x10, 0x51, 0x4, 0x0, 0x40, 0x55,
    0x40,
    /* U+004F "O" */
    0x0, 0x10, 0x0, 0xa6, 0x56, 0x45, 0x55, 0x69,
    0x16, 0x2a, 0xa4, 0x24, 0x1, 0xc0, 0x84, 0x2,
    0x45, 0x10, 0x42, 0x8, 0x10, 0x18, 0x14, 0xa5,
    0x40, 0x91, 0x46, 0x0, 0x6a, 0x90, 0x0,
    /* U+0050 "P" */
    0x0, 0x50, 0x0, 0x3f, 0xc0, 0x1f, 0xfe, 0x3,
    0xff, 0xf4, 0x7f, 0xc7, 0x87, 0xa0, 0x64, 0x30,
    0x1, 0x46, 0x15, 0x14, 0x60, 0x41, 0x41, 0x1,
    0x10, 0x4, 0x0, 0x0, 0x15, 0x0,
    /* U+0051 "Q" */
    0x7, 0xf4, 0x3, 0xff, 0xd0, 0x3f, 0xff, 0x1,
    0x0, 0x70, 0x19, 0x67, 0x5, 0x51, 0x14, 0x52,
    0x0, 0x41, 0x10, 0x10, 0x10, 0x4, 0x0, 0x55,
    0x0,
    /* U+0052 "R" */
    0x0, 0x0, 0x3, 0xfc, 0x1, 0xff, 0xe0, 0xaa,
    0xbc, 0x24, 0x17, 0x19, 0x8, 0x85, 0x10, 0x14,
    0x44, 0x8, 0x11, 0x44, 0x6, 0x4a, 0x0, 0x29,
    0x0,
    /* U+0053 "S" */
    0x2, 0xa4, 0x2, 0x1, 0x1, 0x0, 0x10, 0x54,
    0x54, 0x51, 0x11, 0x54, 0x40, 0x55, 0x3e, 0x24,
    0x4a, 0x84, 0x4, 0x4, 0x0, 0x54, 0x0,
    /* U+0054 "T" */
    0x0, 0x0, 0x0, 0x7f, 0x80, 0x1f, 0xff, 0x3,
    0xef, 0xf0, 0x34, 0x2b, 0x46, 0x1, 0x24, 0x51,
    0x0, 0x41, 0x0, 0x14, 0x11, 0x47, 0x80, 0x41,
    0xb4, 0x0, 0x40, 0x0,
    /* U+0055 "U" */
    0x0, 0x0, 0x0, 0x2a, 0x80, 0x8, 0x2, 0x1,
    0x4, 0x28, 0x14, 0x13, 0x85, 0x52, 0x28, 0x51,
    0x0, 0x11, 0x14, 0x4, 0x15, 0x51, 0x1, 0x0,
    0x0, 0x4, 0x50, 0x0, 0x0, 0x0,
    /* U+0056 "V" */
    0x7, 0xe4, 0x3, 0xff, 0x2, 0xa9, 0xe0, 0x90,
    0x58, 0x20, 0x22, 0x15, 0x80, 0x95, 0x14, 0x14,
    0x4f, 0x4, 0x10, 0x44, 0x1, 0x4, 0x0, 0x0,
    0x0,
    /* U+0057 "W" */
    0x0, 0x0, 0x0, 0xb, 0xfc, 0x0, 0xff, 0xfc,
    0x3, 0xbb, 0xf4, 0x19, 0xf, 0xd0, 0x50, 0x17,
    0x83, 0x60, 0x4f, 0x1d, 0x10, 0x1d, 0xb4, 0x40,
    0xf5, 0xf0, 0xb, 0xc0, 0xe1, 0xbc, 0x0, 0x0,
    0x0,
    /* U+0058 "X" */
    0x2, 0x94, 0x1, 0xff, 0xd0, 0x3e, 0xbf, 0x3,
    0x0, 0x78, 0x65, 0x23, 0x45, 0x52, 0x24, 0x52,
    0x42, 0x81, 0x6e, 0x20, 0x10, 0x4, 0x0, 0x55,
    0x0, 0x0, 0x0, 0x0,
    /* U+0059 "Y" */
    0x0, 0x0, 0x0, 0x0, 0xbe, 0x40, 0x3, 0xff,
    0xc0, 0xb, 0x95, 0xf0, 0x2e, 0x41, 0x7c, 0xbd,
    0x82, 0x3e, 0x78, 0x10, 0x1d, 0x18, 0x4, 0x14,
    0x4, 0x0, 0x10, 0x1, 0x55, 0x40,
    /* U+005A "Z" */
    0x1, 0x40, 0x7, 0xfd, 0x3, 0xeb, 0xd1, 0xc0,
    0x38, 0x50, 0x6, 0x14, 0x0, 0x85, 0x10, 0x20,
    0x44, 0x14, 0x11, 0x44, 0x1, 0x0, 0x0, 0x55,
    0x0,
    /* U+0061 "a" */
    0x0, 0x0, 0x0, 0x55, 0x1, 0x0, 0x10, 0x94,
    0x58, 0x65, 0x96, 0x15, 0x41, 0x50, 0x14, 0x10,
    0x0, 0x44, 0x10, 0x1, 0x5, 0x55, 0x40,
    /* U+0062 "b" */
    0x0, 0x0, 0x0, 0x7, 0xa8, 0x0, 0x91, 0x5c,
    0x5, 0x55, 0xa4, 0x20, 0x19, 0x20, 0x80, 0x0,
    0x86, 0x20, 0x56, 0x14, 0x10, 0x18, 0x24, 0x0,
    0x40, 0x20, 0x40, 0x0, 0x15, 0x40, 0x0,
    /* U+0063 "c" */
    0x6, 0xe4, 0xb, 0xff, 0x83, 0xe6, 0xf1, 0xe0,
    0x2d, 0x20, 0x13, 0x55, 0x48, 0x95, 0x14, 0x4,
    0x40, 0x4, 0x11, 0x44, 0x1, 0x54, 0x0,
    /* U+0064 "d" */
    0x0, 0x1, 0x1f, 0x3, 0xd7, 0xff, 0xf0, 0xbf,
    0xf8, 0x39, 0x2f, 0xa, 0x5, 0xc5, 0x1, 0x15,
    0x41, 0x4, 0x12, 0x84, 0x1, 0x54, 0x0, 0x0,
    0x0,
    /* U+0065 "e" */
    0x5, 0x54, 0x1, 0x54, 0x41, 0x0, 0x10, 0x54,
    0x44, 0x55, 0x11, 0x54, 0x40, 0x51, 0x0, 0x20,
    0x45, 0x0, 0x4, 0x14, 0x0, 0x0, 0x0,
    /* U+0066 "f" */
    0x0, 0x64, 0x0, 0xbf, 0xe0, 0x1f, 0xff, 0x42,
    0x96, 0xf8, 0x31, 0x2, 0xc7, 0x11, 0x2c, 0xb1,
    0x42, 0xeb, 0x4, 0x3e, 0x18, 0x7, 0x40, 0x2a,
    0x0,
    /* U+0067 "g" */
    0x1, 0x40, 0x0, 0xfe, 0x90, 0x3f, 0xff, 0x7,
    0xfe, 0xfc, 0x25, 0x7, 0xc1, 0x41, 0x78, 0x55,
    0x21, 0x45, 0x10, 0x4, 0x11, 0x41, 0x1, 0x10,
    0x40, 0x5, 0x50, 0x0,
    /* U+0068 "h" */
    0x6, 0xa4, 0x0, 0x40, 0x50, 0x10, 0x1, 0x2,
    0xa9, 0x60, 0x59, 0x56, 0x46, 0x56, 0x54, 0x1b,
    0xd1, 0x1, 0x55, 0x10, 0x10, 0x4, 0x0, 0x15,
    0x0,
    /* U+0069 "i" */
    0x7, 0xf4, 0x7, 0xff, 0x83, 0xff, 0xf0, 0xc0,
    0x5c, 0x24, 0x3, 0x14, 0x48, 0x55, 0x10, 0x4,
    0x40, 0x4, 0x21, 0x44, 0x3, 0xaa, 0x0, 0x14,
    0x0,
    /* U+006A "j" */
    0x1, 0xf8, 0x0, 0xbf, 0xf0, 0x1f, 0xff, 0x82,
    0xfa, 0xfc, 0x31, 0x13, 0xc3, 0x51, 0x29, 0x71,
    0x0, 0x6b, 0x0, 0x1e, 0x74, 0x7, 0xe0, 0x55,
    0x64,
    /* U+006B "k" */
    0x0, 0x0, 0x0, 0x1f, 0xfd, 0x3, 0xff, 0xfe,
    0x2f, 0xff, 0xfc, 0x7f, 0xfe, 0xf0, 0x58, 0x13,
    0x45, 0x10, 0x85, 0x14, 0x44, 0x14, 0x10, 0x44,
    0xa0, 0x3, 0x81, 0x0, 0x5a, 0x50, 0x0,
    /* U+006C "l" */
    0x2, 0xf4, 0x3, 0xff, 0x82, 0xff, 0xf0, 0xff,
    0xfd, 0x39, 0xa7, 0x49, 0x41, 0x86, 0xb8, 0x24,
    0x6e, 0x44, 0x10, 0x1, 0x1, 0x55, 0x0,
    /* U+006D "m" */
    0x2, 0x80, 0x2, 0xff, 0x0, 0xff, 0xc0, 0x2a,
    0x60, 0x20, 0x4, 0x14, 0x44, 0x81, 0x0, 0x20,
    0x44, 0x84, 0x11, 0x54, 0x1, 0x68, 0x0,
    /* U+006E "n" */
    0x0, 0x0, 0x0, 0x3f, 0xc0, 0xb, 0xff, 0x0,
    0xfa, 0xb4, 0x34, 0x5, 0xc7, 0x10, 0x4e, 0x70,
    0x40, 0xd2, 0x0, 0x8, 0x5, 0x55, 0x0,
    /* U+006F "o" */
    0x0, 0x0, 0x0, 0x7f, 0x90, 0x2f, 0xff, 0x43,
    0xbf, 0xf4, 0x10, 0x13, 0x41, 0x1, 0x34, 0x51,
    0x11, 0x41, 0x14, 0x0, 0x11, 0xc0, 0x0, 0x41,
    0x0, 0x0, 0x0, 0x0,
    /* U+0070 "p" */
    0x0, 0x0, 0x3, 0xfe, 0x3, 0xff, 0xf0, 0xd0,
    0x7c, 0x24, 0x17, 0x14, 0x5, 0x95, 0x50, 0x14,
    0x44, 0x48, 0x11, 0x47, 0x1, 0x54, 0x90, 0x0,
    0x0,
    /* U+0071 "q" */
    0x0, 0x0, 0x1, 0xfd, 0x1, 0xae, 0xc0, 0x80,
    0x8, 0x25, 0x12, 0x19, 0x8, 0x85, 0x10, 0x14,
    0x40, 0x8, 0x11, 0x44, 0x2, 0x59, 0x0, 0x14,
    0x0,
    /* U+0072 "r" */
    0x2, 0xf8, 0x0, 0xff, 0xf0, 0x1f, 0xff, 0x42,
    0x96, 0xb8, 0x35, 0x17, 0xc7, 0x11, 0x2e, 0xb0,
    0x3, 0xf7, 0x4, 0x3d, 0x0, 0x5, 0x0, 0x0,
    0x0,
    /* U+0073 "s" */
    0x0, 0x0, 0x3, 0xea, 0x3, 0xff, 0xe0, 0xf1,
    0xfc, 0x19, 0x13, 0x45, 0x5, 0xd5, 0x52, 0x25,
    0x44, 0x1, 0x11, 0x11, 0x4, 0x1, 0x0, 0x55,
    0x0, 0x0, 0x0,
    /* U+0074 "t" */
    0x2, 0xf4, 0x0, 0xaa, 0x90, 0x10, 0x3, 0x1,
    0x42, 0x30, 0x55, 0x22, 0x45, 0x10, 0x24, 0x17,
    0x82, 0x43, 0xeb, 0xe0, 0x1f, 0xfc, 0x0, 0xbf,
    0x0,
    /* U+0075 "u" */
    0x7, 0xf8, 0x7, 0xff, 0x83, 0x9f, 0xf0, 0x90,
    0x5d, 0x50, 0x13, 0x55, 0x40, 0x51, 0x10, 0x4,
    0x45, 0x10, 0x4, 0x14, 0x0, 0x50, 0x0,
    /* U+0076 "v" */
    0x0, 0x0, 0x0, 0x3f, 0xd0, 0xe, 0x7f, 0x1,
    0x91, 0xf8, 0x34, 0x7, 0xc7, 0x6a, 0xbe, 0xb6,
    0x14, 0x6b, 0x0, 0xe, 0x74, 0x43, 0xe0, 0x55,
    0xb4,
    /* U+0077 "w" */
    0x2, 0xfd, 0x0, 0xff, 0xf0, 0x1f, 0xff, 0xc3,
    0xff, 0xad, 0x3d, 0x65, 0xd6, 0x10, 0xd, 0x50,
    0x8, 0x95, 0x4, 0x5, 0x14, 0x51, 0x40, 0x15,
    0x40,
    /* U+0078 "x" */
    0x7, 0xd0, 0x3, 0xfc, 0x0, 0xff, 0x80, 0x7f,
    0xf4, 0x2e, 0xbd, 0x4, 0x5, 0x85, 0x15, 0x20,
    0x81, 0x14, 0x4, 0x48, 0x1, 0xa8, 0x0, 0x0,
    0x0,
    /* U+0079 "y" */
    0x5, 0x54, 0x1, 0x15, 0x10, 0x10, 0x0, 0x6,
    0x15, 0x4, 0x50, 0x40, 0x51, 0x4, 0x8, 0x10,
    0x1, 0x0, 0x55, 0x50, 0x0, 0x0, 0x0,
    /* U+007A "z" */
    0x0, 0x0, 0x0, 0x7f, 0xc0, 0x1f, 0xff, 0x3,
    0xff, 0xf4, 0x3a, 0x57, 0x81, 0x10, 0x10, 0x52,
    0x11, 0x47, 0x0, 0x28, 0x74, 0x43, 0xc1, 0x55,
    0x50
};
/*---------------------
 *  GLYPH DESCRIPTION
 *--------------------*/
static const lv_font_fmt_txt_glyph_dsc_t blockhead_18_glyph_dsc[] = {
    {.bitmap_index = 0, .adv_w = 0, .box_w = 0, .box_h = 0, .ofs_x = 0, .ofs_y = 0} /* id = 0 reserved */,
    {.bitmap_index = 0, .adv_w = 52, .box_w = 0, .box_h = 0, .ofs_x = 0, .ofs_y = 0},
    {.bitmap_index = 0, .adv_w = 136, .box_w = 9, .box_h = 9, .ofs_x = 0, .ofs_y = 1},
    {.bitmap_index = 21, .adv_w = 147, .box_w = 9, .box_h = 11, .ofs_x = 0, .ofs_y = 0},
    {.bitmap_index = 46, .adv_w = 146, .box_w = 9, .box_h = 11, .ofs_x = 0, .ofs_y = 0},
    {.bitmap_index = 71, .adv_w = 152, .box_w = 10, .box_h = 11, .ofs_x = 0, .ofs_y = 0},
    {.bitmap_index = 99, .adv_w = 146, .box_w = 9, .box_h = 11, .ofs_x = 0, .ofs_y = 1},
    {.bitmap_index = 124, .adv_w = 140, .box_w = 9, .box_h = 11, .ofs_x = 0, .ofs_y = 1},
    {.bitmap_index = 149, .adv_w = 167, .box_w = 11, .box_h = 10, .ofs_x = 0, .ofs_y = 1},
    {.bitmap_index = 177, .adv_w = 153, .box_w = 10, .box_h = 10, .ofs_x = 0, .ofs_y = 1},
    {.bitmap_index = 202, .adv_w = 177, .box_w = 11, .box_h = 8, .ofs_x = 0, .ofs_y = 1},
    {.bitmap_index = 224, .adv_w = 144, .box_w = 9, .box_h = 9, .ofs_x = 0, .ofs_y = 1},
    {.bitmap_index = 245, .adv_w = 152, .box_w = 10, .box_h = 8, .ofs_x = 0, .ofs_y = 1},
    {.bitmap_index = 265, .adv_w = 154, .box_w = 10, .box_h = 9, .ofs_x = 0, .ofs_y = 1},
    {.bitmap_index = 288, .adv_w = 141, .box_w = 9, .box_h = 10, .ofs_x = 0, .ofs_y = 0},
    {.bitmap_index = 311, .adv_w = 140, .box_w = 9, .box_h = 10, .ofs_x = 0, .ofs_y = 1},
    {.bitmap_index = 334, .adv_w = 141, .box_w = 9, .box_h = 9, .ofs_x = 0, .ofs_y = 0},
    {.bitmap_index = 355, .adv_w = 152, .box_w = 10, .box_h = 9, .ofs_x = 0, .ofs_y = 1},
    {.bitmap_index = 378, .adv_w = 146, .box_w = 9, .box_h = 10, .ofs_x = 0, .ofs_y = 1},
    {.bitmap_index = 401, .adv_w = 143, .box_w = 9, .box_h = 10, .ofs_x = 0, .ofs_y = 1},
    {.bitmap_index = 424, .adv_w = 173, .box_w = 11, .box_h = 10, .ofs_x = 0, .ofs_y = 1},
    {.bitmap_index = 452, .adv_w = 158, .box_w = 10, .box_h = 11, .ofs_x = 0, .ofs_y = 1},
    {.bitmap_index = 480, .adv_w = 134, .box_w = 9, .box_h = 10, .ofs_x = 0, .ofs_y = 1},
    {.bitmap_index = 503, .adv_w = 156, .box_w = 10, .box_h = 11, .ofs_x = 0, .ofs_y = 0},
    {.bitmap_index = 531, .adv_w = 159, .box_w = 10, .box_h = 12, .ofs_x = 0, .ofs_y = 0},
    {.bitmap_index = 561, .adv_w = 147, .box_w = 9, .box_h = 11, .ofs_x = 0, .ofs_y = 1},
    {.bitmap_index = 586, .adv_w = 145, .box_w = 9, .box_h = 12, .ofs_x = 0, .ofs_y = -1},
    {.bitmap_index = 613, .adv_w = 165, .box_w = 10, .box_h = 11, .ofs_x = 0, .ofs_y = 0},
    {.bitmap_index = 641, .adv_w = 154, .box_w = 10, .box_h = 11, .ofs_x = 0, .ofs_y = 0},
    {.bitmap_index = 669, .adv_w = 154, .box_w = 10, .box_h = 11, .ofs_x = 0, .ofs_y = 1},
    {.bitmap_index = 697, .adv_w = 144, .box_w = 9, .box_h = 12, .ofs_x = 0, .ofs_y = 0},
    {.bitmap_index = 724, .adv_w = 152, .box_w = 10, .box_h = 11, .ofs_x = 0, .ofs_y = 0},
    {.bitmap_index = 752, .adv_w = 159, .box_w = 10, .box_h = 10, .ofs_x = 0, .ofs_y = 1},
    {.bitmap_index = 777, .adv_w = 141, .box_w = 9, .box_h = 11, .ofs_x = 0, .ofs_y = 1},
    {.bitmap_index = 802, .adv_w = 167, .box_w = 11, .box_h = 11, .ofs_x = 0, .ofs_y = 1},
    {.bitmap_index = 833, .adv_w = 154, .box_w = 10, .box_h = 12, .ofs_x = 0, .ofs_y = 1},
    {.bitmap_index = 863, .adv_w = 149, .box_w = 10, .box_h = 10, .ofs_x = 0, .ofs_y = 1},
    {.bitmap_index = 888, .adv_w = 144, .box_w = 9, .box_h = 11, .ofs_x = 0, .ofs_y = 1},
    {.bitmap_index = 913, .adv_w = 146, .box_w = 9, .box_h = 10, .ofs_x = 0, .ofs_y = 1},
    {.bitmap_index = 936, .adv_w = 149, .box_w = 10, .box_h = 11, .ofs_x = 0, .ofs_y = 0},
    {.bitmap_index = 964, .adv_w = 154, .box_w = 10, .box_h = 12, .ofs_x = 0, .ofs_y = 0},
    {.bitmap_index = 994, .adv_w = 142, .box_w = 9, .box_h = 11, .ofs_x = 0, .ofs_y = 0},
    {.bitmap_index = 1019, .adv_w = 174, .box_w = 11, .box_h = 12, .ofs_x = 0, .ofs_y = 0},
    {.bitmap_index = 1052, .adv_w = 152, .box_w = 10, .box_h = 11, .ofs_x = 0, .ofs_y = 0},
    {.bitmap_index = 1080, .adv_w = 193, .box_w = 12, .box_h = 10, .ofs_x = 0, .ofs_y = 1},
    {.bitmap_index = 1110, .adv_w = 134, .box_w = 9, .box_h = 11, .ofs_x = 0, .ofs_y = 1},
    {.bitmap_index = 1135, .adv_w = 148, .box_w = 9, .box_h = 10, .ofs_x = 0, .ofs_y = 1},
    {.bitmap_index = 1158, .adv_w = 169, .box_w = 11, .box_h = 11, .ofs_x = 0, .ofs_y = 1},
    {.bitmap_index = 1189, .adv_w = 149, .box_w = 9, .box_h = 10, .ofs_x = 0, .ofs_y = 1},
    {.bitmap_index = 1212, .adv_w = 140, .box_w = 9, .box_h = 11, .ofs_x = 0, .ofs_y = 0},
    {.bitmap_index = 1237, .adv_w = 146, .box_w = 9, .box_h = 10, .ofs_x = 0, .ofs_y = 1},
    {.bitmap_index = 1260, .adv_w = 158, .box_w = 10, .box_h = 10, .ofs_x = 0, .ofs_y = 1},
    {.bitmap_index = 1285, .adv_w = 152, .box_w = 10, .box_h = 11, .ofs_x = 0, .ofs_y = 1},
    {.bitmap_index = 1313, .adv_w = 148, .box_w = 10, .box_h = 10, .ofs_x = 0, .ofs_y = 1},
    {.bitmap_index = 1338, .adv_w = 147, .box_w = 9, .box_h = 11, .ofs_x = 0, .ofs_y = 0},
    {.bitmap_index = 1363, .adv_w = 160, .box_w = 10, .box_h = 10, .ofs_x = 0, .ofs_y = 1},
    {.bitmap_index = 1388, .adv_w = 170, .box_w = 11, .box_h = 11, .ofs_x = 0, .ofs_y = 1},
    {.bitmap_index = 1419, .adv_w = 144, .box_w = 9, .box_h = 10, .ofs_x = 0, .ofs_y = 1},
    {.bitmap_index = 1442, .adv_w = 136, .box_w = 9, .box_h = 10, .ofs_x = 0, .ofs_y = 1},
    {.bitmap_index = 1465, .adv_w = 161, .box_w = 10, .box_h = 9, .ofs_x = 0, .ofs_y = 1},
    {.bitmap_index = 1488, .adv_w = 150, .box_w = 10, .box_h = 11, .ofs_x = 0, .ofs_y = 1},
    {.bitmap_index = 1516, .adv_w = 142, .box_w = 9, .box_h = 11, .ofs_x = 0, .ofs_y = 1},
    {.bitmap_index = 1541, .adv_w = 143, .box_w = 9, .box_h = 11, .ofs_x = 0, .ofs_y = 1},
    {.bitmap_index = 1566, .adv_w = 161, .box_w = 10, .box_h = 10, .ofs_x = 0, .ofs_y = 1},
    {.bitmap_index = 1591, .adv_w = 146, .box_w = 9, .box_h = 12, .ofs_x = 0, .ofs_y = 0},
    {.bitmap_index = 1618, .adv_w = 150, .box_w = 10, .box_h = 10, .ofs_x = 0, .ofs_y = 1},
    {.bitmap_index = 1643, .adv_w = 145, .box_w = 9, .box_h = 10, .ofs_x = 0, .ofs_y = 1},
    {.bitmap_index = 1666, .adv_w = 166, .box_w = 10, .box_h = 10, .ofs_x = 0, .ofs_y = 1},
    {.bitmap_index = 1691, .adv_w = 164, .box_w = 10, .box_h = 10, .ofs_x = 0, .ofs_y = 1},
    {.bitmap_index = 1716, .adv_w = 135, .box_w = 9, .box_h = 11, .ofs_x = 0, .ofs_y = 0},
    {.bitmap_index = 1741, .adv_w = 156, .box_w = 10, .box_h = 9, .ofs_x = 0, .ofs_y = 1},
    {.bitmap_index = 1764, .adv_w = 152, .box_w = 10, .box_h = 10, .ofs_x = 0, .ofs_y = 1}
};
/*---------------------
 *  CHARACTER MAPPING
 *--------------------*/
/*Collect the unicode lists and glyph_id offsets*/
static const lv_font_fmt_txt_cmap_t blockhead_18_cmaps[] =
{
    {
        .range_start = 32, .range_length = 1, .glyph_id_start = 1,
        .unicode_list = NULL, .glyph_id_ofs_list = NULL, .list_length = 0, .type = LV_FONT_FMT_TXT_CMAP_FORMAT0_TINY
    },
    {
        .range_start = 47, .range_length = 44, .glyph_id_start = 2,
        .unicode_list = NULL, .glyph_id_ofs_list = NULL, .list_length = 0, .type = LV_FONT_FMT_TXT_CMAP_FORMAT0_TINY
    },
    {
        .range_start = 97, .range_length = 26, .glyph_id_start = 46,
        .unicode_list = NULL, .glyph_id_ofs_list = NULL, .list_length = 0, .type = LV_FONT_FMT_TXT_CMAP_FORMAT0_TINY
    }
};
/*--------------------
 *  ALL CUSTOM DATA
 *--------------------*/
/*Store all the custom data of the font*/
static lv_font_fmt_txt_glyph_cache_t blockhead_18_cache;
static const lv_font_fmt_txt_dsc_t blockhead_18_font_dsc = {
    .glyph_bitmap = blockhead_18_glyph_bitmap,
    .glyph_dsc = blockhead_18_glyph_dsc,
    .cmaps = blockhead_18_cmaps,
    .kern_dsc = NULL,
    .kern_scale = 0,
    .cmap_num = 3,
    .bpp = 2,
    .kern_classes = 0,
    .bitmap_format = 0,
    .cache = &blockhead_18_cache
};
/*-----------------
 *  PUBLIC FONT
 *----------------*/
/*Initialize a public general font descriptor*/
const lv_font_t blockhead_18 = {
    .get_glyph_dsc = lv_font_get_glyph_dsc_fmt_txt,    /*Function pointer to get glyph's data*/
    .get_glyph_bitmap = lv_font_get_bitmap_fmt_txt,    /*Function pointer to get glyph's bitmap*/
    .line_height = 14,          /*The maximum line height required by the font*/
    .base_line = 1,             /*Baseline measured from the bottom of the line*/

    .subpx = LV_FONT_SUBPX_NONE,
    .underline_position = -1,
    .underline_thickness = 1,
    .dsc = &blockhead_18_font_dsc,          /*The custom font data. Will be accessed by `get_glyph_bitmap/dsc` */
};
#endif

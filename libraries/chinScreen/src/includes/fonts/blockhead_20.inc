/*******************************************************************************
 * Size: 20 px
 * Bpp: 2
 ******************************************************************************/


#ifdef __has_include

    #if __has_include("lvgl.h")
         #ifndef LV_LVGL_H_INCLUDE_SIMPLE
             #define LV_LVGL_H_INCLUDE_SIMPLE
         #endif
     #endif
 #endif

 #ifdef LV_LVGL_H_INCLUDE_SIMPLE
     #include "lvgl.h"
 #else
     #include "../lvgl-8.3.11/lvgl.h"
 #endif

 #ifndef BLOCKHEAD_20
 #define BLOCKHEAD_20 1
 #endif

 #if BLOCKHEAD_20

/*-----------------
 *    BITMAPS
 *----------------*/
/*Store the image of the glyphs*/
static LV_ATTRIBUTE_LARGE_CONST const uint8_t blockhead_20_glyph_bitmap[] = {
    /* U+0020 " " */
    /* U+002F "/" */
    0x2, 0xf8, 0x0, 0xff, 0xf0, 0x29, 0x57, 0x82,
    0x51, 0x7c, 0x15, 0x21, 0x45, 0x10, 0x1, 0x22,
    0x0, 0x51, 0x14, 0x14, 0x10, 0x1, 0x0, 0x55,
    0x40,
    /* U+0030 "0" */
    0x2, 0xae, 0x0, 0x3f, 0xfe, 0x2, 0xef, 0xfd,
    0xd, 0x0, 0xb8, 0x26, 0x4, 0xf1, 0x85, 0x13,
    0x86, 0x14, 0x41, 0x58, 0x50, 0x4, 0x23, 0xf8,
    0x80, 0x75, 0x3d, 0x0, 0xba, 0xd0, 0x0, 0x14,
    0x0,
    /* U+0031 "1" */
    0x0, 0xf, 0x40, 0x6, 0xff, 0x0, 0xbf, 0xfc,
    0x7, 0xf6, 0xf0, 0x29, 0x3, 0xd0, 0xa8, 0x6b,
    0x42, 0x59, 0x69, 0x9, 0x85, 0x4, 0x30, 0x40,
    0x60, 0x41, 0x5, 0x0, 0x80, 0x60, 0x0, 0xa9,
    0x0, 0x0, 0x0, 0x0,
    /* U+0032 "2" */
    0x0, 0x54, 0x0, 0x14, 0x5, 0x0, 0x40, 0x4,
    0x4, 0x0, 0x4, 0x11, 0x5, 0x11, 0x89, 0x20,
    0x95, 0x4, 0x2, 0x48, 0x7d, 0x9, 0x13, 0xac,
    0x40, 0x10, 0x2, 0x0, 0x50, 0x60, 0x0, 0x14,
    0x0,
    /* U+0033 "3" */
    0x0, 0x64, 0x0, 0x1f, 0xfc, 0x1, 0xff, 0xfd,
    0xf, 0xfe, 0xbc, 0x15, 0x1d, 0xf0, 0x80, 0x13,
    0xc5, 0x24, 0x49, 0x18, 0x40, 0x4, 0x10, 0x40,
    0x50, 0x11, 0x44, 0x0, 0x50, 0x50, 0x0, 0x14,
    0x0,
    /* U+0034 "4" */
    0x0, 0x0, 0x0, 0x2, 0xe0, 0x0, 0x3f, 0x40,
    0x1b, 0xf0, 0xf, 0xff, 0x41, 0x90, 0xfc, 0x25,
    0x1b, 0xc6, 0x58, 0x2e, 0x5a, 0x59, 0x52, 0x21,
    0x40, 0x10, 0x1, 0x0, 0x44, 0x10, 0x5, 0x54,
    0x0,
    /* U+0035 "5" */
    0x0, 0xae, 0x40, 0x0, 0xff, 0xf4, 0x0, 0xff,
    0xff, 0x80, 0x34, 0x7, 0xf0, 0x19, 0x42, 0xbd,
    0xe, 0x40, 0x4f, 0x47, 0x44, 0x13, 0xe0, 0xd1,
    0x40, 0xf8, 0x38, 0x44, 0x7e, 0x2, 0x40, 0x3e,
    0x0, 0x15, 0x50, 0x0,
    /* U+0036 "6" */
    0x1, 0x55, 0x0, 0x10, 0x1, 0x0, 0x41, 0x0,
    0x5, 0x87, 0x44, 0x20, 0x0, 0x11, 0x49, 0x20,
    0x55, 0x10, 0x0, 0x48, 0xac, 0x1, 0x17, 0xfc,
    0x90, 0x41, 0x1, 0x0, 0x90, 0x60, 0x0, 0x69,
    0x0,
    /* U+0037 "7" */
    0x1, 0xbf, 0x90, 0x1, 0xff, 0xfd, 0x0, 0xd5,
    0x55, 0xc0, 0x3b, 0xef, 0xb0, 0x59, 0xf3, 0xca,
    0x12, 0x15, 0x2, 0x12, 0x80, 0x0, 0xa0, 0x20,
    0x44, 0x20, 0x4, 0x0, 0x14, 0x0, 0x55, 0x54,
    0x0,
    /* U+0038 "8" */
    0x1, 0x64, 0x0, 0x3f, 0xfe, 0x0, 0x80, 0xc,
    0x5, 0x40, 0x20, 0x6, 0x8, 0x91, 0x11, 0x2,
    0x46, 0x44, 0x9, 0x1, 0x14, 0x10, 0x4, 0x1,
    0x0, 0x5, 0x54, 0x0,
    /* U+0039 "9" */
    0x7, 0xff, 0x80, 0x3f, 0x97, 0x82, 0x80, 0xb,
    0x8, 0x40, 0x48, 0x21, 0x11, 0x31, 0x41, 0x0,
    0x95, 0x1, 0x1, 0x45, 0x5, 0x8, 0x4, 0x0,
    0x40, 0x5, 0x59, 0x0,
    /* U+003A ":" */
    0x0, 0x0, 0x0, 0x2, 0x50, 0x0, 0x7c, 0x18,
    0x3, 0xe0, 0x14, 0x1d, 0x2, 0x20, 0x86, 0x9c,
    0x45, 0x7, 0x41, 0x94, 0x4, 0x5, 0x10, 0x55,
    0x20, 0x10, 0x2, 0x0, 0x29, 0xa4, 0x0,
    /* U+003B ";" */
    0x0, 0x0, 0x0, 0x1b, 0xfc, 0x3, 0xff, 0xfc,
    0x6, 0xbe, 0xf4, 0x10, 0x2, 0xd0, 0x84, 0x13,
    0x45, 0x10, 0x45, 0x18, 0x10, 0x14, 0x10, 0x10,
    0x40, 0x10, 0x4, 0x0, 0x15, 0x40, 0x0, 0x0,
    0x0,
    /* U+003C "<" */
    0x0, 0x50, 0x0, 0xff, 0xd0, 0x3f, 0xff, 0x82,
    0x95, 0x2c, 0x25, 0x16, 0xc6, 0x4, 0x5d, 0x61,
    0x0, 0x52, 0x4, 0x1, 0x11, 0x51, 0x0, 0x40,
    0x40, 0x0, 0x50, 0x0,
    /* U+003D "=" */
    0x0, 0x54, 0x0, 0x1f, 0xfc, 0x0, 0x5a, 0x68,
    0x4, 0x0, 0x70, 0x15, 0x14, 0xc1, 0x85, 0x11,
    0x85, 0x4, 0x5, 0x8, 0x10, 0x14, 0x10, 0x81,
    0x0, 0x20, 0x4, 0x0, 0x15, 0x0, 0x0,
    /* U+003E ">" */
    0x1, 0xfe, 0x0, 0x2f, 0xfe, 0x0, 0xff, 0xfc,
    0x5, 0x0, 0x74, 0x35, 0x4, 0xf1, 0xc5, 0x20,
    0x67, 0x4, 0x2, 0xad, 0x14, 0x3e, 0x28, 0x2,
    0xe0, 0x5, 0x50, 0x0,
    /* U+003F "?" */
    0x0, 0x54, 0x0, 0x1f, 0xfc, 0x1, 0xff, 0xfc,
    0xf, 0xff, 0xf8, 0x16, 0x26, 0xf0, 0x80, 0x13,
    0x86, 0x20, 0x85, 0x14, 0x10, 0x4, 0x20, 0x0,
    0x50, 0x1, 0x40, 0x0, 0x50, 0x50, 0x0, 0x14,
    0x0,
    /* U+0040 "@" */
    0x0, 0x0, 0x0, 0xb, 0xe0, 0x0, 0xbf, 0xf4,
    0x8, 0x4b, 0xf0, 0x24, 0x17, 0xc1, 0x50, 0x4c,
    0x41, 0x51, 0x5, 0x4, 0x40, 0x54, 0x11, 0x2,
    0x0, 0x45, 0x0, 0x0, 0x0, 0x0, 0x0, 0x0,
    0x0,
    /* U+0041 "A" */
    0x0, 0x14, 0x40, 0x1, 0x7f, 0xfe, 0x1, 0xff,
    0xff, 0xc0, 0xff, 0xff, 0xfc, 0x7f, 0x90, 0x6f,
    0xf, 0x10, 0x13, 0xc3, 0xc0, 0x0, 0xb0, 0xa2,
    0x2, 0x18, 0x18, 0x14, 0x5, 0x6, 0x4, 0x41,
    0x0, 0x40, 0x40, 0x40, 0xa, 0x55, 0x40,
    /* U+0042 "B" */
    0x0, 0x0, 0x0, 0x1, 0x56, 0x40, 0x4, 0x0,
    0x10, 0x10, 0x0, 0x4, 0x21, 0xa6, 0x48, 0x14,
    0x41, 0x14, 0x14, 0x0, 0x28, 0x55, 0x52, 0x24,
    0x24, 0x10, 0x20, 0x4, 0x0, 0x10, 0x8, 0x14,
    0x10, 0x2, 0xa6, 0x40,
    /* U+0043 "C" */
    0x2, 0xfe, 0x0, 0xff, 0xfc, 0x2e, 0xff, 0x83,
    0x87, 0xfc, 0x3f, 0x44, 0xc2, 0x29, 0x94, 0x50,
    0x56, 0x57, 0x4, 0x18, 0x10, 0x81, 0x0, 0x0,
    0x10, 0x8, 0x11, 0x0, 0x55, 0x80,
    /* U+0044 "D" */
    0x0, 0x0, 0x0, 0x0, 0xbf, 0x40, 0x7, 0xff,
    0xe0, 0xf, 0xff, 0xf4, 0x1f, 0xef, 0xf8, 0x3a,
    0x45, 0x7c, 0x34, 0x1, 0x3c, 0x32, 0x4, 0x3c,
    0x71, 0x44, 0x14, 0xb0, 0x40, 0x8, 0xb0, 0x40,
    0x78, 0xb8, 0x50, 0xf4, 0x6e, 0x7, 0xe0, 0x0,
    0x64, 0x0,
    /* U+0045 "E" */
    0x0, 0x0, 0x0, 0x1, 0xaa, 0x40, 0x4, 0x0,
    0x10, 0x11, 0x0, 0x10, 0x14, 0x10, 0x4, 0x15,
    0x65, 0x84, 0x25, 0x1, 0x4, 0x14, 0x40, 0x28,
    0x44, 0x51, 0x24, 0x14, 0x10, 0x18, 0x18, 0x14,
    0x4, 0x5, 0x0, 0x50, 0x0, 0x0, 0x0,
    /* U+0046 "F" */
    0x0, 0x0, 0x0, 0xa, 0xf8, 0x0, 0xff, 0xfc,
    0x7, 0xff, 0xf8, 0x3e, 0xa6, 0xf0, 0x90, 0x2,
    0xc2, 0x50, 0x56, 0x14, 0x10, 0x55, 0x51, 0x40,
    0x40, 0x81, 0x41, 0x0, 0x45, 0x4, 0x1, 0x0,
    0x10, 0x2, 0xa9, 0x0,
    /* U+0047 "G" */
    0x0, 0xfd, 0x0, 0xf, 0xfe, 0x1, 0xff, 0xfc,
    0xf, 0xf, 0xfc, 0x38, 0x9, 0xe0, 0xe0, 0x66,
    0x46, 0x95, 0x5e, 0x19, 0xb1, 0x55, 0x60, 0x10,
    0x60, 0x11, 0x2, 0x0, 0x41, 0x4, 0x0, 0x80,
    0x80, 0x0, 0x54, 0x0,
    /* U+0048 "H" */
    0x0, 0x7e, 0x0, 0xb, 0xff, 0xf0, 0x1f, 0xff,
    0xf4, 0x2f, 0xff, 0xfc, 0x3f, 0xeb, 0xfc, 0x7d,
    0x0, 0x7d, 0x7d, 0x43, 0x3d, 0x78, 0x50, 0x29,
    0x38, 0x10, 0x2c, 0x2c, 0x18, 0x38, 0x5, 0x0,
    0x50, 0x0, 0x0, 0x0, 0x0, 0x0, 0x0,
    /* U+0049 "I" */
    0x0, 0x14, 0x0, 0xb, 0xff, 0x0, 0xff, 0xff,
    0x7, 0xff, 0xfd, 0x3f, 0xbb, 0xf8, 0xd8, 0x16,
    0xf7, 0x10, 0x4b, 0xdc, 0x91, 0x2f, 0xb0, 0x80,
    0xbe, 0xd1, 0x42, 0xfb, 0xc0, 0xf, 0xdf, 0x91,
    0xbd, 0x0, 0x0, 0x0,
    /* U+004A "J" */
    0x0, 0x0, 0x0, 0xb, 0xf8, 0x0, 0xbf, 0xfc,
    0xb, 0xff, 0xfc, 0x2c, 0x20, 0xf0, 0xd4, 0xa,
    0xc3, 0x10, 0x17, 0x18, 0x50, 0x49, 0x50, 0x80,
    0x24, 0x80, 0x40, 0x81, 0x5, 0x44, 0x2, 0x0,
    0x10, 0x1, 0x55, 0x0, 0x0, 0x0, 0x0,
    /* U+004B "K" */
    0x0, 0x14, 0x0, 0xb, 0xfe, 0x0, 0xbf, 0xfd,
    0xb, 0x6f, 0xf8, 0x3c, 0x1f, 0xf0, 0xfc, 0x2b,
    0x83, 0x19, 0x5e, 0x14, 0x55, 0x34, 0x65, 0x45,
    0x50, 0x81, 0x2, 0x41, 0x4, 0x4, 0x1, 0x0,
    0x10, 0x5, 0x5, 0x0, 0x1, 0x40, 0x0,
    /* U+004C "L" */
    0x1, 0xfe, 0x0, 0x3f, 0xfe, 0x2, 0xff, 0xff,
    0xf, 0xfd, 0x3d, 0x35, 0x0, 0xf4, 0x88, 0x15,
    0xc6, 0x24, 0x42, 0x54, 0x10, 0x9, 0x20, 0x40,
    0x64, 0x45, 0x41, 0x0, 0x40, 0x4, 0x0, 0x40,
    0x0,
    /* U+004D "M" */
    0x0, 0x0, 0x0, 0x7, 0xff, 0x80, 0xf, 0xff,
    0xf0, 0x8, 0x0, 0x30, 0x11, 0x1, 0x20, 0x60,
    0x1, 0x28, 0x55, 0x42, 0x55, 0x50, 0x10, 0x28,
    0x20, 0x14, 0x20, 0x10, 0x14, 0x10, 0x0, 0x10,
    0x10, 0xa, 0x55, 0x40,
    /* U+004E "N" */
    0x0, 0x0, 0x0, 0xb, 0xff, 0x0, 0xff, 0xfc,
    0x7, 0x55, 0xf0, 0x18, 0x0, 0xd0, 0xe6, 0xeb,
    0x85, 0x55, 0x59, 0x18, 0x61, 0x68, 0x10, 0x10,
    0x50, 0x40, 0x50, 0x41, 0x0, 0x4, 0x2, 0x95,
    0x90,
    /* U+004F "O" */
    0x0, 0x0, 0x0, 0x6, 0x56, 0x14, 0x2a, 0x29,
    0x65, 0x55, 0x99, 0x59, 0x65, 0x26, 0xa8, 0x2d,
    0x0, 0x68, 0x8, 0x0, 0x4c, 0x10, 0x41, 0x9,
    0x30, 0x60, 0x9, 0x24, 0x15, 0x18, 0x15, 0x56,
    0x54, 0x18, 0x14, 0x14, 0x5, 0x55, 0x40, 0x0,
    0x0, 0x0,
    /* U+0050 "P" */
    0x0, 0x14, 0x0, 0x3, 0xfc, 0x0, 0x7f, 0xf8,
    0xb, 0xff, 0xf8, 0x7f, 0xfa, 0xf1, 0xff, 0x43,
    0xc3, 0xa4, 0x17, 0x9, 0x0, 0xc, 0x51, 0x58,
    0x25, 0x81, 0x1, 0x50, 0x40, 0x5, 0x1, 0x4,
    0x10, 0x1, 0x1, 0x0, 0x2, 0xa4, 0x0,
    /* U+0051 "Q" */
    0x2, 0xf9, 0x0, 0xbf, 0xfe, 0x2, 0xff, 0xfc,
    0x6, 0xaa, 0xb8, 0x10, 0x0, 0xe0, 0x99, 0xa3,
    0x86, 0x10, 0x45, 0x54, 0x40, 0x5, 0x20, 0x40,
    0x10, 0x45, 0x42, 0x0, 0x40, 0x10, 0x1, 0x56,
    0x40,
    /* U+0052 "R" */
    0x1, 0x50, 0x0, 0x2f, 0xf0, 0x0, 0xff, 0xf8,
    0x3, 0xff, 0xf4, 0x14, 0x1, 0xd0, 0x54, 0x13,
    0x46, 0x10, 0x49, 0x18, 0x51, 0x24, 0x20, 0x40,
    0x10, 0x45, 0x41, 0x0, 0x0, 0x10, 0x0, 0x41,
    0x0, 0x0, 0x0, 0x0,
    /* U+0053 "S" */
    0x0, 0x0, 0x0, 0x0, 0x0, 0x0, 0x40, 0x0,
    0x0, 0x0, 0x10, 0x12, 0x5, 0x40, 0x80, 0x1,
    0x46, 0x14, 0x5, 0x54, 0x14, 0x10, 0x21, 0xf8,
    0x40, 0x1a, 0xb1, 0x0, 0x85, 0x10, 0x0, 0x55,
    0x0,
    /* U+0054 "T" */
    0x1, 0xb9, 0x0, 0x2f, 0xfe, 0x1, 0xff, 0xfd,
    0xb, 0x7b, 0xf8, 0x35, 0x6, 0xf0, 0xc4, 0x12,
    0xc5, 0x14, 0x40, 0x54, 0x20, 0x5, 0x20, 0x50,
    0xb0, 0x10, 0x3, 0xd0, 0x50, 0x6e, 0x0, 0x14,
    0x0,
    /* U+0055 "U" */
    0x0, 0x0, 0x0, 0x0, 0x0, 0x0, 0x0, 0x0,
    0x10, 0x0, 0x50, 0xb0, 0x11, 0x4, 0xb0, 0x11,
    0x0, 0x70, 0x52, 0x4c, 0x14, 0x61, 0x0, 0x8,
    0x21, 0x44, 0x34, 0x20, 0x50, 0x50, 0x14, 0x0,
    0xc0, 0xa, 0x5b, 0x40, 0x1, 0xa4, 0x0, 0x0,
    0x0, 0x0,
    /* U+0056 "V" */
    0x2, 0xfa, 0x0, 0x2f, 0xfc, 0x0, 0xff, 0xf8,
    0x5, 0x0, 0x30, 0x25, 0x4, 0xc0, 0x84, 0x23,
    0x45, 0x24, 0x9, 0x14, 0x20, 0x24, 0x20, 0xe0,
    0x90, 0x43, 0x84, 0x0, 0x40, 0x20, 0x0, 0x55,
    0x0, 0x0, 0x0, 0x0,
    /* U+0057 "W" */
    0x0, 0x0, 0x0, 0x0, 0x7f, 0xf4, 0x0, 0x7f,
    0xff, 0x40, 0x3f, 0xff, 0xf0, 0xe, 0x13, 0xfc,
    0x3, 0x10, 0x8f, 0x1, 0xc8, 0x22, 0x90, 0xe1,
    0x44, 0x1c, 0x78, 0x10, 0xb, 0x5f, 0x15, 0xf,
    0xd2, 0xe0, 0xb, 0xf0, 0x2e, 0x5b, 0xd0, 0x0,
    0x0, 0x0, 0x0,
    /* U+0058 "X" */
    0x0, 0x50, 0x0, 0x1b, 0xfc, 0x1, 0xff, 0xfd,
    0xf, 0x82, 0xf8, 0x30, 0x0, 0xf0, 0xd8, 0x67,
    0xc6, 0x24, 0x8d, 0x54, 0x0, 0x21, 0x23, 0xf4,
    0x40, 0x46, 0x92, 0x0, 0x40, 0x20, 0x0, 0x56,
    0x0, 0x0, 0x0, 0x0,
    /* U+0059 "Y" */
    0x0, 0x0, 0x0, 0x0, 0x2, 0xf9, 0x0, 0x0,
    0xbf, 0xf8, 0x0, 0x2f, 0xff, 0xc0, 0x7, 0xe4,
    0x6f, 0x1, 0xf1, 0x4, 0xf8, 0x7f, 0x30, 0xcb,
    0xe7, 0xe0, 0x40, 0x3d, 0x3d, 0x0, 0x12, 0xc0,
    0x10, 0x50, 0x20, 0x1, 0x0, 0x1, 0x0, 0x5,
    0x69, 0x40,
    /* U+005A "Z" */
    0x1, 0xa0, 0x0, 0xff, 0xe0, 0x3e, 0x5f, 0x83,
    0x40, 0x3c, 0x30, 0x1, 0xc2, 0x0, 0xc, 0x52,
    0x44, 0x95, 0x4, 0x9, 0x10, 0x40, 0x81, 0x5,
    0x10, 0x4, 0x1, 0x0, 0x10, 0x40, 0x0, 0x0,
    0x0,
    /* U+0061 "a" */
    0x0, 0x54, 0x0, 0x0, 0x0, 0x1, 0x40, 0x8,
    0x5, 0x51, 0x60, 0x25, 0x65, 0x91, 0x45, 0x55,
    0x55, 0x14, 0x52, 0x4, 0x14, 0x4, 0x10, 0x54,
    0x10, 0x40, 0x0, 0x40, 0x55, 0x54, 0x0,
    /* U+0062 "b" */
    0x0, 0x19, 0x40, 0x0, 0x65, 0x68, 0x0, 0x56,
    0x5b, 0x80, 0x20, 0x6a, 0xa4, 0x18, 0x5, 0x49,
    0x9, 0x0, 0x12, 0x45, 0x15, 0x4, 0x91, 0x55,
    0x45, 0x24, 0x14, 0x0, 0x9, 0x1, 0x5, 0x4,
    0x0, 0x10, 0x1, 0x0, 0x1, 0xa5, 0x0,
    /* U+0063 "c" */
    0x2, 0xb9, 0x0, 0x3f, 0xfe, 0x2, 0xfe, 0xfd,
    0xf, 0x40, 0xfc, 0x35, 0x8, 0xf0, 0xc0, 0x2,
    0xc6, 0x24, 0x85, 0x54, 0x54, 0x5, 0x20, 0x0,
    0x60, 0x41, 0x81, 0x0, 0x50, 0x50, 0x0, 0x14,
    0x0,
    /* U+0064 "d" */
    0x0, 0x0, 0x2, 0xc0, 0x2e, 0x7e, 0xbb, 0xf2,
    0xff, 0xfc, 0x1f, 0xbf, 0xc3, 0xa0, 0xac, 0x30,
    0x0, 0xd6, 0x24, 0x85, 0x50, 0x0, 0x11, 0x9,
    0x8, 0x4, 0xd1, 0x0, 0x65, 0x40, 0x0, 0x0,
    0x0,
    /* U+0065 "e" */
    0x1, 0x55, 0x0, 0x10, 0x41, 0x0, 0x45, 0x11,
    0x4, 0x41, 0x44, 0x20, 0x0, 0x11, 0x89, 0x11,
    0x45, 0x4, 0x5, 0x48, 0x10, 0x18, 0x10, 0x50,
    0x40, 0x20, 0x4, 0x0, 0x15, 0x40, 0x0, 0x0,
    0x0,
    /* U+0066 "f" */
    0x0, 0x0, 0x0, 0x1, 0xff, 0x40, 0xb, 0xff,
    0xd0, 0xf, 0xff, 0xf0, 0x2d, 0xaf, 0xf0, 0x25,
    0x1, 0x74, 0x35, 0x0, 0x78, 0x75, 0x44, 0x7c,
    0xb4, 0x40, 0x7d, 0xb8, 0x50, 0xbc, 0x18, 0x1,
    0xe0, 0x1, 0x55, 0x0,
    /* U+0067 "g" */
    0x1, 0x90, 0x0, 0x2f, 0xee, 0x2, 0xff, 0xfd,
    0xf, 0xff, 0xfc, 0x2f, 0xd1, 0xf8, 0x44, 0x13,
    0xe2, 0x10, 0x5f, 0x14, 0x92, 0x21, 0x51, 0x0,
    0x4, 0x85, 0x1, 0x82, 0x16, 0x4, 0x1, 0x0,
    0x80, 0x6, 0xa4, 0x0,
    /* U+0068 "h" */
    0x0, 0x0, 0x0, 0x0, 0x0, 0x0, 0x40, 0x4,
    0x0, 0x0, 0x10, 0x1a, 0x1a, 0x40, 0x86, 0x53,
    0x46, 0x65, 0x59, 0x49, 0x81, 0x11, 0x13, 0xf4,
    0x90, 0x59, 0xa2, 0x1, 0x4, 0x14, 0x2, 0x55,
    0x40, 0x0, 0x50, 0x0,
    /* U+0069 "i" */
    0x2, 0xfd, 0x0, 0x3f, 0xfe, 0x1, 0xff, 0xfd,
    0x9, 0x4, 0x38, 0x25, 0x5, 0xe0, 0x88, 0x2,
    0x85, 0x14, 0x84, 0x54, 0x10, 0x5, 0x20, 0x40,
    0x50, 0x45, 0x51, 0x0, 0x80, 0x10, 0x0, 0xaa,
    0x0, 0x0, 0x0, 0x0,
    /* U+006A "j" */
    0x0, 0x69, 0x0, 0x3, 0xff, 0xc0, 0xf, 0xff,
    0xf0, 0xf, 0xff, 0xf4, 0x29, 0x12, 0xf8, 0x35,
    0x5, 0xbc, 0x32, 0x4, 0x6c, 0x71, 0x44, 0x8,
    0xb0, 0x40, 0xd, 0xb4, 0x50, 0x7d, 0x3c, 0x1,
    0xfc, 0x1, 0x55, 0x50,
    /* U+006B "k" */
    0x0, 0x0, 0x0, 0x0, 0xbf, 0xec, 0x2, 0xff,
    0xff, 0xc1, 0xff, 0xff, 0xf8, 0x7f, 0xff, 0x3f,
    0x5, 0x40, 0x4b, 0x46, 0x10, 0x10, 0xc1, 0x41,
    0x5, 0x28, 0x61, 0x61, 0x5, 0x4, 0xd, 0x1,
    0x0, 0x42, 0x81, 0x0, 0x5, 0x55, 0x0,
    /* U+006C "l" */
    0x1, 0xfe, 0x0, 0x2f, 0xff, 0x1, 0xff, 0xfd,
    0xf, 0xff, 0xfc, 0x3e, 0xe9, 0xb0, 0x80, 0x15,
    0x86, 0x56, 0x6, 0x9, 0x61, 0x48, 0x10, 0x0,
    0x10, 0x40, 0x40, 0x40, 0x55, 0x54, 0x0,
    /* U+006D "m" */
    0x0, 0x60, 0x0, 0x3f, 0xe0, 0x7, 0xff, 0x0,
    0xff, 0xf4, 0xf, 0xfb, 0x0, 0x50, 0x10, 0x20,
    0x0, 0x95, 0x14, 0x45, 0x20, 0x0, 0x41, 0x25,
    0xc4, 0x15, 0x55, 0x80, 0x6f, 0xe0, 0x0, 0x0,
    0x0,
    /* U+006E "n" */
    0x0, 0x0, 0x0, 0x0, 0xbe, 0x0, 0x3, 0xff,
    0xc0, 0x7, 0xff, 0xd0, 0xf, 0xab, 0xf0, 0x3c,
    0x1, 0x38, 0x38, 0x41, 0x3c, 0xb8, 0x0, 0x2c,
    0x34, 0x10, 0x2c, 0x8, 0x0, 0x20, 0x1, 0x69,
    0x40,
    /* U+006F "o" */
    0x0, 0x68, 0x0, 0x2f, 0xff, 0x2, 0xff, 0xff,
    0xf, 0xbf, 0xf8, 0x5, 0x8, 0xf0, 0x80, 0x3,
    0x86, 0x24, 0x84, 0x48, 0x20, 0x1, 0x10, 0x50,
    0x50, 0x13, 0xc1, 0x0, 0x55, 0x50, 0x0, 0x0,
    0x0,
    /* U+0070 "p" */
    0x0, 0x0, 0x0, 0x1f, 0xf8, 0x1, 0xff, 0xfc,
    0xf, 0x9a, 0xf4, 0x20, 0x2, 0xe0, 0x84, 0x17,
    0x46, 0x10, 0x4a, 0x18, 0x51, 0x14, 0x62, 0x80,
    0x10, 0x40, 0x53, 0x40, 0x44, 0x1f, 0x0, 0x55,
    0x4, 0x0, 0x0, 0x0,
    /* U+0071 "q" */
    0x0, 0x54, 0x0, 0x1f, 0xfc, 0x0, 0x8a, 0x58,
    0x8, 0x0, 0x30, 0x25, 0x4, 0xc1, 0xc0, 0x3,
    0x46, 0x24, 0x89, 0x18, 0x10, 0x14, 0x20, 0x40,
    0x50, 0x45, 0x41, 0x0, 0x40, 0x10, 0x0, 0x55,
    0x0,
    /* U+0072 "r" */
    0x0, 0x69, 0x0, 0x3, 0xff, 0xc0, 0xb, 0xff,
    0xe0, 0xf, 0xff, 0xf0, 0x1f, 0xff, 0xf4, 0x2a,
    0x49, 0xb4, 0x76, 0x5, 0x7c, 0xb4, 0x40, 0x7d,
    0xb4, 0x0, 0xbe, 0x3c, 0x50, 0xfd, 0xa, 0x2,
    0xe0, 0x1, 0xfd, 0x0, 0x0, 0x0, 0x0,
    /* U+0073 "s" */
    0x0, 0x0, 0x0, 0x2f, 0xa8, 0x2, 0xff, 0xf8,
    0xf, 0xef, 0xf0, 0x1d, 0x6, 0xe0, 0x58, 0x63,
    0xc2, 0x20, 0xf, 0x14, 0x92, 0x25, 0x21, 0x0,
    0x10, 0x45, 0x12, 0x40, 0x5a, 0x10, 0x1, 0x41,
    0x40, 0x0, 0x50, 0x0,
    /* U+0074 "t" */
    0x1, 0xfe, 0x0, 0x2b, 0xfe, 0x0, 0x40, 0xc,
    0x5, 0x41, 0x24, 0x20, 0x4, 0xa1, 0x49, 0x32,
    0x16, 0x10, 0x8, 0x49, 0xfe, 0x34, 0x2e, 0xaf,
    0xc0, 0x3f, 0xfd, 0x0, 0x7f, 0x90, 0x0,
    /* U+0075 "u" */
    0x1, 0xfe, 0x0, 0x3f, 0xff, 0x2, 0xef, 0xfd,
    0xe, 0x6, 0xf8, 0x25, 0x5, 0xf0, 0x84, 0x13,
    0x85, 0x24, 0x85, 0x18, 0x10, 0x4, 0x11, 0x14,
    0x50, 0x11, 0x44, 0x0, 0x50, 0x50, 0x0, 0x14,
    0x0,
    /* U+0076 "v" */
    0x0, 0x14, 0x0, 0x1, 0xff, 0x80, 0x7, 0xff,
    0xe0, 0xf, 0x1f, 0xf0, 0x1c, 0x6, 0xf4, 0x39,
    0x46, 0xb8, 0x7a, 0xa0, 0xed, 0x75, 0x8a, 0x9,
    0xb0, 0x40, 0x1d, 0xb4, 0x0, 0xbd, 0x2c, 0x11,
    0xfc, 0x2, 0x5a, 0xe0,
    /* U+0077 "w" */
    0x1, 0xbf, 0x40, 0x7, 0xff, 0xe0, 0xf, 0xff,
    0xf8, 0x2f, 0xff, 0xbc, 0x3f, 0x3d, 0x3c, 0x35,
    0x41, 0x6c, 0x50, 0x42, 0x15, 0x40, 0x61, 0x15,
    0x58, 0x10, 0x24, 0x5, 0x10, 0x40, 0x0, 0x55,
    0x0,
    /* U+0078 "x" */
    0x2, 0xf0, 0x0, 0x7f, 0x80, 0xb, 0xfd, 0x0,
    0x7f, 0xf0, 0x1f, 0xff, 0xc1, 0xe9, 0xf4, 0x4,
    0x4, 0x94, 0x58, 0x49, 0x34, 0x40, 0xc0, 0x41,
    0x10, 0x5, 0x6, 0x0, 0x1e, 0x80,
    /* U+0079 "y" */
    0x6, 0x56, 0x40, 0x5, 0xa5, 0x10, 0x10, 0x0,
    0x20, 0x21, 0x45, 0x14, 0x60, 0x10, 0x24, 0x60,
    0x10, 0x14, 0x20, 0x14, 0x10, 0x4, 0x0, 0x10,
    0x4, 0x0, 0x80, 0x1, 0xa9, 0x0,
    /* U+007A "z" */
    0x1, 0xbe, 0x0, 0x2f, 0xff, 0x1, 0xff, 0xfe,
    0xb, 0xff, 0xfc, 0x3e, 0x55, 0xf0, 0x80, 0x0,
    0x95, 0x14, 0x42, 0x58, 0x0, 0xd, 0x74, 0x10,
    0x74, 0xf0, 0x3, 0xc0, 0x15, 0x55, 0x0
};
/*---------------------
 *  GLYPH DESCRIPTION
 *--------------------*/
static const lv_font_fmt_txt_glyph_dsc_t blockhead_20_glyph_dsc[] = {
    {.bitmap_index = 0, .adv_w = 0, .box_w = 0, .box_h = 0, .ofs_x = 0, .ofs_y = 0} /* id = 0 reserved */,
    {.bitmap_index = 0, .adv_w = 61, .box_w = 0, .box_h = 0, .ofs_x = 0, .ofs_y = 0},
    {.bitmap_index = 0, .adv_w = 160, .box_w = 10, .box_h = 10, .ofs_x = 0, .ofs_y = 2},
    {.bitmap_index = 25, .adv_w = 173, .box_w = 11, .box_h = 12, .ofs_x = 0, .ofs_y = 1},
    {.bitmap_index = 58, .adv_w = 171, .box_w = 11, .box_h = 13, .ofs_x = 0, .ofs_y = 0},
    {.bitmap_index = 94, .adv_w = 179, .box_w = 11, .box_h = 12, .ofs_x = 0, .ofs_y = 1},
    {.bitmap_index = 127, .adv_w = 172, .box_w = 11, .box_h = 12, .ofs_x = 0, .ofs_y = 1},
    {.bitmap_index = 160, .adv_w = 165, .box_w = 10, .box_h = 13, .ofs_x = 0, .ofs_y = 2},
    {.bitmap_index = 193, .adv_w = 196, .box_w = 13, .box_h = 11, .ofs_x = 0, .ofs_y = 2},
    {.bitmap_index = 229, .adv_w = 180, .box_w = 11, .box_h = 12, .ofs_x = 0, .ofs_y = 1},
    {.bitmap_index = 262, .adv_w = 208, .box_w = 13, .box_h = 10, .ofs_x = 0, .ofs_y = 1},
    {.bitmap_index = 295, .adv_w = 169, .box_w = 11, .box_h = 10, .ofs_x = 0, .ofs_y = 1},
    {.bitmap_index = 323, .adv_w = 179, .box_w = 11, .box_h = 10, .ofs_x = 0, .ofs_y = 1},
    {.bitmap_index = 351, .adv_w = 181, .box_w = 11, .box_h = 11, .ofs_x = 0, .ofs_y = 1},
    {.bitmap_index = 382, .adv_w = 166, .box_w = 11, .box_h = 12, .ofs_x = 0, .ofs_y = 0},
    {.bitmap_index = 415, .adv_w = 164, .box_w = 10, .box_h = 11, .ofs_x = 0, .ofs_y = 1},
    {.bitmap_index = 443, .adv_w = 166, .box_w = 11, .box_h = 11, .ofs_x = 0, .ofs_y = 1},
    {.bitmap_index = 474, .adv_w = 178, .box_w = 11, .box_h = 10, .ofs_x = 0, .ofs_y = 2},
    {.bitmap_index = 502, .adv_w = 172, .box_w = 11, .box_h = 12, .ofs_x = 0, .ofs_y = 1},
    {.bitmap_index = 535, .adv_w = 168, .box_w = 11, .box_h = 12, .ofs_x = 0, .ofs_y = 1},
    {.bitmap_index = 568, .adv_w = 204, .box_w = 13, .box_h = 12, .ofs_x = 0, .ofs_y = 2},
    {.bitmap_index = 607, .adv_w = 186, .box_w = 12, .box_h = 12, .ofs_x = 0, .ofs_y = 2},
    {.bitmap_index = 643, .adv_w = 158, .box_w = 10, .box_h = 12, .ofs_x = 0, .ofs_y = 1},
    {.bitmap_index = 673, .adv_w = 184, .box_w = 12, .box_h = 14, .ofs_x = 0, .ofs_y = 1},
    {.bitmap_index = 715, .adv_w = 187, .box_w = 12, .box_h = 13, .ofs_x = 0, .ofs_y = 1},
    {.bitmap_index = 754, .adv_w = 173, .box_w = 11, .box_h = 13, .ofs_x = 0, .ofs_y = 2},
    {.bitmap_index = 790, .adv_w = 171, .box_w = 11, .box_h = 13, .ofs_x = 0, .ofs_y = 0},
    {.bitmap_index = 826, .adv_w = 194, .box_w = 12, .box_h = 13, .ofs_x = 0, .ofs_y = 0},
    {.bitmap_index = 865, .adv_w = 181, .box_w = 11, .box_h = 13, .ofs_x = 0, .ofs_y = 1},
    {.bitmap_index = 901, .adv_w = 181, .box_w = 11, .box_h = 14, .ofs_x = 0, .ofs_y = 0},
    {.bitmap_index = 940, .adv_w = 170, .box_w = 11, .box_h = 14, .ofs_x = 0, .ofs_y = 0},
    {.bitmap_index = 979, .adv_w = 179, .box_w = 11, .box_h = 12, .ofs_x = 0, .ofs_y = 1},
    {.bitmap_index = 1012, .adv_w = 187, .box_w = 12, .box_h = 12, .ofs_x = 0, .ofs_y = 2},
    {.bitmap_index = 1048, .adv_w = 166, .box_w = 11, .box_h = 12, .ofs_x = 0, .ofs_y = 2},
    {.bitmap_index = 1081, .adv_w = 196, .box_w = 12, .box_h = 14, .ofs_x = 0, .ofs_y = 0},
    {.bitmap_index = 1123, .adv_w = 181, .box_w = 11, .box_h = 14, .ofs_x = 0, .ofs_y = 1},
    {.bitmap_index = 1162, .adv_w = 176, .box_w = 11, .box_h = 12, .ofs_x = 0, .ofs_y = 1},
    {.bitmap_index = 1195, .adv_w = 169, .box_w = 11, .box_h = 13, .ofs_x = 0, .ofs_y = 1},
    {.bitmap_index = 1231, .adv_w = 172, .box_w = 11, .box_h = 12, .ofs_x = 0, .ofs_y = 2},
    {.bitmap_index = 1264, .adv_w = 175, .box_w = 11, .box_h = 12, .ofs_x = 0, .ofs_y = 1},
    {.bitmap_index = 1297, .adv_w = 182, .box_w = 12, .box_h = 14, .ofs_x = 0, .ofs_y = 0},
    {.bitmap_index = 1339, .adv_w = 167, .box_w = 11, .box_h = 13, .ofs_x = 0, .ofs_y = 0},
    {.bitmap_index = 1375, .adv_w = 205, .box_w = 13, .box_h = 13, .ofs_x = 0, .ofs_y = 1},
    {.bitmap_index = 1418, .adv_w = 179, .box_w = 11, .box_h = 13, .ofs_x = 0, .ofs_y = 1},
    {.bitmap_index = 1454, .adv_w = 227, .box_w = 14, .box_h = 12, .ofs_x = 0, .ofs_y = 2},
    {.bitmap_index = 1496, .adv_w = 158, .box_w = 10, .box_h = 13, .ofs_x = 0, .ofs_y = 0},
    {.bitmap_index = 1529, .adv_w = 174, .box_w = 11, .box_h = 11, .ofs_x = 0, .ofs_y = 2},
    {.bitmap_index = 1560, .adv_w = 198, .box_w = 13, .box_h = 12, .ofs_x = 0, .ofs_y = 2},
    {.bitmap_index = 1599, .adv_w = 175, .box_w = 11, .box_h = 12, .ofs_x = 0, .ofs_y = 1},
    {.bitmap_index = 1632, .adv_w = 164, .box_w = 10, .box_h = 13, .ofs_x = 0, .ofs_y = 1},
    {.bitmap_index = 1665, .adv_w = 172, .box_w = 11, .box_h = 12, .ofs_x = 0, .ofs_y = 1},
    {.bitmap_index = 1698, .adv_w = 186, .box_w = 12, .box_h = 12, .ofs_x = 0, .ofs_y = 2},
    {.bitmap_index = 1734, .adv_w = 179, .box_w = 11, .box_h = 13, .ofs_x = 0, .ofs_y = 1},
    {.bitmap_index = 1770, .adv_w = 174, .box_w = 11, .box_h = 13, .ofs_x = 0, .ofs_y = 1},
    {.bitmap_index = 1806, .adv_w = 173, .box_w = 11, .box_h = 13, .ofs_x = 0, .ofs_y = 0},
    {.bitmap_index = 1842, .adv_w = 189, .box_w = 12, .box_h = 12, .ofs_x = 0, .ofs_y = 2},
    {.bitmap_index = 1878, .adv_w = 200, .box_w = 13, .box_h = 12, .ofs_x = 0, .ofs_y = 2},
    {.bitmap_index = 1917, .adv_w = 170, .box_w = 11, .box_h = 11, .ofs_x = 0, .ofs_y = 2},
    {.bitmap_index = 1948, .adv_w = 160, .box_w = 10, .box_h = 13, .ofs_x = 0, .ofs_y = 1},
    {.bitmap_index = 1981, .adv_w = 189, .box_w = 12, .box_h = 11, .ofs_x = 0, .ofs_y = 2},
    {.bitmap_index = 2014, .adv_w = 177, .box_w = 11, .box_h = 12, .ofs_x = 0, .ofs_y = 1},
    {.bitmap_index = 2047, .adv_w = 167, .box_w = 11, .box_h = 13, .ofs_x = 0, .ofs_y = 1},
    {.bitmap_index = 2083, .adv_w = 168, .box_w = 11, .box_h = 12, .ofs_x = 0, .ofs_y = 2},
    {.bitmap_index = 2116, .adv_w = 190, .box_w = 12, .box_h = 13, .ofs_x = 0, .ofs_y = 1},
    {.bitmap_index = 2155, .adv_w = 172, .box_w = 11, .box_h = 13, .ofs_x = 0, .ofs_y = 1},
    {.bitmap_index = 2191, .adv_w = 176, .box_w = 11, .box_h = 11, .ofs_x = 0, .ofs_y = 2},
    {.bitmap_index = 2222, .adv_w = 171, .box_w = 11, .box_h = 12, .ofs_x = 0, .ofs_y = 1},
    {.bitmap_index = 2255, .adv_w = 196, .box_w = 12, .box_h = 12, .ofs_x = 0, .ofs_y = 2},
    {.bitmap_index = 2291, .adv_w = 193, .box_w = 12, .box_h = 11, .ofs_x = 0, .ofs_y = 2},
    {.bitmap_index = 2324, .adv_w = 158, .box_w = 10, .box_h = 12, .ofs_x = 0, .ofs_y = 1},
    {.bitmap_index = 2354, .adv_w = 183, .box_w = 12, .box_h = 10, .ofs_x = 0, .ofs_y = 2},
    {.bitmap_index = 2384, .adv_w = 179, .box_w = 11, .box_h = 11, .ofs_x = 0, .ofs_y = 2}
};
/*---------------------
 *  CHARACTER MAPPING
 *--------------------*/
/*Collect the unicode lists and glyph_id offsets*/
static const lv_font_fmt_txt_cmap_t blockhead_20_cmaps[] =
{
    {
        .range_start = 32, .range_length = 1, .glyph_id_start = 1,
        .unicode_list = NULL, .glyph_id_ofs_list = NULL, .list_length = 0, .type = LV_FONT_FMT_TXT_CMAP_FORMAT0_TINY
    },
    {
        .range_start = 47, .range_length = 44, .glyph_id_start = 2,
        .unicode_list = NULL, .glyph_id_ofs_list = NULL, .list_length = 0, .type = LV_FONT_FMT_TXT_CMAP_FORMAT0_TINY
    },
    {
        .range_start = 97, .range_length = 26, .glyph_id_start = 46,
        .unicode_list = NULL, .glyph_id_ofs_list = NULL, .list_length = 0, .type = LV_FONT_FMT_TXT_CMAP_FORMAT0_TINY
    }
};
/*--------------------
 *  ALL CUSTOM DATA
 *--------------------*/
/*Store all the custom data of the font*/
static lv_font_fmt_txt_glyph_cache_t blockhead_20_cache;
static const lv_font_fmt_txt_dsc_t blockhead_20_font_dsc = {
    .glyph_bitmap = blockhead_20_glyph_bitmap,
    .glyph_dsc = blockhead_20_glyph_dsc,
    .cmaps = blockhead_20_cmaps,
    .kern_dsc = NULL,
    .kern_scale = 0,
    .cmap_num = 3,
    .bpp = 2,
    .kern_classes = 0,
    .bitmap_format = 0,
    .cache = &blockhead_20_cache
};
/*-----------------
 *  PUBLIC FONT
 *----------------*/
/*Initialize a public general font descriptor*/
const lv_font_t blockhead_20 = {
    .get_glyph_dsc = lv_font_get_glyph_dsc_fmt_txt,    /*Function pointer to get glyph's data*/
    .get_glyph_bitmap = lv_font_get_bitmap_fmt_txt,    /*Function pointer to get glyph's bitmap*/
    .line_height = 15,          /*The maximum line height required by the font*/
    .base_line = 0,             /*Baseline measured from the bottom of the line*/

    .subpx = LV_FONT_SUBPX_NONE,
    .underline_position = -1,
    .underline_thickness = 1,
    .dsc = &blockhead_20_font_dsc,          /*The custom font data. Will be accessed by `get_glyph_bitmap/dsc` */
};
#endif

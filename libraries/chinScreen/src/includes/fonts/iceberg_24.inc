/*******************************************************************************
 * Size: 18 px
 * Bpp: 2
 ******************************************************************************/


#ifdef __has_include

    #if __has_include("lvgl.h")
         #ifndef LV_LVGL_H_INCLUDE_SIMPLE
             #define LV_LVGL_H_INCLUDE_SIMPLE
         #endif
     #endif
 #endif

 #ifdef LV_LVGL_H_INCLUDE_SIMPLE
     #include "lvgl.h"
 #else
     #include "../lvgl-8.3.11/lvgl.h"
 #endif

 #ifndef ICEBERG
 #define ICEBERG 1
 #endif

 #if ICEBERG

/*-----------------
 *    BITMAPS
 *----------------*/
/*Store the image of the glyphs*/
static LV_ATTRIBUTE_LARGE_CONST const uint8_t glyph_bitmap[] = {
    /* U+0020 " " */
    /* U+0021 "!" */
    0x3c, 0xf3, 0xcf, 0x3c, 0xf3, 0xce, 0x20, 0x3,
    0x8f,
    /* U+0022 "\"" */
    0x38, 0xf3, 0x8f, 0x38, 0xf3, 0x4e, 0x10, 0x80,
    0x0,
    /* U+0023 "#" */
    0x0, 0x40, 0x10, 0x0, 0xc0, 0xd0, 0xb, 0xff,
    0xfc, 0xb, 0xea, 0xd0, 0x3, 0x41, 0xc0, 0x7,
    0x43, 0x80, 0x2f, 0xff, 0xe0, 0x1b, 0x5b, 0x40,
    0x9, 0x6, 0x0, 0x0, 0x0, 0x0,
    /* U+0024 "$" */
    0x0, 0x0, 0x0, 0x30, 0x1, 0xff, 0xe1, 0xeb,
    0xa9, 0x74, 0xc0, 0x1d, 0x30, 0x7, 0x4d, 0x0,
    0xbf, 0xf8, 0x5, 0xd7, 0x80, 0x30, 0xe0, 0xc,
    0x38, 0x3, 0xe, 0x6a, 0xeb, 0x4f, 0xff, 0x80,
    0xc, 0x0, 0x0, 0x0,
    /* U+0025 "%" */
    0x2f, 0x0, 0x30, 0xb, 0xbc, 0xa, 0x0, 0xb2,
    0xc0, 0xd0, 0xb, 0x2c, 0x1c, 0x0, 0xb2, 0xc3,
    0x80, 0xb, 0x2c, 0x30, 0x0, 0xb2, 0xcb, 0x0,
    0x3, 0xf4, 0xd2, 0xf4, 0x4, 0x1c, 0x76, 0xc0,
    0x3, 0x87, 0x1c, 0x0, 0x30, 0x71, 0xc0, 0xb,
    0x7, 0x1c, 0x0, 0xd0, 0x7a, 0xc0, 0x1c, 0x1,
    0xf0,
    /* U+0026 "&" */
    0xb, 0xe0, 0x1, 0xeb, 0x80, 0x2c, 0x3c, 0x1,
    0xe3, 0x0, 0xf, 0x40, 0x0, 0x3c, 0x0, 0x1f,
    0xff, 0xd7, 0xab, 0xe4, 0x74, 0x3d, 0x7, 0x40,
    0xf0, 0x7a, 0xab, 0xc1, 0xff, 0x2e,
    /* U+0027 "'" */
    0x38, 0xe3, 0x8d, 0x10, 0x0,
    /* U+0028 "(" */
    0x3c, 0xf8, 0xf0, 0xf0, 0xf0, 0xf0, 0xf0, 0xf0,
    0xf0, 0xf0, 0xf0, 0xf0, 0xf0, 0xf8, 0x3c,
    /* U+0029 ")" */
    0xf0, 0x7c, 0x2c, 0x2c, 0x2c, 0x2c, 0x2c, 0x2c,
    0x2c, 0x2c, 0x2c, 0x2c, 0x2c, 0x7c, 0xf0,
    /* U+002A "*" */
    0x0, 0x40, 0xf, 0x1c, 0x80, 0x57, 0x30, 0xfd,
    0xc0, 0x16, 0x3f, 0x49, 0xa5, 0x3, 0x28, 0xf0,
    0x1, 0x4, 0x0, 0x0, 0x0,
    /* U+002B "+" */
    0x1, 0xc0, 0x0, 0x70, 0x0, 0x1c, 0x0, 0xff,
    0xfc, 0x2a, 0xea, 0x0, 0x70, 0x0, 0x1c, 0x0,
    0x0, 0x0,
    /* U+002C "," */
    0x74, 0x7c, 0x1c, 0x1c, 0x14, 0x0,
    /* U+002D "-" */
    0xa, 0x83, 0xf8,
    /* U+002E "." */
    0x38, 0xf0,
    /* U+002F "/" */
    0x0, 0x7, 0x0, 0x3, 0x80, 0x1, 0xd0, 0x0,
    0xb0, 0x0, 0x34, 0x0, 0x2c, 0x0, 0xe, 0x0,
    0x7, 0x40, 0x3, 0xc0, 0x0, 0xd0, 0x0, 0xb0,
    0x0, 0x38, 0x0, 0x1c, 0x0, 0xf, 0x0, 0x3,
    0x40, 0x0,
    /* U+0030 "0" */
    0x2f, 0xe2, 0xea, 0xdb, 0x3, 0xac, 0xe, 0xb0,
    0x3a, 0xc0, 0xeb, 0x3, 0xac, 0xe, 0xb0, 0x3a,
    0xc0, 0xeb, 0xab, 0x4b, 0xf8,
    /* U+0031 "1" */
    0xb, 0xc0, 0xbf, 0xb, 0x6c, 0x4, 0xb0, 0x2,
    0xc0, 0xb, 0x0, 0x2c, 0x0, 0xb0, 0x2, 0xc0,
    0xb, 0x6, 0xbe, 0x6f, 0xfe,
    /* U+0032 "2" */
    0x3f, 0xd3, 0xea, 0xcf, 0x7, 0x7c, 0x1d, 0x50,
    0x74, 0x2, 0xd0, 0x2e, 0x2, 0xd0, 0x2d, 0x3,
    0xd0, 0xf, 0xaa, 0x3f, 0xfc,
    /* U+0033 "3" */
    0x3f, 0xfc, 0x2a, 0xac, 0x0, 0x38, 0x0, 0xe0,
    0x3, 0xc0, 0x7, 0xf4, 0x0, 0x2c, 0x0, 0x2c,
    0x0, 0x2c, 0x38, 0x2c, 0x3e, 0xbc, 0xf, 0xf0,
    /* U+0034 "4" */
    0x1, 0xe0, 0x1e, 0x1, 0xe0, 0x1e, 0xd, 0xf0,
    0x77, 0x81, 0xde, 0x7, 0x78, 0x2d, 0xff, 0xf5,
    0x56, 0xd0, 0x7, 0x40, 0x1d,
    /* U+0035 "5" */
    0xbf, 0xfa, 0xea, 0x9b, 0x0, 0x2c, 0x0, 0xb0,
    0x2, 0xff, 0x81, 0x57, 0x80, 0xe, 0x0, 0x3a,
    0xc0, 0xeb, 0xab, 0x4b, 0xf8,
    /* U+0036 "6" */
    0x2f, 0xfa, 0xea, 0x9b, 0x0, 0x2c, 0x0, 0xb0,
    0x2, 0xff, 0xcb, 0x57, 0xac, 0xf, 0xb0, 0x3e,
    0xc0, 0xfb, 0xab, 0x8b, 0xf8,
    /* U+0037 "7" */
    0xff, 0xf7, 0xea, 0xdf, 0x7, 0x7c, 0x1d, 0x50,
    0x74, 0x1, 0xd0, 0xf, 0x0, 0xf0, 0xf, 0x0,
    0x38, 0x0, 0xe0, 0x3, 0x80,
    /* U+0038 "8" */
    0x2f, 0xe2, 0xea, 0xdb, 0x7, 0x6c, 0x1d, 0x30,
    0x70, 0xff, 0xcf, 0x3, 0xbc, 0xf, 0xf0, 0x3f,
    0xc0, 0xff, 0xab, 0x8f, 0xf8,
    /* U+0039 "9" */
    0x3f, 0xe3, 0xea, 0xdf, 0x3, 0xbc, 0xe, 0xf0,
    0x3b, 0xc0, 0xe7, 0xff, 0x86, 0xae, 0x0, 0x38,
    0x0, 0xe6, 0xab, 0x6f, 0xf8,
    /* U+003A ":" */
    0x79, 0xe0, 0x0, 0x0, 0x7, 0x9e,
    /* U+003B ";" */
    0xb6, 0xd0, 0x0, 0x0, 0xf, 0x3e, 0x3c, 0xf2,
    0x0,
    /* U+003C "<" */
    0x0, 0x20, 0x3, 0xd0, 0x7c, 0xb, 0x80, 0xb8,
    0x0, 0xb8, 0x0, 0x7c, 0x0, 0x3d, 0x0, 0x20,
    /* U+003D "=" */
    0x0, 0x0, 0xf, 0xff, 0xc1, 0x55, 0x50, 0x0,
    0x0, 0x3f, 0xff, 0x5, 0x55, 0x40,
    /* U+003E ">" */
    0x60, 0x1, 0xf0, 0x0, 0xf4, 0x0, 0xf4, 0x0,
    0xf4, 0xb, 0x80, 0xf4, 0x1f, 0x0, 0x60, 0x0,
    /* U+003F "?" */
    0xf, 0xf0, 0x3e, 0xbc, 0x38, 0x2c, 0x38, 0x2c,
    0x24, 0x2c, 0x0, 0x2c, 0x0, 0xb4, 0x0, 0xd0,
    0x0, 0x40, 0x0, 0x0, 0x3, 0xc0, 0x3, 0xc0,
    /* U+0040 "@" */
    0xf, 0xff, 0xff, 0xc3, 0xea, 0xaa, 0xaf, 0x38,
    0x0, 0x0, 0xf3, 0x80, 0x0, 0xf, 0x38, 0x0,
    0x0, 0xf3, 0x81, 0xfe, 0xf, 0x38, 0x2a, 0xb4,
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    0x3d, 0x55, 0x55, 0x40, 0xff, 0xff, 0xf8,
    /* U+0041 "A" */
    0x1f, 0xff, 0x4e, 0xaa, 0x97, 0x40, 0x35, 0xd0,
    0x1d, 0x74, 0x7, 0x5d, 0x1, 0xd7, 0x6f, 0xf5,
    0xea, 0xad, 0x74, 0x7, 0x5d, 0x1, 0xd7, 0x40,
    0x75, 0xd0, 0x1d,
    /* U+0042 "B" */
    0x7f, 0xf0, 0xa, 0xaf, 0x2, 0x82, 0xc0, 0xe0,
    0xb0, 0x38, 0x28, 0xe, 0xbf, 0x83, 0x80, 0x78,
    0xe0, 0xe, 0x38, 0x3, 0x8e, 0x0, 0xe3, 0xea,
    0xb4, 0xff, 0xf8,
    /* U+0043 "C" */
    0x1f, 0xfc, 0x1e, 0xab, 0xc7, 0x40, 0xb1, 0xd0,
    0x24, 0x74, 0x0, 0x1d, 0x0, 0x7, 0x40, 0x1,
    0xd0, 0x0, 0x74, 0x3, 0x1d, 0x2, 0xc7, 0xaa,
    0xf0, 0x7f, 0xf0,
    /* U+0044 "D" */
    0x7f, 0xfe, 0xa, 0xaa, 0xd2, 0x80, 0x38, 0xe0,
    0xe, 0x38, 0x3, 0x8e, 0x0, 0xe3, 0x80, 0x38,
    0xe0, 0xe, 0x38, 0x3, 0x8e, 0x0, 0xe3, 0x8a,
    0xb4, 0xef, 0xf8,
    /* U+0045 "E" */
    0x7f, 0xfc, 0xaa, 0xa2, 0x80, 0xe, 0x0, 0x38,
    0x0, 0xeb, 0xf3, 0x95, 0x4e, 0x0, 0x38, 0x0,
    0xe0, 0x3, 0xea, 0x8f, 0xff,
    /* U+0046 "F" */
    0x7f, 0xfc, 0xaa, 0xa2, 0x80, 0xe, 0x0, 0x38,
    0x0, 0xe0, 0x3, 0xaf, 0xce, 0xaa, 0x38, 0x0,
    0xe0, 0x3, 0x80, 0xe, 0x0,
    /* U+0047 "G" */
    0x1f, 0xfe, 0x1e, 0xaa, 0x97, 0x40, 0x1, 0xd0,
    0x0, 0x74, 0x0, 0x1d, 0x1f, 0xd7, 0x45, 0xb5,
    0xd0, 0x1d, 0x74, 0x7, 0x5d, 0x1, 0xd7, 0xaa,
    0xb4, 0x7f, 0x9d,
    /* U+0048 "H" */
    0x38, 0x3, 0x8e, 0x0, 0xe3, 0x80, 0x38, 0xe0,
    0xe, 0x38, 0x7, 0x8e, 0xbf, 0xe3, 0x95, 0x78,
    0xe0, 0xe, 0x38, 0x3, 0x8e, 0x0, 0xe3, 0x80,
    0x38, 0xe0, 0xe,
    /* U+0049 "I" */
    0x38, 0xe3, 0x8e, 0x38, 0xe3, 0x8e, 0x38, 0xe3,
    0x8e,
    /* U+004A "J" */
    0x3f, 0xfe, 0x1a, 0xae, 0x0, 0xe, 0x0, 0xe,
    0x0, 0xe, 0x0, 0xe, 0x0, 0xe, 0x0, 0xe,
    0x28, 0xe, 0x38, 0xe, 0x3e, 0xad, 0xf, 0xf8,
    /* U+004B "K" */
    0x38, 0x7, 0x4e, 0x1, 0xd3, 0x80, 0xf0, 0xe0,
    0xf0, 0x38, 0xf0, 0xe, 0xff, 0x83, 0x95, 0x74,
    0xe0, 0xe, 0x38, 0x3, 0x8e, 0x0, 0xe3, 0x80,
    0x38, 0xe0, 0xe,
    /* U+004C "L" */
    0x38, 0x0, 0xe, 0x0, 0x3, 0x80, 0x0, 0xe0,
    0x0, 0x38, 0x0, 0xe, 0x0, 0x3, 0x80, 0x0,
    0xe0, 0x0, 0x38, 0x3, 0x4e, 0x1, 0xd3, 0xea,
    0xb4, 0xff, 0xfd,
    /* U+004D "M" */
    0x3f, 0x1, 0xfc, 0xee, 0xf, 0xb3, 0x6c, 0x76,
    0xce, 0x3b, 0xcf, 0x38, 0xbd, 0x3c, 0xe0, 0xf0,
    0xf3, 0x80, 0x3, 0xce, 0x0, 0xf, 0x38, 0x0,
    0x3c, 0xe0, 0x0, 0xf3, 0x80, 0x3, 0xce, 0x0,
    0xf,
    /* U+004E "N" */
    0x3f, 0x41, 0xd3, 0xb8, 0x1d, 0x36, 0xc1, 0xd3,
    0x9c, 0x1d, 0x38, 0xe1, 0xd3, 0x8f, 0x1d, 0x38,
    0xb1, 0xd3, 0x87, 0x5d, 0x38, 0x39, 0xd3, 0x82,
    0xcd, 0x38, 0x1e, 0x93, 0x80, 0xfd,
    /* U+004F "O" */
    0x1f, 0xfd, 0x1e, 0xaa, 0xc7, 0x40, 0x75, 0xd0,
    0x1d, 0x74, 0x7, 0x5d, 0x1, 0xd7, 0x40, 0x75,
    0xd0, 0x1d, 0x74, 0x7, 0x5d, 0x1, 0xd7, 0xaa,
    0xb0, 0x7f, 0xf4,
    /* U+0050 "P" */
    0x7f, 0xfe, 0xa, 0xaa, 0xd2, 0x80, 0x38, 0xe0,
    0xe, 0x38, 0x3, 0x8e, 0x0, 0xe3, 0xaf, 0xf0,
    0xea, 0xa0, 0x38, 0x0, 0xe, 0x0, 0x3, 0x80,
    0x0, 0xe0, 0x0,
    /* U+0051 "Q" */
    0x1f, 0xfd, 0x1e, 0xaa, 0xc7, 0x40, 0x75, 0xd0,
    0x1d, 0x74, 0x7, 0x5d, 0x1, 0xd7, 0x40, 0x75,
    0xd0, 0x1d, 0x74, 0x7, 0x5d, 0x11, 0xd7, 0xae,
    0xb0, 0x7f, 0xf4, 0x1, 0xc0, 0x0, 0x70, 0x0,
    0x4, 0x0, 0x0, 0x0,
    /* U+0052 "R" */
    0x7f, 0xfe, 0xa, 0xaa, 0xd2, 0x80, 0x38, 0xe0,
    0xe, 0x38, 0x3, 0x8e, 0x1, 0xe3, 0x8f, 0xe0,
    0xe7, 0xc0, 0x38, 0x78, 0xe, 0x7, 0x83, 0x80,
    0x74, 0xe0, 0xe,
    /* U+0053 "S" */
    0x2f, 0xfc, 0x2e, 0xaa, 0x4f, 0x0, 0x3, 0xc0,
    0x0, 0xf0, 0x0, 0xf, 0xfe, 0x0, 0x55, 0xe0,
    0x0, 0x38, 0x20, 0xe, 0x2c, 0x3, 0x8b, 0xaa,
    0xe0, 0xbf, 0xe0,
    /* U+0054 "T" */
    0xff, 0xfd, 0xab, 0xe8, 0x3, 0x80, 0x3, 0x80,
    0x3, 0x80, 0x3, 0x80, 0x3, 0x80, 0x3, 0x80,
    0x3, 0x80, 0x3, 0x80, 0x3, 0x80, 0x3, 0x80,
    /* U+0055 "U" */
    0x74, 0x7, 0x5d, 0x1, 0xd7, 0x40, 0x75, 0xd0,
    0x1d, 0x74, 0x7, 0x5d, 0x1, 0xd7, 0x40, 0x75,
    0xd0, 0x1d, 0x74, 0x7, 0x5d, 0x1, 0xd3, 0xaa,
    0xb4, 0x7f, 0xdd,
    /* U+0056 "V" */
    0xf0, 0xf, 0xf0, 0xf, 0xf0, 0xf, 0xf0, 0xf,
    0xf0, 0xf, 0xf0, 0xf, 0xf0, 0xf, 0xf0, 0xf,
    0xb4, 0xe, 0x3c, 0x3c, 0xf, 0xb0, 0x7, 0xd0,
    /* U+0057 "W" */
    0xb0, 0xe, 0x2, 0xcb, 0x0, 0xe0, 0x2c, 0xb0,
    0xe, 0x2, 0xcb, 0x0, 0xe0, 0x2c, 0xb0, 0xe,
    0x2, 0xcb, 0x0, 0xe0, 0x2c, 0xb0, 0xe, 0x2,
    0xcb, 0x0, 0xe0, 0x2c, 0xb0, 0xe, 0x2, 0xcb,
    0x82, 0xf4, 0x3c, 0x2e, 0xb6, 0xef, 0x0, 0xbd,
    0xb, 0xc0,
    /* U+0058 "X" */
    0xf0, 0xf, 0xf0, 0xe, 0x78, 0x3c, 0x1d, 0xb4,
    0xb, 0xe0, 0xb, 0xe0, 0x1e, 0xf0, 0x3c, 0x3c,
    0xf0, 0x1e, 0xf0, 0xf, 0xf0, 0xf, 0xf0, 0xf,
    /* U+0059 "Y" */
    0xf0, 0xf, 0xf0, 0xf, 0xf0, 0xf, 0xf0, 0xf,
    0xf0, 0xf, 0xf0, 0xf, 0x7f, 0xfd, 0x1b, 0xe4,
    0x3, 0xc0, 0x3, 0xc0, 0x3, 0xc0, 0x3, 0xc0,
    /* U+005A "Z" */
    0xff, 0xfc, 0xaa, 0xbc, 0x0, 0x2c, 0x0, 0x3c,
    0x0, 0xf4, 0x3, 0xd0, 0xf, 0x40, 0x7d, 0x0,
    0xf0, 0x0, 0xf0, 0x0, 0xfa, 0xa8, 0xff, 0xfc,
    /* U+005B "[" */
    0xfd, 0xf8, 0xf0, 0xf0, 0xf0, 0xf0, 0xf0, 0xf0,
    0xf0, 0xf0, 0xf0, 0xf0, 0xf0, 0xf8, 0xfd,
    /* U+005C "\\" */
    0x34, 0x0, 0xf, 0x0, 0x1, 0xc0, 0x0, 0x38,
    0x0, 0xb, 0x0, 0x0, 0xd0, 0x0, 0x3c, 0x0,
    0x7, 0x0, 0x0, 0xe0, 0x0, 0x2c, 0x0, 0x3,
    0x40, 0x0, 0xb0, 0x0, 0x1d, 0x0, 0x3, 0x80,
    0x0, 0xb0,
    /* U+005D "]" */
    0xfc, 0x7c, 0x2c, 0x2c, 0x2c, 0x2c, 0x2c, 0x2c,
    0x2c, 0x2c, 0x2c, 0x2c, 0x2c, 0x7c, 0xfc,
    /* U+005E "^" */
    0x0, 0x0, 0x0, 0x5, 0x0, 0x1, 0xf4, 0x0,
    0x3a, 0xc0, 0xf, 0xf, 0x2, 0xc0, 0x3c, 0x34,
    0x0, 0xd0, 0x0, 0x0,
    /* U+005F "_" */
    0x0, 0x0, 0x3, 0xff, 0xff, 0x15, 0x55, 0x50,
    /* U+0061 "a" */
    0x1f, 0xf8, 0x1a, 0xad, 0x0, 0x1e, 0xf, 0xde,
    0x3d, 0xe, 0x3c, 0xe, 0x3c, 0xe, 0x3e, 0xae,
    0xf, 0xde,
    /* U+0062 "b" */
    0x4, 0x0, 0x34, 0x0, 0x74, 0x0, 0x74, 0x0,
    0x74, 0x0, 0x7b, 0xf0, 0x7a, 0xbc, 0x74, 0x2c,
    0x74, 0x2c, 0x74, 0x2c, 0x74, 0x2c, 0x74, 0x2c,
    0x7a, 0xbc, 0x5b, 0xf0, 0x0, 0x0,
    /* U+0063 "c" */
    0x2f, 0xd1, 0xea, 0xcb, 0x5, 0x2c, 0x0, 0xb0,
    0x2, 0xc0, 0xb, 0x0, 0x1e, 0xa8, 0x2f, 0xf0,
    /* U+0064 "d" */
    0x0, 0x4, 0x0, 0x70, 0x3, 0xc0, 0xf, 0x0,
    0x3c, 0xbe, 0xf7, 0x93, 0xec, 0xf, 0xb0, 0x3e,
    0xc0, 0xfb, 0x3, 0xec, 0xf, 0x7a, 0x7c, 0xbd,
    0xf0,
    /* U+0065 "e" */
    0x2f, 0xe1, 0xea, 0xeb, 0x3, 0xec, 0xf, 0xb0,
    0x3e, 0xcb, 0xcb, 0x54, 0x1e, 0xa9, 0x2f, 0xfc,
    /* U+0066 "f" */
    0x1f, 0xc0, 0xea, 0x47, 0x40, 0x1d, 0x0, 0x74,
    0x1, 0xef, 0x7, 0xa0, 0x1d, 0x0, 0x74, 0x1,
    0xd0, 0x7, 0x40, 0x1d, 0x0, 0x74, 0x1, 0xd0,
    0x0,
    /* U+0067 "g" */
    0xf, 0xfe, 0xb, 0xa9, 0x3, 0xc0, 0x0, 0xf0,
    0x38, 0x3c, 0xe, 0xf, 0x3, 0x83, 0xc0, 0xe0,
    0xba, 0xb8, 0xf, 0x8e, 0x0, 0x3, 0x80, 0x0,
    0xe0, 0x15, 0xb4, 0x2f, 0xf8, 0x0,
    /* U+0068 "h" */
    0x4, 0x0, 0x34, 0x0, 0x74, 0x0, 0x74, 0x0,
    0x74, 0x0, 0x76, 0xf0, 0x7a, 0xbc, 0x74, 0x2c,
    0x74, 0x2c, 0x74, 0x2c, 0x74, 0x2c, 0x74, 0x2c,
    0x74, 0x2c, 0x74, 0x2c,
    /* U+0069 "i" */
    0x75, 0x80, 0x5, 0x75, 0xd7, 0x5d, 0x75, 0xd7,
    0x5d,
    /* U+006A "j" */
    0xb, 0x1, 0x80, 0x0, 0x8, 0x7, 0x2, 0xc0,
    0xb0, 0x2c, 0xb, 0x2, 0xc0, 0xb0, 0x2c, 0xb,
    0x2, 0xc0, 0xf1, 0xf0,
    /* U+006B "k" */
    0x4, 0x0, 0xd0, 0x7, 0x40, 0x1d, 0x0, 0x74,
    0x1, 0xd0, 0x37, 0x47, 0x9d, 0x78, 0x7b, 0xf1,
    0xd0, 0xf7, 0x43, 0xdd, 0xf, 0x74, 0x3d, 0xd0,
    0xf0,
    /* U+006C "l" */
    0x4, 0x34, 0x74, 0x74, 0x74, 0x74, 0x74, 0x74,
    0x74, 0x74, 0x74, 0x74, 0x79, 0x1f,
    /* U+006D "m" */
    0x77, 0xf3, 0xf0, 0x7a, 0xbe, 0xbc, 0x74, 0x3c,
    0x2c, 0x74, 0x3c, 0x2c, 0x74, 0x3c, 0x2c, 0x74,
    0x3c, 0x2c, 0x74, 0x3c, 0x2c, 0x74, 0x3c, 0x2c,
    0x74, 0x3c, 0x2c,
    /* U+006E "n" */
    0x77, 0xf1, 0xea, 0xf7, 0x43, 0xdd, 0xf, 0x74,
    0x3d, 0xd0, 0xf7, 0x43, 0xdd, 0xf, 0x74, 0x3c,
    /* U+006F "o" */
    0x2f, 0xe1, 0xea, 0xeb, 0x3, 0xec, 0xf, 0xb0,
    0x3e, 0xc0, 0xfb, 0x3, 0xde, 0xae, 0x2f, 0xe0,
    /* U+0070 "p" */
    0x77, 0xf0, 0x7a, 0xbc, 0x74, 0x2c, 0x74, 0x2c,
    0x74, 0x2c, 0x74, 0x2c, 0x74, 0x2c, 0x75, 0xbc,
    0x7b, 0xf0, 0x74, 0x0, 0x74, 0x0, 0x74, 0x0,
    0x74, 0x0,
    /* U+0071 "q" */
    0x2f, 0xbd, 0xe4, 0xfb, 0x3, 0xec, 0xf, 0xb0,
    0x3e, 0xc0, 0xfb, 0x3, 0xde, 0x9f, 0x2f, 0x7c,
    0x0, 0xf0, 0x3, 0xc0, 0xf, 0x0, 0x34, 0x0,
    0x40,
    /* U+0072 "r" */
    0x77, 0xe1, 0xea, 0xe7, 0x43, 0xdd, 0xd, 0x74,
    0x11, 0xd0, 0x7, 0x40, 0x1d, 0x0, 0x74, 0x0,
    /* U+0073 "s" */
    0x1f, 0xe1, 0xea, 0x97, 0x40, 0xf, 0xf4, 0xa,
    0xb4, 0x1, 0xd0, 0x7, 0x4a, 0xad, 0x7f, 0xd0,
    /* U+0074 "t" */
    0x0, 0x40, 0x3, 0x40, 0x7, 0x40, 0x2f, 0xf8,
    0x2b, 0x90, 0x7, 0x40, 0x7, 0x40, 0x7, 0x40,
    0x7, 0x40, 0x7, 0x40, 0x3, 0xa4, 0x1, 0xf8,
    /* U+0075 "u" */
    0xb0, 0x3e, 0xc0, 0xfb, 0x3, 0xec, 0xf, 0xb0,
    0x3e, 0xc0, 0xfb, 0x3, 0xde, 0x9f, 0x2f, 0x7c,
    /* U+0076 "v" */
    0x0, 0x3, 0x0, 0x6f, 0x3, 0xbc, 0xe, 0xf0,
    0x3b, 0xc0, 0xef, 0x3, 0xbc, 0x1d, 0x3e, 0xe0,
    0x3e, 0x0,
    /* U+0077 "w" */
    0x0, 0x0, 0x3, 0x0, 0x90, 0x2f, 0x7, 0x43,
    0xfc, 0x1d, 0xf, 0xf0, 0x74, 0x3f, 0xc1, 0xd0,
    0xff, 0x7, 0x43, 0xfc, 0x2d, 0xe, 0x3e, 0xfd,
    0xf0, 0x3d, 0x2f, 0x0,
    /* U+0078 "x" */
    0x0, 0x0, 0x30, 0xc, 0x3c, 0x3c, 0x1f, 0xf4,
    0x7, 0xd0, 0xb, 0xe0, 0x2c, 0x38, 0x38, 0x2c,
    0x38, 0x2c, 0x38, 0x2c,
    /* U+0079 "y" */
    0xb0, 0x3e, 0xc0, 0xfb, 0x3, 0xec, 0xf, 0xb0,
    0x3e, 0xc0, 0xfb, 0x3, 0xde, 0xaf, 0x2f, 0x7c,
    0x0, 0xf0, 0x3, 0xc1, 0x5f, 0x7f, 0xf0,
    /* U+007A "z" */
    0x3f, 0xf4, 0xaa, 0xd0, 0x7, 0x40, 0x78, 0xb,
    0x80, 0xb8, 0x3, 0x80, 0xe, 0xa8, 0x3f, 0xf4,
    /* U+007B "{" */
    0x3, 0xc0, 0xf8, 0xf, 0x0, 0xf0, 0xf, 0x0,
    0xf0, 0x2d, 0x7, 0xc0, 0xe, 0x0, 0xf0, 0xf,
    0x0, 0xf0, 0xf, 0x0, 0xf8, 0x3, 0xc0,
    /* U+007C "|" */
    0x75, 0xd7, 0x5d, 0x75, 0xd7, 0x5d, 0x75, 0xd7,
    0x5d, 0x75, 0xd7, 0x40,
    /* U+007D "}" */
    0xf0, 0x1f, 0x2, 0xc0, 0xb0, 0x2c, 0xb, 0x0,
    0xe4, 0x2e, 0x1c, 0xb, 0x2, 0xc0, 0xb0, 0x2c,
    0x1f, 0xf, 0x0,
    /* U+007E "~" */
    0x0, 0x0, 0x2f, 0x4e, 0x77, 0xee, 0x70, 0xf8,
    /* U+00C0 "À" */
    0x5, 0x0, 0x0, 0xf0, 0x0, 0x5, 0x0, 0x0,
    0x0, 0x1f, 0xff, 0x4e, 0xaa, 0x97, 0x40, 0x35,
    0xd0, 0x1d, 0x74, 0x7, 0x5d, 0x1, 0xd7, 0x6f,
    0xf5, 0xea, 0xad, 0x74, 0x7, 0x5d, 0x1, 0xd7,
    0x40, 0x75, 0xd0, 0x1d,
    /* U+00C2 "Â" */
    0x0, 0x0, 0x0, 0x34, 0x0, 0x7b, 0x40, 0x14,
    0x50, 0x0, 0x0, 0x7, 0xff, 0xd3, 0xaa, 0xa5,
    0xd0, 0xd, 0x74, 0x7, 0x5d, 0x1, 0xd7, 0x40,
    0x75, 0xdb, 0xfd, 0x7a, 0xab, 0x5d, 0x1, 0xd7,
    0x40, 0x75, 0xd0, 0x1d, 0x74, 0x7, 0x40,
    /* U+00C4 "Ä" */
    0xb, 0x2c, 0x2, 0xc7, 0x0, 0x0, 0x0, 0x7f,
    0xfd, 0x3a, 0xaa, 0x5d, 0x0, 0xd7, 0x40, 0x75,
    0xd0, 0x1d, 0x74, 0x7, 0x5d, 0xbf, 0xd7, 0xaa,
    0xb5, 0xd0, 0x1d, 0x74, 0x7, 0x5d, 0x1, 0xd7,
    0x40, 0x74,
    /* U+00C6 "Æ" */
    0x1f, 0xff, 0xff, 0xe, 0xaa, 0xea, 0x87, 0x40,
    0xb0, 0x1, 0xd0, 0x3c, 0x0, 0x74, 0xf, 0x0,
    0x1d, 0x3, 0xef, 0xc7, 0x6f, 0xf0, 0x1, 0xea,
    0xbc, 0x0, 0x74, 0xf, 0x0, 0x1d, 0x3, 0xc0,
    0x7, 0x40, 0xfa, 0xa1, 0xd0, 0x3f, 0xfc,
    /* U+00C7 "Ç" */
    0x1f, 0xfc, 0x1e, 0xab, 0xc7, 0x40, 0xb1, 0xd0,
    0x24, 0x74, 0x0, 0x1d, 0x0, 0x7, 0x40, 0x1,
    0xd0, 0x0, 0x74, 0x3, 0x1d, 0x2, 0xc7, 0xaa,
    0xf0, 0x7f, 0xf0, 0x1, 0x80, 0x0, 0xfc, 0x0,
    0x57, 0xc0, 0x2f, 0xc0,
    /* U+00C8 "È" */
    0x18, 0x0, 0x3c, 0x0, 0x14, 0x0, 0x0, 0x7f,
    0xfc, 0xaa, 0xa2, 0x80, 0xe, 0x0, 0x38, 0x0,
    0xeb, 0xf3, 0x95, 0x4e, 0x0, 0x38, 0x0, 0xe0,
    0x3, 0xea, 0x8f, 0xff,
    /* U+00C9 "É" */
    0x0, 0x64, 0x7, 0x80, 0x24, 0x0, 0x0, 0x7f,
    0xfc, 0xaa, 0xa2, 0x80, 0xe, 0x0, 0x38, 0x0,
    0xeb, 0xf3, 0x95, 0x4e, 0x0, 0x38, 0x0, 0xe0,
    0x3, 0xea, 0x8f, 0xff,
    /* U+00CA "Ê" */
    0x0, 0x0, 0xe, 0x0, 0xee, 0x5, 0x8, 0x0,
    0x1, 0xff, 0xf2, 0xaa, 0x8a, 0x0, 0x38, 0x0,
    0xe0, 0x3, 0xaf, 0xce, 0x55, 0x38, 0x0, 0xe0,
    0x3, 0x80, 0xf, 0xaa, 0x3f, 0xfc,
    /* U+00CB "Ë" */
    0x2c, 0xb0, 0xb1, 0xc0, 0x0, 0x1f, 0xff, 0x2a,
    0xa8, 0xa0, 0x3, 0x80, 0xe, 0x0, 0x3a, 0xfc,
    0xe5, 0x53, 0x80, 0xe, 0x0, 0x38, 0x0, 0xfa,
    0xa3, 0xff, 0xc0,
    /* U+00CE "Î" */
    0x0, 0x0, 0xd, 0x0, 0xed, 0x5, 0x14, 0x0,
    0x0, 0xe, 0x0, 0x38, 0x0, 0xe0, 0x3, 0x80,
    0xe, 0x0, 0x38, 0x0, 0xe0, 0x3, 0x80, 0xe,
    0x0, 0x38, 0x0, 0xe0, 0x3, 0x80,
    /* U+00CF "Ï" */
    0xb2, 0xcb, 0x1c, 0x0, 0x0, 0xe0, 0xe, 0x0,
    0xe0, 0xe, 0x0, 0xe0, 0xe, 0x0, 0xe0, 0xe,
    0x0, 0xe0, 0xe, 0x0, 0xe0, 0xe, 0x0,
    /* U+00D4 "Ô" */
    0x0, 0x0, 0x0, 0x70, 0x0, 0x7b, 0x0, 0x10,
    0x50, 0x0, 0x0, 0x7, 0xff, 0x47, 0xaa, 0xb1,
    0xd0, 0x1d, 0x74, 0x7, 0x5d, 0x1, 0xd7, 0x40,
    0x75, 0xd0, 0x1d, 0x74, 0x7, 0x5d, 0x1, 0xd7,
    0x40, 0x75, 0xea, 0xac, 0x1f, 0xfd, 0x0,
    /* U+00D6 "Ö" */
    0xe, 0x3c, 0x3, 0x8b, 0x0, 0x0, 0x0, 0x7f,
    0xf4, 0x7a, 0xab, 0x1d, 0x1, 0xd7, 0x40, 0x75,
    0xd0, 0x1d, 0x74, 0x7, 0x5d, 0x1, 0xd7, 0x40,
    0x75, 0xd0, 0x1d, 0x74, 0x7, 0x5e, 0xaa, 0xc1,
    0xff, 0xd0,
    /* U+00DB "Û" */
    0x0, 0x0, 0x0, 0x34, 0x0, 0x7b, 0x40, 0x14,
    0x50, 0x0, 0x0, 0x1d, 0x1, 0xd7, 0x40, 0x75,
    0xd0, 0x1d, 0x74, 0x7, 0x5d, 0x1, 0xd7, 0x40,
    0x75, 0xd0, 0x1d, 0x74, 0x7, 0x5d, 0x1, 0xd7,
    0x40, 0x74, 0xea, 0xad, 0x1f, 0xf7, 0x40,
    /* U+00DC "Ü" */
    0xf, 0x2c, 0x3, 0xcb, 0x0, 0x0, 0x1, 0xd0,
    0x1d, 0x74, 0x7, 0x5d, 0x1, 0xd7, 0x40, 0x75,
    0xd0, 0x1d, 0x74, 0x7, 0x5d, 0x1, 0xd7, 0x40,
    0x75, 0xd0, 0x1d, 0x74, 0x7, 0x4e, 0xaa, 0xd1,
    0xff, 0x74,
    /* U+00E0 "à" */
    0x2e, 0x0, 0xb, 0x40, 0x3, 0xc0, 0x0, 0x40,
    0x0, 0x0, 0x1f, 0xf8, 0x1a, 0xad, 0x0, 0x1e,
    0xf, 0xde, 0x3d, 0xe, 0x3c, 0xe, 0x3c, 0xe,
    0x3e, 0xae, 0xf, 0xde,
    /* U+00E2 "â" */
    0x0, 0x40, 0x2, 0xe0, 0xa, 0x38, 0x4, 0x8,
    0x0, 0x0, 0x1f, 0xf8, 0x1a, 0xad, 0x0, 0x1e,
    0xf, 0xde, 0x3d, 0xe, 0x3c, 0xe, 0x3c, 0xe,
    0x3e, 0xae, 0xf, 0xde,
    /* U+00E4 "ä" */
    0xf, 0x2c, 0xe, 0x2c, 0x0, 0x0, 0x1f, 0xf8,
    0x1a, 0xad, 0x0, 0x1e, 0xf, 0xde, 0x3d, 0xe,
    0x3c, 0xe, 0x3c, 0xe, 0x3e, 0xae, 0xf, 0xde,
    /* U+00E6 "æ" */
    0x1f, 0xf7, 0xf4, 0x1a, 0xbe, 0xad, 0x0, 0x2c,
    0xe, 0xf, 0xac, 0xe, 0x3d, 0x2c, 0x1e, 0x38,
    0x2c, 0xbc, 0x38, 0x2d, 0x50, 0x3e, 0xbe, 0xa8,
    0xf, 0xcb, 0xfc,
    /* U+00E7 "ç" */
    0x2f, 0xd1, 0xea, 0xcb, 0x5, 0x2c, 0x0, 0xb0,
    0x2, 0xc0, 0xb, 0x0, 0x1e, 0xa8, 0x2f, 0xf0,
    0x8, 0x0, 0xbd, 0x5, 0x7c, 0x1f, 0xd0,
    /* U+00E8 "è" */
    0x3c, 0x0, 0x78, 0x0, 0x78, 0x0, 0x50, 0x0,
    0x0, 0xbf, 0x87, 0xab, 0xac, 0xf, 0xb0, 0x3e,
    0xc0, 0xfb, 0x2f, 0x2d, 0x50, 0x7a, 0xa4, 0xbf,
    0xf0,
    /* U+00E9 "é" */
    0x0, 0xb8, 0x1, 0xe0, 0x3, 0x80, 0x5, 0x0,
    0x0, 0x0, 0x2f, 0xe0, 0x7a, 0xb8, 0xb0, 0x3c,
    0xb0, 0x3c, 0xb0, 0x3c, 0xb2, 0xf0, 0xb5, 0x40,
    0x7a, 0xa4, 0x2f, 0xfc,
    /* U+00EA "ê" */
    0x1, 0x0, 0x1f, 0x1, 0xcb, 0x4, 0x5, 0x0,
    0x0, 0xbf, 0x87, 0xab, 0xac, 0xf, 0xb0, 0x3e,
    0xc0, 0xfb, 0x2f, 0x2d, 0x50, 0x7a, 0xa4, 0xbf,
    0xf0,
    /* U+00EB "ë" */
    0x3c, 0xb0, 0xb2, 0xc0, 0x0, 0xb, 0xf8, 0x7a,
    0xba, 0xc0, 0xfb, 0x3, 0xec, 0xf, 0xb2, 0xf2,
    0xd5, 0x7, 0xaa, 0x4b, 0xff,
    /* U+00EE "î" */
    0x1, 0x0, 0x3d, 0x3, 0x5d, 0x14, 0x14, 0x0,
    0x0, 0x18, 0x0, 0xe0, 0x3, 0x80, 0xe, 0x0,
    0x38, 0x0, 0xe0, 0x3, 0x80, 0xe, 0x0, 0x38,
    0x0,
    /* U+00EF "ï" */
    0xb1, 0xdb, 0x1d, 0x0, 0x0, 0x20, 0xe, 0x0,
    0xe0, 0xe, 0x0, 0xe0, 0xe, 0x0, 0xe0, 0xe,
    0x0, 0xe0,
    /* U+00F4 "ô" */
    0x1, 0x0, 0x2e, 0x2, 0xce, 0x8, 0x8, 0x0,
    0x0, 0xbf, 0x87, 0xab, 0xac, 0xf, 0xb0, 0x3e,
    0xc0, 0xfb, 0x3, 0xec, 0xf, 0x7a, 0xb8, 0xbf,
    0x80,
    /* U+00F6 "ö" */
    0x3c, 0xb0, 0xe2, 0xc0, 0x0, 0xb, 0xf8, 0x7a,
    0xba, 0xc0, 0xfb, 0x3, 0xec, 0xf, 0xb0, 0x3e,
    0xc0, 0xf7, 0xab, 0x8b, 0xf8,
    /* U+00FB "û" */
    0x1, 0x0, 0x2f, 0x2, 0xcf, 0x4, 0x5, 0x0,
    0x2, 0xc0, 0xfb, 0x3, 0xec, 0xf, 0xb0, 0x3e,
    0xc0, 0xfb, 0x3, 0xec, 0xf, 0x7a, 0x7c, 0xbd,
    0xf0,
    /* U+00FC "ü" */
    0x38, 0xf0, 0xe2, 0xc0, 0x0, 0x2c, 0xf, 0xb0,
    0x3e, 0xc0, 0xfb, 0x3, 0xec, 0xf, 0xb0, 0x3e,
    0xc0, 0xf7, 0xa7, 0xcb, 0xdf,
    /* U+00FF "ÿ" */
    0x38, 0xb0, 0xf2, 0xc0, 0x0, 0x0, 0x0, 0xb0,
    0x3e, 0xc0, 0xfb, 0x3, 0xec, 0xf, 0xb0, 0x3e,
    0xc0, 0xfb, 0x3, 0xde, 0xaf, 0x2f, 0x7c, 0x0,
    0xf0, 0x3, 0xc1, 0x5f, 0x7f, 0xf0,
    /* U+0152 "Œ" */
    0x1f, 0xfa, 0xff, 0x1e, 0xab, 0xea, 0x87, 0x40,
    0xf0, 0x1, 0xd0, 0x3c, 0x0, 0x74, 0xf, 0x0,
    0x1d, 0x3, 0xdf, 0xc7, 0x40, 0xf5, 0x51, 0xd0,
    0x3c, 0x0, 0x74, 0xf, 0x0, 0x1d, 0x3, 0xc0,
    0x7, 0xaa, 0xfa, 0xa0, 0x7f, 0xeb, 0xfc,
    /* U+0153 "œ" */
    0x2f, 0xef, 0xf0, 0x7a, 0xbe, 0xbc, 0xb0, 0x38,
    0x2c, 0xb0, 0x38, 0x2c, 0xb0, 0x38, 0x3c, 0xb0,
    0x39, 0xf4, 0xb0, 0x39, 0x40, 0x7a, 0xbe, 0xa4,
    0x2f, 0xdf, 0xfc
};
/*---------------------
 *  GLYPH DESCRIPTION
 *--------------------*/
static const lv_font_fmt_txt_glyph_dsc_t glyph_dsc[] = {
    {.bitmap_index = 0, .adv_w = 0, .box_w = 0, .box_h = 0, .ofs_x = 0, .ofs_y = 0} /* id = 0 reserved */,
    {.bitmap_index = 0, .adv_w = 50, .box_w = 0, .box_h = 0, .ofs_x = 0, .ofs_y = 0},
    {.bitmap_index = 0, .adv_w = 89, .box_w = 3, .box_h = 12, .ofs_x = 1, .ofs_y = 0},
    {.bitmap_index = 9, .adv_w = 135, .box_w = 6, .box_h = 6, .ofs_x = 1, .ofs_y = 8},
    {.bitmap_index = 18, .adv_w = 185, .box_w = 12, .box_h = 10, .ofs_x = 0, .ofs_y = 1},
    {.bitmap_index = 48, .adv_w = 174, .box_w = 9, .box_h = 16, .ofs_x = 1, .ofs_y = -2},
    {.bitmap_index = 84, .adv_w = 249, .box_w = 14, .box_h = 14, .ofs_x = 1, .ofs_y = 0},
    {.bitmap_index = 133, .adv_w = 170, .box_w = 10, .box_h = 12, .ofs_x = 1, .ofs_y = 0},
    {.bitmap_index = 163, .adv_w = 82, .box_w = 3, .box_h = 6, .ofs_x = 1, .ofs_y = 8},
    {.bitmap_index = 168, .adv_w = 100, .box_w = 4, .box_h = 15, .ofs_x = 2, .ofs_y = -1},
    {.bitmap_index = 183, .adv_w = 100, .box_w = 4, .box_h = 15, .ofs_x = 1, .ofs_y = -1},
    {.bitmap_index = 198, .adv_w = 179, .box_w = 9, .box_h = 9, .ofs_x = 1, .ofs_y = 6},
    {.bitmap_index = 219, .adv_w = 142, .box_w = 9, .box_h = 8, .ofs_x = 0, .ofs_y = 1},
    {.bitmap_index = 237, .adv_w = 92, .box_w = 4, .box_h = 6, .ofs_x = 1, .ofs_y = -4},
    {.bitmap_index = 243, .adv_w = 96, .box_w = 6, .box_h = 2, .ofs_x = 0, .ofs_y = 4},
    {.bitmap_index = 246, .adv_w = 89, .box_w = 3, .box_h = 2, .ofs_x = 1, .ofs_y = 0},
    {.bitmap_index = 248, .adv_w = 110, .box_w = 9, .box_h = 15, .ofs_x = -1, .ofs_y = -1},
    {.bitmap_index = 282, .adv_w = 142, .box_w = 7, .box_h = 12, .ofs_x = 1, .ofs_y = 0},
    {.bitmap_index = 303, .adv_w = 142, .box_w = 7, .box_h = 12, .ofs_x = 1, .ofs_y = 0},
    {.bitmap_index = 324, .adv_w = 142, .box_w = 7, .box_h = 12, .ofs_x = 1, .ofs_y = 0},
    {.bitmap_index = 345, .adv_w = 142, .box_w = 8, .box_h = 12, .ofs_x = 0, .ofs_y = 0},
    {.bitmap_index = 369, .adv_w = 142, .box_w = 7, .box_h = 12, .ofs_x = 1, .ofs_y = 0},
    {.bitmap_index = 390, .adv_w = 142, .box_w = 7, .box_h = 12, .ofs_x = 1, .ofs_y = 0},
    {.bitmap_index = 411, .adv_w = 142, .box_w = 7, .box_h = 12, .ofs_x = 1, .ofs_y = 0},
    {.bitmap_index = 432, .adv_w = 142, .box_w = 7, .box_h = 12, .ofs_x = 1, .ofs_y = 0},
    {.bitmap_index = 453, .adv_w = 142, .box_w = 7, .box_h = 12, .ofs_x = 1, .ofs_y = 0},
    {.bitmap_index = 474, .adv_w = 142, .box_w = 7, .box_h = 12, .ofs_x = 1, .ofs_y = 0},
    {.bitmap_index = 495, .adv_w = 82, .box_w = 3, .box_h = 8, .ofs_x = 1, .ofs_y = 0},
    {.bitmap_index = 501, .adv_w = 82, .box_w = 3, .box_h = 12, .ofs_x = 1, .ofs_y = -4},
    {.bitmap_index = 510, .adv_w = 142, .box_w = 7, .box_h = 9, .ofs_x = 1, .ofs_y = 1},
    {.bitmap_index = 526, .adv_w = 142, .box_w = 9, .box_h = 6, .ofs_x = 0, .ofs_y = 2},
    {.bitmap_index = 540, .adv_w = 142, .box_w = 7, .box_h = 9, .ofs_x = 1, .ofs_y = 1},
    {.bitmap_index = 556, .adv_w = 135, .box_w = 8, .box_h = 12, .ofs_x = 0, .ofs_y = 0},
    {.bitmap_index = 580, .adv_w = 267, .box_w = 14, .box_h = 18, .ofs_x = 1, .ofs_y = -4},
    {.bitmap_index = 643, .adv_w = 179, .box_w = 9, .box_h = 12, .ofs_x = 1, .ofs_y = 0},
    {.bitmap_index = 670, .adv_w = 173, .box_w = 9, .box_h = 12, .ofs_x = 1, .ofs_y = 0},
    {.bitmap_index = 697, .adv_w = 160, .box_w = 9, .box_h = 12, .ofs_x = 1, .ofs_y = 0},
    {.bitmap_index = 724, .adv_w = 178, .box_w = 9, .box_h = 12, .ofs_x = 1, .ofs_y = 0},
    {.bitmap_index = 751, .adv_w = 142, .box_w = 7, .box_h = 12, .ofs_x = 1, .ofs_y = 0},
    {.bitmap_index = 772, .adv_w = 137, .box_w = 7, .box_h = 12, .ofs_x = 1, .ofs_y = 0},
    {.bitmap_index = 793, .adv_w = 173, .box_w = 9, .box_h = 12, .ofs_x = 1, .ofs_y = 0},
    {.bitmap_index = 820, .adv_w = 181, .box_w = 9, .box_h = 12, .ofs_x = 1, .ofs_y = 0},
    {.bitmap_index = 847, .adv_w = 86, .box_w = 3, .box_h = 12, .ofs_x = 1, .ofs_y = 0},
    {.bitmap_index = 856, .adv_w = 147, .box_w = 8, .box_h = 12, .ofs_x = 0, .ofs_y = 0},
    {.bitmap_index = 880, .adv_w = 178, .box_w = 9, .box_h = 12, .ofs_x = 1, .ofs_y = 0},
    {.bitmap_index = 907, .adv_w = 158, .box_w = 9, .box_h = 12, .ofs_x = 1, .ofs_y = 0},
    {.bitmap_index = 934, .adv_w = 221, .box_w = 11, .box_h = 12, .ofs_x = 1, .ofs_y = 0},
    {.bitmap_index = 967, .adv_w = 196, .box_w = 10, .box_h = 12, .ofs_x = 1, .ofs_y = 0},
    {.bitmap_index = 997, .adv_w = 174, .box_w = 9, .box_h = 12, .ofs_x = 1, .ofs_y = 0},
    {.bitmap_index = 1024, .adv_w = 169, .box_w = 9, .box_h = 12, .ofs_x = 1, .ofs_y = 0},
    {.bitmap_index = 1051, .adv_w = 174, .box_w = 9, .box_h = 16, .ofs_x = 1, .ofs_y = -4},
    {.bitmap_index = 1087, .adv_w = 174, .box_w = 9, .box_h = 12, .ofs_x = 1, .ofs_y = 0},
    {.bitmap_index = 1114, .adv_w = 160, .box_w = 9, .box_h = 12, .ofs_x = 1, .ofs_y = 0},
    {.bitmap_index = 1141, .adv_w = 118, .box_w = 8, .box_h = 12, .ofs_x = 0, .ofs_y = 0},
    {.bitmap_index = 1165, .adv_w = 179, .box_w = 9, .box_h = 12, .ofs_x = 1, .ofs_y = 0},
    {.bitmap_index = 1192, .adv_w = 164, .box_w = 8, .box_h = 12, .ofs_x = 1, .ofs_y = 0},
    {.bitmap_index = 1216, .adv_w = 249, .box_w = 14, .box_h = 12, .ofs_x = 1, .ofs_y = 0},
    {.bitmap_index = 1258, .adv_w = 156, .box_w = 8, .box_h = 12, .ofs_x = 1, .ofs_y = 0},
    {.bitmap_index = 1282, .adv_w = 164, .box_w = 8, .box_h = 12, .ofs_x = 1, .ofs_y = 0},
    {.bitmap_index = 1306, .adv_w = 146, .box_w = 8, .box_h = 12, .ofs_x = 1, .ofs_y = 0},
    {.bitmap_index = 1330, .adv_w = 103, .box_w = 4, .box_h = 15, .ofs_x = 2, .ofs_y = -1},
    {.bitmap_index = 1345, .adv_w = 110, .box_w = 9, .box_h = 15, .ofs_x = -1, .ofs_y = -1},
    {.bitmap_index = 1379, .adv_w = 103, .box_w = 4, .box_h = 15, .ofs_x = 1, .ofs_y = -1},
    {.bitmap_index = 1394, .adv_w = 164, .box_w = 10, .box_h = 8, .ofs_x = 0, .ofs_y = 8},
    {.bitmap_index = 1414, .adv_w = 142, .box_w = 10, .box_h = 3, .ofs_x = -1, .ofs_y = -4},
    {.bitmap_index = 1422, .adv_w = 144, .box_w = 8, .box_h = 9, .ofs_x = 0, .ofs_y = 0},
    {.bitmap_index = 1440, .adv_w = 152, .box_w = 8, .box_h = 15, .ofs_x = 1, .ofs_y = -1},
    {.bitmap_index = 1470, .adv_w = 121, .box_w = 7, .box_h = 9, .ofs_x = 1, .ofs_y = 0},
    {.bitmap_index = 1486, .adv_w = 150, .box_w = 7, .box_h = 14, .ofs_x = 1, .ofs_y = 0},
    {.bitmap_index = 1511, .adv_w = 140, .box_w = 7, .box_h = 9, .ofs_x = 1, .ofs_y = 0},
    {.bitmap_index = 1527, .adv_w = 92, .box_w = 7, .box_h = 14, .ofs_x = 1, .ofs_y = 0},
    {.bitmap_index = 1552, .adv_w = 139, .box_w = 9, .box_h = 13, .ofs_x = 0, .ofs_y = -4},
    {.bitmap_index = 1582, .adv_w = 153, .box_w = 8, .box_h = 14, .ofs_x = 1, .ofs_y = 0},
    {.bitmap_index = 1610, .adv_w = 78, .box_w = 3, .box_h = 12, .ofs_x = 1, .ofs_y = 0},
    {.bitmap_index = 1619, .adv_w = 77, .box_w = 5, .box_h = 16, .ofs_x = -1, .ofs_y = -4},
    {.bitmap_index = 1639, .adv_w = 142, .box_w = 7, .box_h = 14, .ofs_x = 1, .ofs_y = 0},
    {.bitmap_index = 1664, .adv_w = 80, .box_w = 4, .box_h = 14, .ofs_x = 1, .ofs_y = 0},
    {.bitmap_index = 1678, .adv_w = 219, .box_w = 12, .box_h = 9, .ofs_x = 1, .ofs_y = 0},
    {.bitmap_index = 1705, .adv_w = 151, .box_w = 7, .box_h = 9, .ofs_x = 1, .ofs_y = 0},
    {.bitmap_index = 1721, .adv_w = 147, .box_w = 7, .box_h = 9, .ofs_x = 1, .ofs_y = 0},
    {.bitmap_index = 1737, .adv_w = 151, .box_w = 8, .box_h = 13, .ofs_x = 1, .ofs_y = -4},
    {.bitmap_index = 1763, .adv_w = 150, .box_w = 7, .box_h = 14, .ofs_x = 1, .ofs_y = -5},
    {.bitmap_index = 1788, .adv_w = 133, .box_w = 7, .box_h = 9, .ofs_x = 1, .ofs_y = 0},
    {.bitmap_index = 1804, .adv_w = 113, .box_w = 7, .box_h = 9, .ofs_x = 0, .ofs_y = 0},
    {.bitmap_index = 1820, .adv_w = 94, .box_w = 8, .box_h = 12, .ofs_x = -1, .ofs_y = 0},
    {.bitmap_index = 1844, .adv_w = 151, .box_w = 7, .box_h = 9, .ofs_x = 1, .ofs_y = 0},
    {.bitmap_index = 1860, .adv_w = 139, .box_w = 7, .box_h = 10, .ofs_x = 1, .ofs_y = 0},
    {.bitmap_index = 1878, .adv_w = 206, .box_w = 11, .box_h = 10, .ofs_x = 1, .ofs_y = 0},
    {.bitmap_index = 1906, .adv_w = 128, .box_w = 8, .box_h = 10, .ofs_x = 0, .ofs_y = 0},
    {.bitmap_index = 1926, .adv_w = 151, .box_w = 7, .box_h = 13, .ofs_x = 1, .ofs_y = -4},
    {.bitmap_index = 1949, .adv_w = 114, .box_w = 7, .box_h = 9, .ofs_x = 0, .ofs_y = 0},
    {.bitmap_index = 1965, .adv_w = 100, .box_w = 6, .box_h = 15, .ofs_x = 0, .ofs_y = -1},
    {.bitmap_index = 1988, .adv_w = 78, .box_w = 3, .box_h = 15, .ofs_x = 1, .ofs_y = -1},
    {.bitmap_index = 2000, .adv_w = 100, .box_w = 5, .box_h = 15, .ofs_x = 1, .ofs_y = -1},
    {.bitmap_index = 2019, .adv_w = 164, .box_w = 8, .box_h = 4, .ofs_x = 1, .ofs_y = 4},
    {.bitmap_index = 2027, .adv_w = 179, .box_w = 9, .box_h = 16, .ofs_x = 1, .ofs_y = 0},
    {.bitmap_index = 2063, .adv_w = 179, .box_w = 9, .box_h = 17, .ofs_x = 1, .ofs_y = 0},
    {.bitmap_index = 2102, .adv_w = 179, .box_w = 9, .box_h = 15, .ofs_x = 1, .ofs_y = 0},
    {.bitmap_index = 2136, .adv_w = 226, .box_w = 13, .box_h = 12, .ofs_x = 1, .ofs_y = 0},
    {.bitmap_index = 2175, .adv_w = 160, .box_w = 9, .box_h = 16, .ofs_x = 1, .ofs_y = -4},
    {.bitmap_index = 2211, .adv_w = 142, .box_w = 7, .box_h = 16, .ofs_x = 1, .ofs_y = 0},
    {.bitmap_index = 2239, .adv_w = 142, .box_w = 7, .box_h = 16, .ofs_x = 1, .ofs_y = 0},
    {.bitmap_index = 2267, .adv_w = 142, .box_w = 7, .box_h = 17, .ofs_x = 1, .ofs_y = 0},
    {.bitmap_index = 2297, .adv_w = 142, .box_w = 7, .box_h = 15, .ofs_x = 1, .ofs_y = 0},
    {.bitmap_index = 2324, .adv_w = 86, .box_w = 7, .box_h = 17, .ofs_x = -1, .ofs_y = 0},
    {.bitmap_index = 2354, .adv_w = 86, .box_w = 6, .box_h = 15, .ofs_x = 0, .ofs_y = 0},
    {.bitmap_index = 2377, .adv_w = 174, .box_w = 9, .box_h = 17, .ofs_x = 1, .ofs_y = 0},
    {.bitmap_index = 2416, .adv_w = 174, .box_w = 9, .box_h = 15, .ofs_x = 1, .ofs_y = 0},
    {.bitmap_index = 2450, .adv_w = 179, .box_w = 9, .box_h = 17, .ofs_x = 1, .ofs_y = 0},
    {.bitmap_index = 2489, .adv_w = 179, .box_w = 9, .box_h = 15, .ofs_x = 1, .ofs_y = 0},
    {.bitmap_index = 2523, .adv_w = 144, .box_w = 8, .box_h = 14, .ofs_x = 0, .ofs_y = 0},
    {.bitmap_index = 2551, .adv_w = 144, .box_w = 8, .box_h = 14, .ofs_x = 0, .ofs_y = 0},
    {.bitmap_index = 2579, .adv_w = 144, .box_w = 8, .box_h = 12, .ofs_x = 0, .ofs_y = 0},
    {.bitmap_index = 2603, .adv_w = 200, .box_w = 12, .box_h = 9, .ofs_x = 0, .ofs_y = 0},
    {.bitmap_index = 2630, .adv_w = 121, .box_w = 7, .box_h = 13, .ofs_x = 1, .ofs_y = -4},
    {.bitmap_index = 2653, .adv_w = 141, .box_w = 7, .box_h = 14, .ofs_x = 1, .ofs_y = 0},
    {.bitmap_index = 2678, .adv_w = 141, .box_w = 8, .box_h = 14, .ofs_x = 1, .ofs_y = 0},
    {.bitmap_index = 2706, .adv_w = 141, .box_w = 7, .box_h = 14, .ofs_x = 1, .ofs_y = 0},
    {.bitmap_index = 2731, .adv_w = 141, .box_w = 7, .box_h = 12, .ofs_x = 1, .ofs_y = 0},
    {.bitmap_index = 2752, .adv_w = 78, .box_w = 7, .box_h = 14, .ofs_x = 0, .ofs_y = 0},
    {.bitmap_index = 2777, .adv_w = 78, .box_w = 6, .box_h = 12, .ofs_x = 0, .ofs_y = 0},
    {.bitmap_index = 2795, .adv_w = 147, .box_w = 7, .box_h = 14, .ofs_x = 1, .ofs_y = 0},
    {.bitmap_index = 2820, .adv_w = 147, .box_w = 7, .box_h = 12, .ofs_x = 1, .ofs_y = 0},
    {.bitmap_index = 2841, .adv_w = 151, .box_w = 7, .box_h = 14, .ofs_x = 1, .ofs_y = 0},
    {.bitmap_index = 2866, .adv_w = 151, .box_w = 7, .box_h = 12, .ofs_x = 1, .ofs_y = 0},
    {.bitmap_index = 2887, .adv_w = 151, .box_w = 7, .box_h = 17, .ofs_x = 1, .ofs_y = -4},
    {.bitmap_index = 2917, .adv_w = 224, .box_w = 13, .box_h = 12, .ofs_x = 1, .ofs_y = 0},
    {.bitmap_index = 2956, .adv_w = 208, .box_w = 12, .box_h = 9, .ofs_x = 1, .ofs_y = 0}
};
/*---------------------
 *  CHARACTER MAPPING
 *--------------------*/
static const uint16_t unicode_list_2[] = {
    0x0, 0x2, 0x4, 0x6, 0x7, 0x8, 0x9, 0xa,
    0xb, 0xe, 0xf, 0x14, 0x16, 0x1b, 0x1c, 0x20,
    0x22, 0x24, 0x26, 0x27, 0x28, 0x29, 0x2a, 0x2b,
    0x2e, 0x2f, 0x34, 0x36, 0x3b, 0x3c, 0x3f, 0x92,
    0x93
};
/*Collect the unicode lists and glyph_id offsets*/
static const lv_font_fmt_txt_cmap_t cmaps[] =
{
    {
        .range_start = 32, .range_length = 64, .glyph_id_start = 1,
        .unicode_list = NULL, .glyph_id_ofs_list = NULL, .list_length = 0, .type = LV_FONT_FMT_TXT_CMAP_FORMAT0_TINY
    },
    {
        .range_start = 97, .range_length = 30, .glyph_id_start = 65,
        .unicode_list = NULL, .glyph_id_ofs_list = NULL, .list_length = 0, .type = LV_FONT_FMT_TXT_CMAP_FORMAT0_TINY
    },
    {
        .range_start = 192, .range_length = 148, .glyph_id_start = 95,
        .unicode_list = unicode_list_2, .glyph_id_ofs_list = NULL, .list_length = 33, .type = LV_FONT_FMT_TXT_CMAP_SPARSE_TINY
    }
};
/*--------------------
 *  ALL CUSTOM DATA
 *--------------------*/
/*Store all the custom data of the font*/
static lv_font_fmt_txt_glyph_cache_t cache;
static const lv_font_fmt_txt_dsc_t font_dsc = {
    .glyph_bitmap = glyph_bitmap,
    .glyph_dsc = glyph_dsc,
    .cmaps = cmaps,
    .kern_dsc = NULL,
    .kern_scale = 0,
    .cmap_num = 3,
    .bpp = 2,
    .kern_classes = 0,
    .bitmap_format = 0,
    .cache = &cache
};
/*-----------------
 *  PUBLIC FONT
 *----------------*/
/*Initialize a public general font descriptor*/
const lv_font_t iceberg = {
    .get_glyph_dsc = lv_font_get_glyph_dsc_fmt_txt,    /*Function pointer to get glyph's data*/
    .get_glyph_bitmap = lv_font_get_bitmap_fmt_txt,    /*Function pointer to get glyph's bitmap*/
    .line_height = 22,          /*The maximum line height required by the font*/
    .base_line = 5,             /*Baseline measured from the bottom of the line*/

    .subpx = LV_FONT_SUBPX_NONE,
    .underline_position = -1,
    .underline_thickness = 1,
    .dsc = &font_dsc,          /*The custom font data. Will be accessed by `get_glyph_bitmap/dsc` */
};
#endif

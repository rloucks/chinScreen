/*******************************************************************************
 * Size: 18 px
 * Bpp: 2
 ******************************************************************************/


#ifdef __has_include

    #if __has_include("lvgl.h")
         #ifndef LV_LVGL_H_INCLUDE_SIMPLE
             #define LV_LVGL_H_INCLUDE_SIMPLE
         #endif
     #endif
 #endif

 #ifdef LV_LVGL_H_INCLUDE_SIMPLE
     #include "lvgl.h"
 #else
     #include "../lvgl-8.3.11/lvgl.h"
 #endif

 #ifndef EMOJI_18
 #define EMOJI_18 1
 #endif

 #if EMOJI_18

/*-----------------
 *    BITMAPS
 *----------------*/
/*Store the image of the glyphs*/
static LV_ATTRIBUTE_LARGE_CONST const uint8_t emoji_18_glyph_bitmap[] = {
    /* U+0020 " " */
    /* U+0030 "0" */
    0x1, 0x69, 0x50, 0x2, 0x0, 0x1, 0x2, 0x0,
    0x0, 0x11, 0x0, 0x0, 0x4, 0x80, 0x0, 0x0,
    0x50, 0x70, 0x70, 0x14, 0xc, 0xc, 0x5, 0x0,
    0x0, 0x1, 0x81, 0xff, 0xd0, 0x50, 0x0, 0x0,
    0x42, 0x0, 0x0, 0x10, 0x24, 0x0, 0x50, 0x1,
    0xaa, 0x80, 0x0,
    /* U+0031 "1" */
    0x1a, 0xff, 0xe9, 0x3c, 0x14, 0x54, 0xf3, 0xa5,
    0x56, 0xb0, 0x47, 0x47, 0x44, 0x1, 0x51, 0x50,
    0x40, 0x0, 0x0, 0x14, 0x80, 0x0, 0x85, 0x30,
    0x0, 0x31, 0x83, 0x40, 0x70, 0x50, 0x2f, 0xf0,
    0x12, 0x0, 0x0, 0x20, 0x20, 0x0, 0x20, 0x1,
    0xa6, 0x90, 0x0,
    /* U+0032 "2" */
    0x1, 0x5a, 0x50, 0x2, 0x0, 0x2, 0x2, 0x0,
    0x0, 0x11, 0x40, 0x0, 0x1, 0x80, 0x0, 0x0,
    0x60, 0x0, 0x0, 0x14, 0xd, 0x1d, 0x5, 0x3,
    0x8b, 0x1, 0x40, 0x40, 0x40, 0x50, 0xf, 0xc0,
    0x12, 0x4, 0x8, 0x10, 0x14, 0x0, 0x10, 0x1,
    0x5a, 0x50, 0x0,
    /* U+0033 "3" */
    0x1, 0xaa, 0x90, 0x2, 0x40, 0x6, 0x1, 0x0,
    0x0, 0x20, 0x40, 0x0, 0x5, 0x80, 0x0, 0x0,
    0xa0, 0xd0, 0x1c, 0x28, 0x2e, 0x2f, 0x6, 0xe,
    0x42, 0xc1, 0x80, 0x0, 0x10, 0x44, 0xfe, 0xf8,
    0x2, 0x4, 0x40, 0x10, 0x20, 0x0, 0x50, 0x1,
    0x6a, 0x40, 0x0,
    /* U+0034 "4" */
    0x1, 0x59, 0x40, 0x2, 0x0, 0x5, 0x2, 0x0,
    0x0, 0x21, 0x0, 0x0, 0x4, 0x41, 0xc1, 0xc0,
    0x50, 0x70, 0x70, 0x14, 0x0, 0x0, 0x5, 0x0,
    0x0, 0x1, 0x80, 0x40, 0x40, 0x50, 0x2f, 0xe0,
    0x42, 0x0, 0x0, 0x10, 0x24, 0x0, 0x60, 0x1,
    0xaa, 0x80, 0x0,
    /* U+0035 "5" */
    0x1, 0x5a, 0x80, 0x2, 0x0, 0x5, 0x2, 0x0,
    0x0, 0x11, 0x0, 0x0, 0x44, 0x48, 0x0, 0x4,
    0x50, 0x90, 0x28, 0x14, 0x1c, 0x7, 0x5, 0x0,
    0x0, 0x1, 0x80, 0x0, 0x40, 0x54, 0x0, 0x70,
    0x42, 0xb, 0xf4, 0x10, 0x24, 0x0, 0x50, 0x0,
    0xaa, 0x80, 0x0,
    /* U+0036 "6" */
    0x0, 0xaa, 0x40, 0x1, 0x40, 0x5, 0x1, 0x0,
    0x0, 0x11, 0x40, 0x0, 0x4, 0x80, 0xc0, 0xc0,
    0x90, 0x70, 0x34, 0x28, 0x4, 0x8, 0xa, 0x0,
    0x0, 0x1, 0x8a, 0xee, 0xf8, 0x51, 0xff, 0xff,
    0xe2, 0x0, 0x0, 0x78, 0x14, 0x0, 0x10, 0x1,
    0xaa, 0x40, 0x0,
    /* U+0037 "7" */
    0x1, 0x69, 0x50, 0x2, 0x0, 0x5, 0x2, 0x0,
    0x0, 0x11, 0x7, 0x47, 0x44, 0x42, 0x52, 0x50,
    0x50, 0x10, 0x0, 0x14, 0x8, 0x69, 0x5, 0x9,
    0xa9, 0x81, 0x85, 0x1, 0x60, 0x46, 0x0, 0x24,
    0x41, 0x80, 0x19, 0x60, 0x20, 0x8, 0xa0, 0x1,
    0x6e, 0x80, 0x0,
    /* U+0038 "8" */
    0x1, 0x69, 0x50, 0x2, 0x0, 0x6, 0x2, 0x0,
    0x0, 0x21, 0x9, 0x1, 0x85, 0x80, 0x0, 0x0,
    0x50, 0x0, 0x0, 0x14, 0x3c, 0x1f, 0x5, 0x0,
    0x0, 0x1, 0x40, 0x0, 0x0, 0x50, 0xf, 0xc0,
    0x42, 0x0, 0x40, 0x10, 0x24, 0x0, 0x50, 0x1,
    0xaa, 0x80, 0x0,
    /* U+0039 "9" */
    0x0, 0x56, 0x50, 0x0, 0x54, 0x4, 0x50, 0x19,
    0x56, 0x0, 0x41, 0x0, 0x0, 0x4, 0x40, 0x1,
    0x54, 0x59, 0x2, 0x81, 0x41, 0x41, 0xf0, 0xb0,
    0x14, 0x4a, 0xb, 0x1, 0x20, 0x0, 0x0, 0x41,
    0x0, 0xf8, 0x8, 0x4, 0x0, 0x51, 0x0, 0x10,
    0x0, 0x40, 0x0, 0x6a, 0x50, 0x0,
    /* U+0041 "A" */
    0x1, 0xaa, 0x50, 0x1, 0x0, 0x6, 0x1, 0x0,
    0x0, 0x11, 0xa, 0x2, 0x80, 0x40, 0x0, 0x0,
    0x60, 0xb4, 0x3c, 0x18, 0x0, 0x0, 0xa, 0x0,
    0x0, 0x2, 0x80, 0xfb, 0xc0, 0x94, 0x1f, 0xd0,
    0x42, 0x0, 0x0, 0x20, 0x24, 0x0, 0x60, 0x0,
    0xaa, 0x90, 0x0,
    /* U+0042 "B" */
    0x1, 0xa9, 0x50, 0x2, 0x0, 0x46, 0x2, 0x0,
    0x40, 0x51, 0x0, 0x17, 0x15, 0x86, 0x4, 0x0,
    0x91, 0xd0, 0x50, 0x14, 0x4, 0x7, 0xc5, 0x4,
    0x1f, 0xe2, 0x81, 0xbd, 0xf4, 0x44, 0xf0, 0x3c,
    0x41, 0x58, 0x8, 0x10, 0x19, 0x1, 0x50, 0x0,
    0x55, 0x0, 0x0,
    /* U+0043 "C" */
    0x3f, 0xe5, 0xff, 0x8b, 0xf4, 0x2, 0xfc, 0xbd,
    0x0, 0xb, 0xcf, 0x40, 0x0, 0x2e, 0x80, 0xc0,
    0xe0, 0x84, 0xe, 0xf9, 0x4, 0x4b, 0x3f, 0x5d,
    0x44, 0x3, 0xf4, 0x4, 0x42, 0x49, 0x18, 0x41,
    0x3f, 0xff, 0x40, 0x0, 0x7f, 0x81, 0x0, 0x50,
    0x0, 0x40, 0x0, 0x55, 0x40, 0x0,
    /* U+0044 "D" */
    0x1, 0x6a, 0x40, 0x1, 0x0, 0x1, 0x1, 0x0,
    0x0, 0x11, 0x0, 0x0, 0x1, 0x40, 0x0, 0x0,
    0x53, 0x80, 0xd, 0x14, 0x90, 0x2, 0x46, 0x51,
    0x4, 0x12, 0x40, 0x14, 0x0, 0x84, 0x0, 0x0,
    0x52, 0x0, 0x0, 0x20, 0x24, 0x0, 0x60, 0x1,
    0xaa, 0x90, 0x0,
    /* U+0045 "E" */
    0x1, 0x6a, 0x50, 0x2, 0x40, 0x6, 0x2, 0xa0,
    0x6, 0x61, 0x4, 0x0, 0x4, 0x84, 0x51, 0x44,
    0x54, 0xd4, 0x5c, 0x55, 0x1, 0x11, 0x15, 0x10,
    0x44, 0x11, 0x81, 0x40, 0x50, 0x50, 0x0, 0x0,
    0x52, 0x2, 0xe0, 0x20, 0x24, 0x0, 0x60, 0x1,
    0xaa, 0x90, 0x0,
    /* U+0046 "F" */
    0x1, 0x69, 0x50, 0x2, 0x0, 0x5, 0x2, 0x0,
    0x0, 0x11, 0x0, 0x0, 0x5, 0x80, 0x0, 0x0,
    0x52, 0xf0, 0x7d, 0x14, 0x0, 0x0, 0x5, 0x0,
    0x0, 0x1, 0x80, 0x0, 0x0, 0x50, 0xbf, 0xf4,
    0x42, 0x0, 0x0, 0x20, 0x24, 0x0, 0x60, 0x1,
    0xaa, 0x90, 0x0,
    /* U+0047 "G" */
    0x1, 0x59, 0x50, 0x2, 0x0, 0x2, 0x2, 0x0,
    0x0, 0x20, 0x0, 0x0, 0x1, 0x41, 0xc0, 0xd0,
    0x50, 0x70, 0x34, 0x14, 0x0, 0x0, 0x5, 0x19,
    0xa6, 0x91, 0x4a, 0x6e, 0xb8, 0x45, 0x9a, 0x69,
    0x52, 0x0, 0x0, 0x20, 0x24, 0x0, 0x60, 0x1,
    0xaa, 0x90, 0x0,
    /* U+0048 "H" */
    0x0, 0xbf, 0x90, 0x0, 0x2f, 0xbe, 0x80, 0x18,
    0x90, 0x86, 0x1, 0x69, 0x1a, 0x64, 0x54, 0x0,
    0x1, 0x88, 0x1c, 0xd, 0x10, 0x8c, 0x0, 0xd,
    0x18, 0x0, 0x0, 0x0, 0x51, 0xbf, 0x90, 0x85,
    0x7c, 0x8f, 0x50, 0x12, 0xc0, 0xe1, 0x0, 0x41,
    0x4, 0x80, 0x1, 0x7f, 0x50, 0x0,
    /* U+0049 "I" */
    0x0, 0xaa, 0x90, 0x0, 0x50, 0x0, 0x80, 0x14,
    0x0, 0x2, 0x2, 0x0, 0x0, 0x4, 0x42, 0x80,
    0x74, 0x84, 0x1f, 0x1f, 0x4, 0x42, 0x84, 0x24,
    0x48, 0x5, 0x10, 0x4, 0x84, 0x12, 0x78, 0x84,
    0x11, 0x3e, 0x8, 0x10, 0x4b, 0x2, 0x1, 0x1,
    0x80, 0x80, 0x1, 0x7a, 0x90, 0x0,
    /* U+004A "J" */
    0x0, 0x0, 0x0, 0x2, 0x2e, 0x56, 0xe0, 0x1d,
    0x0, 0xe, 0x0, 0x80, 0x0, 0x40, 0x28, 0x0,
    0x46, 0x6, 0x84, 0x0, 0xb4, 0x6d, 0x0, 0x2e,
    0x41, 0xc0, 0x10, 0xa0, 0xa9, 0x8d, 0x56, 0x88,
    0x81, 0x10, 0x88, 0x41, 0x44, 0x50, 0x42, 0x3,
    0xf0, 0x20, 0x8, 0x2f, 0x8, 0x0, 0x19, 0x69,
    0x0,
    /* U+004B "K" */
    0x1, 0x56, 0x80, 0x0, 0x80, 0x1, 0x40, 0x20,
    0x0, 0xa5, 0x4, 0x38, 0x1, 0x10, 0x40, 0x0,
    0x0, 0x44, 0xc, 0xc, 0x8, 0x40, 0x82, 0xea,
    0xc4, 0x0, 0x0, 0x4, 0x40, 0x0, 0x56, 0x84,
    0x2, 0xe0, 0x0, 0x20, 0x60, 0x1, 0x0, 0x80,
    0x0, 0x40, 0x1, 0x95, 0x40, 0x0,
    /* U+004C "L" */
    0x1, 0x59, 0x50, 0x1, 0x0, 0x2, 0x1, 0x4,
    0x0, 0x20, 0xc, 0x0, 0x1, 0x40, 0x0, 0x0,
    0x50, 0x74, 0x38, 0x14, 0xc, 0x1b, 0x6, 0x0,
    0x0, 0x1, 0x80, 0xfb, 0xc0, 0x54, 0x1f, 0xd0,
    0x52, 0x0, 0x0, 0x20, 0x24, 0x0, 0x60, 0x1,
    0xaa, 0x90, 0x0,
    /* U+004D "M" */
    0x1, 0x59, 0x50, 0x2, 0x0, 0x6, 0x2, 0x0,
    0x0, 0x21, 0x2d, 0x2, 0x95, 0x9e, 0x11, 0xd1,
    0x94, 0x4, 0x40, 0x55, 0x1, 0x10, 0x15, 0x40,
    0x44, 0x6, 0x81, 0x40, 0x50, 0x94, 0x7, 0x80,
    0x42, 0x2, 0x40, 0x20, 0x24, 0x0, 0x60, 0x1,
    0xaa, 0x80, 0x0,
    /* U+004E "N" */
    0x1, 0x55, 0x40, 0x2, 0x0, 0x2, 0x1, 0x0,
    0x0, 0x21, 0x2, 0x2, 0x5, 0x41, 0x40, 0x50,
    0x50, 0x70, 0x70, 0x14, 0x1c, 0x1c, 0x5, 0x0,
    0x0, 0x1, 0x40, 0xff, 0xc0, 0x90, 0x30, 0x30,
    0x52, 0x4, 0x4, 0x20, 0x20, 0x0, 0x20, 0x1,
    0xa9, 0x50, 0x0,
    /* U+004F "O" */
    0x1, 0x59, 0x50, 0x2, 0x0, 0x6, 0x2, 0x0,
    0x0, 0x21, 0x0, 0x0, 0x4, 0x80, 0x0, 0x0,
    0x50, 0x70, 0x70, 0x14, 0xc, 0xc, 0x5, 0x0,
    0x0, 0x1, 0x40, 0x0, 0x0, 0x50, 0x0, 0x0,
    0x42, 0x0, 0x0, 0x20, 0x24, 0x0, 0x60, 0x1,
    0xaa, 0x90, 0x0,
    /* U+0050 "P" */
    0x0, 0x0, 0x0, 0x4d, 0x0, 0xc5, 0x90, 0x15,
    0x8d, 0x10, 0x20, 0x0, 0x4, 0x20, 0x0, 0x41,
    0x10, 0x0, 0x1, 0x88, 0x3c, 0x3c, 0x22, 0x0,
    0x0, 0x4, 0x40, 0x0, 0x6, 0x50, 0x2, 0x1,
    0x98, 0x0, 0xf9, 0x61, 0x80, 0x70, 0x20, 0x18,
    0x0, 0x28, 0x4, 0x6a, 0xa4, 0x0,
    /* U+0051 "Q" */
    0x0, 0xa9, 0x90, 0x0, 0x50, 0x1, 0x80, 0x20,
    0x0, 0x2, 0x1, 0x0, 0x0, 0x4, 0x81, 0xe1,
    0xe0, 0x88, 0x20, 0x2, 0x4, 0x55, 0x55, 0x55,
    0x44, 0x0, 0x0, 0x8, 0x94, 0x0, 0x6, 0x85,
    0x40, 0x0, 0x18, 0x14, 0x0, 0x5, 0x0, 0x65,
    0x1, 0x40, 0x0, 0x6a, 0x50, 0x0,
    /* U+0052 "R" */
    0x0, 0x95, 0xa0, 0x0, 0x60, 0x0, 0x50, 0x9,
    0x40, 0x5, 0x42, 0xf, 0xb, 0x48, 0x67, 0xe0,
    0xfd, 0x94, 0x20, 0x1, 0xc1, 0xae, 0x55, 0x5b,
    0x15, 0x7f, 0xff, 0xe1, 0x21, 0xf5, 0xb8, 0x42,
    0x1, 0x54, 0x8, 0x8, 0x0, 0x1, 0x0, 0x20,
    0x0, 0x90, 0x0, 0x6a, 0xa0, 0x0,
    /* U+0053 "S" */
    0x1, 0xaa, 0x90, 0x2, 0xa0, 0x2a, 0x2, 0x10,
    0x0, 0x21, 0x6e, 0x1, 0xe1, 0x8d, 0x80, 0x9c,
    0xa1, 0x10, 0x11, 0x28, 0x44, 0x40, 0x4a, 0x12,
    0xfe, 0x12, 0x44, 0xff, 0xc4, 0x85, 0x3f, 0xf1,
    0x42, 0x48, 0x8, 0x20, 0x40, 0x0, 0x4, 0x5,
    0xba, 0x99, 0x0,
    /* U+0054 "T" */
    0x1, 0x55, 0x50, 0x2, 0x0, 0x2, 0x2, 0x0,
    0x6, 0x21, 0x8, 0x0, 0x1, 0x80, 0x0, 0x0,
    0x90, 0xb4, 0x78, 0x14, 0x10, 0x1, 0x5, 0x0,
    0x0, 0x1, 0x80, 0x40, 0x40, 0x44, 0x2f, 0xf0,
    0x82, 0x41, 0xc4, 0x50, 0x18, 0x1, 0x90, 0x0,
    0x6a, 0x80, 0x0,
    /* U+0055 "U" */
    0x1, 0x55, 0x50, 0x2, 0x0, 0x2, 0x2, 0x0,
    0x0, 0x21, 0x2, 0x2, 0x1, 0x81, 0xc0, 0xd0,
    0x90, 0x30, 0x30, 0x14, 0x0, 0x0, 0x6, 0x0,
    0x0, 0x1, 0x8f, 0xea, 0xf4, 0x45, 0xf1, 0x3c,
    0x41, 0x5c, 0xd, 0x50, 0x6, 0x2, 0x80, 0x0,
    0x56, 0x40, 0x0,
    /* U+0056 "V" */
    0x1, 0x5a, 0x50, 0x2, 0x0, 0x2, 0x2, 0x0,
    0x0, 0x21, 0x0, 0x0, 0x1, 0x41, 0xc0, 0xd0,
    0x50, 0x65, 0x24, 0x14, 0x0, 0x0, 0x6, 0x0,
    0x88, 0x1, 0x80, 0x5, 0x40, 0x54, 0x0, 0x60,
    0x42, 0x0, 0x15, 0x10, 0x15, 0x6, 0x50, 0x0,
    0x61, 0x40, 0x0,
    /* U+0057 "W" */
    0x1, 0x5a, 0x50, 0x2, 0x40, 0x2, 0x2, 0x4,
    0x9, 0x21, 0x4a, 0x0, 0x1, 0x8b, 0xe0, 0xf4,
    0x91, 0x78, 0xff, 0x14, 0x45, 0x28, 0x45, 0x5,
    0x0, 0x41, 0x40, 0x0, 0x18, 0x45, 0x40, 0xa8,
    0x12, 0x6a, 0x80, 0x20, 0x20, 0x0, 0x60, 0x1,
    0x96, 0x90, 0x0,
    /* U+0058 "X" */
    0x1, 0xaa, 0x50, 0x2, 0x0, 0x1, 0x2, 0x0,
    0xa, 0x11, 0x14, 0x5, 0x4, 0x80, 0x4, 0x0,
    0x51, 0xd0, 0x72, 0x24, 0x30, 0x89, 0xd5, 0x0,
    0x5, 0x55, 0x40, 0x0, 0x5, 0x50, 0x2f, 0x1,
    0x92, 0x0, 0x0, 0x60, 0x20, 0x0, 0x74, 0x1,
    0xa6, 0x94, 0x0,
    /* U+0059 "Y" */
    0x0, 0x0, 0x0, 0x0, 0x7, 0xfd, 0x0, 0x2,
    0xff, 0xf4, 0x1f, 0xff, 0xff, 0xff, 0xbf, 0xff,
    0xff, 0xfb, 0xb, 0xfe, 0x4e, 0x60, 0x10, 0x40,
    0x92, 0xb, 0xe, 0x8, 0x20, 0x60, 0x90, 0x82,
    0x0, 0x0, 0x8, 0x10, 0x95, 0x60, 0x40, 0x8f,
    0xff, 0x20, 0x2, 0x2a, 0x88, 0x0, 0x6, 0xa9,
    0x0,
    /* U+005A "Z" */
    0x1, 0xf9, 0x90, 0x1, 0x0, 0x2a, 0x1, 0xd,
    0x14, 0x21, 0x3, 0x47, 0x5, 0x40, 0x1, 0xc0,
    0x90, 0x2e, 0x0, 0x28, 0x0, 0x20, 0xa, 0x81,
    0x50, 0x1, 0x45, 0x4, 0x0, 0x60, 0x4, 0x0,
    0x18, 0x1, 0x0, 0x21, 0x0, 0x40, 0x20, 0x2a,
    0xf6, 0x90, 0x0,
    /* U+0061 "a" */
    0x0, 0x95, 0x90, 0x0, 0x90, 0x1, 0x80, 0x14,
    0x0, 0x6, 0x7, 0x0, 0x0, 0x28, 0xff, 0xff,
    0xff, 0xcb, 0xff, 0x3f, 0xfc, 0xbf, 0xf2, 0xff,
    0xc6, 0xfc, 0xb, 0xe4, 0x40, 0x6a, 0x40, 0x41,
    0x7, 0xf4, 0x4, 0x10, 0x0, 0x2, 0x0, 0x80,
    0x0, 0x80, 0x1, 0xa6, 0x90, 0x0,
    /* U+0062 "b" */
    0x1, 0xa5, 0x90, 0x2, 0x40, 0x5, 0x2, 0xc,
    0xc, 0x10, 0x49, 0x1, 0x84, 0x83, 0x40, 0x70,
    0xa0, 0xb8, 0xb8, 0x24, 0x3d, 0x1f, 0x5, 0x0,
    0x50, 0x1, 0x40, 0x40, 0x40, 0x90, 0xff, 0xf8,
    0x11, 0x34, 0x7, 0x20, 0x6c, 0x0, 0xf0, 0xf,
    0x0, 0x3c, 0x1, 0x55, 0x59, 0x0,
    /* U+0063 "c" */
    0x1, 0x55, 0x40, 0x0, 0x40, 0x15, 0x0, 0x21,
    0x90, 0x8, 0x4, 0x58, 0xb, 0x44, 0x50, 0x0,
    0x8, 0x4e, 0x9d, 0xd, 0x78, 0x81, 0xd0, 0xd0,
    0x44, 0x60, 0x0, 0x8, 0xbd, 0x99, 0xab, 0xc3,
    0x99, 0xda, 0xb8, 0x2e, 0x99, 0xaf, 0x0, 0xb4,
    0xff, 0xc0, 0x1, 0x5f, 0xd0, 0x0,
    /* U+0064 "d" */
    0x1, 0x5a, 0x90, 0x2, 0x0, 0x5, 0x2, 0x24,
    0x6, 0x11, 0x0, 0x0, 0x1, 0x40, 0x0, 0x0,
    0x90, 0x70, 0x34, 0x18, 0x1c, 0xd, 0x6, 0x0,
    0x0, 0x1, 0x80, 0x19, 0x0, 0x94, 0x2f, 0xe0,
    0x52, 0xb, 0xf8, 0x20, 0x24, 0x0, 0x60, 0x1,
    0xaa, 0x90, 0x0,
    /* U+0065 "e" */
    0x1, 0x5a, 0x90, 0x2, 0x0, 0x6, 0x2, 0x0,
    0x0, 0x21, 0x0, 0x0, 0x5, 0x81, 0xc0, 0xc0,
    0x90, 0x70, 0x34, 0x14, 0x4, 0x8, 0x5, 0x0,
    0x10, 0x1, 0x80, 0x7f, 0x0, 0x50, 0x2f, 0xe0,
    0x52, 0x3, 0xf0, 0x10, 0x24, 0x0, 0x50, 0x1,
    0xaa, 0x90, 0x0,
    /* U+0066 "f" */
    0x1, 0xa5, 0x90, 0x0, 0x80, 0x1, 0x40, 0x10,
    0x1, 0x1, 0x4, 0x6, 0x24, 0x18, 0x40, 0x0,
    0x1, 0x84, 0x2d, 0x1e, 0x48, 0x54, 0x0, 0x1f,
    0x48, 0x40, 0x3, 0xc4, 0x40, 0xbf, 0xf4, 0x44,
    0x25, 0x6, 0x0, 0x10, 0x0, 0x1, 0x0, 0x40,
    0x0, 0x40, 0x1, 0x55, 0x50, 0x0,
    /* U+0067 "g" */
    0x7, 0xea, 0x80, 0x0, 0x40, 0x6, 0x2, 0x4,
    0x0, 0x21, 0x81, 0x0, 0x4, 0x50, 0x40, 0x0,
    0x93, 0x40, 0x0, 0x24, 0x95, 0x1, 0x4a, 0xf,
    0x7, 0xc2, 0x80, 0x0, 0x0, 0x94, 0xf, 0x80,
    0x42, 0xa, 0xa8, 0x10, 0x20, 0x0, 0x50, 0x1,
    0x6a, 0x90, 0x0,
    /* U+0068 "h" */
    0x1, 0x59, 0x50, 0x2, 0x40, 0x6, 0x2, 0x0,
    0xa, 0x21, 0x0, 0x0, 0x4, 0x82, 0x90, 0x80,
    0x50, 0x30, 0x34, 0x14, 0xc, 0xc, 0x5, 0x0,
    0x0, 0x1, 0x80, 0x0, 0x0, 0x90, 0xf, 0xc0,
    0x52, 0x0, 0x0, 0x20, 0x20, 0x0, 0x60, 0x1,
    0xaa, 0x90, 0x0,
    /* U+0069 "i" */
    0x1, 0x6a, 0x50, 0x2, 0x40, 0x6, 0x2, 0x0,
    0x0, 0x21, 0x0, 0x0, 0x4, 0x80, 0xbf, 0x40,
    0x50, 0x15, 0x60, 0x14, 0x0, 0x0, 0x5, 0x0,
    0x0, 0x1, 0x81, 0xc0, 0xc0, 0x90, 0x70, 0x34,
    0x52, 0x0, 0x0, 0x20, 0x20, 0x0, 0x60, 0x1,
    0xaa, 0x90, 0x0,
    /* U+006A "j" */
    0x1, 0x6a, 0x50, 0x0, 0x50, 0x0, 0x80, 0x10,
    0x0, 0x2, 0x1, 0x4, 0x5, 0x8, 0x40, 0x11,
    0x4, 0x84, 0x41, 0x10, 0x44, 0x80, 0x11, 0x4,
    0x44, 0x0, 0xd1, 0x1, 0x40, 0x2f, 0x0, 0x4,
    0x2, 0xf0, 0x4, 0x10, 0x1e, 0x1, 0x0, 0x0,
    0x4, 0x10, 0x9, 0x95, 0x95, 0x0,
    /* U+006B "k" */
    0x1, 0xa9, 0x40, 0x2, 0x80, 0xa, 0x2, 0xfa,
    0x1b, 0xe1, 0xff, 0x87, 0xfd, 0x6f, 0xd1, 0xfe,
    0x53, 0xf4, 0x7f, 0x15, 0xa5, 0x56, 0x95, 0x79,
    0x1, 0xb5, 0x8b, 0xff, 0xf8, 0x54, 0xb4, 0x78,
    0x12, 0x1, 0x90, 0x10, 0x24, 0x0, 0x60, 0x1,
    0xaa, 0x90, 0x0,
    /* U+006C "l" */
    0x0, 0x6a, 0x40, 0x0, 0x80, 0x5, 0x0, 0x80,
    0x0, 0x50, 0x87, 0x4f, 0x4, 0x12, 0x40, 0x0,
    0x10, 0x0, 0x8, 0x14, 0x0, 0x1d, 0xa, 0x7,
    0xfd, 0x2, 0xa8, 0x0, 0xa, 0xa5, 0x40, 0x5,
    0x64, 0x14, 0x4, 0x5, 0x1, 0x2, 0x1, 0x6,
    0xe6, 0xe5, 0x0,
    /* U+006D "m" */
    0x1, 0xa9, 0x90, 0x2, 0x40, 0x6, 0x2, 0xc,
    0xd, 0x20, 0x44, 0x0, 0x45, 0x80, 0x62, 0x40,
    0xa0, 0xf8, 0x78, 0x28, 0x18, 0xa, 0xa, 0x0,
    0x54, 0x2, 0x80, 0xff, 0xc0, 0x54, 0xbf, 0xf8,
    0x12, 0x2d, 0x5e, 0x10, 0x10, 0x0, 0x20, 0x1,
    0x6a, 0x90, 0x0,
    /* U+006E "n" */
    0x1, 0x95, 0x90, 0x0, 0x50, 0x0, 0x80, 0x10,
    0x0, 0x2, 0xb, 0x95, 0x1e, 0xbc, 0xd2, 0xaf,
    0x70, 0xc9, 0x2a, 0x77, 0xc, 0x70, 0x32, 0x41,
    0xc6, 0xea, 0x5a, 0xb8, 0x8e, 0x40, 0x6d, 0x81,
    0xbf, 0xff, 0xc4, 0x22, 0xd5, 0xf6, 0x0, 0x95,
    0x54, 0x80, 0x1, 0xa9, 0x90, 0x0,
    /* U+006F "o" */
    0x1, 0xbf, 0x80, 0x2, 0xff, 0xfe, 0x2, 0x94,
    0x5, 0x50, 0x49, 0x0, 0x84, 0x80, 0x0, 0x0,
    0x60, 0x70, 0x70, 0x14, 0x1c, 0x1c, 0x6, 0x90,
    0x0, 0x1, 0xc4, 0x15, 0x0, 0x61, 0x3f, 0xe0,
    0x44, 0x4f, 0xf8, 0x10, 0x74, 0x0, 0x50, 0x1,
    0xa6, 0x80, 0x0,
    /* U+0070 "p" */
    0x1, 0x55, 0x50, 0x2, 0x0, 0x1, 0x2, 0x0,
    0x0, 0x11, 0x41, 0x0, 0x44, 0x82, 0x0, 0x24,
    0x50, 0x50, 0x14, 0x14, 0x17, 0x13, 0x45, 0xf,
    0x87, 0xd1, 0x40, 0x0, 0x0, 0x54, 0x0, 0x0,
    0x12, 0x1, 0xe0, 0x20, 0x20, 0x0, 0x20, 0x1,
    0xa6, 0x90, 0x0,
    /* U+0071 "q" */
    0x1, 0xaa, 0x90, 0x2, 0x40, 0x6, 0x2, 0x0,
    0x0, 0x20, 0x67, 0x47, 0x85, 0x8b, 0xa3, 0xe8,
    0xa1, 0xf4, 0xb8, 0x28, 0x1, 0x90, 0xa, 0x2,
    0x1, 0x2, 0x82, 0xff, 0xe0, 0x84, 0xff, 0xfc,
    0x11, 0x3e, 0x6f, 0x20, 0x14, 0x0, 0x60, 0x1,
    0xaa, 0x90, 0x0,
    /* U+0072 "r" */
    0x1, 0x5a, 0x90, 0x2, 0x0, 0x6, 0x2, 0x0,
    0x0, 0x21, 0x0, 0x0, 0x4, 0x89, 0x0, 0x14,
    0x90, 0xa0, 0x28, 0x14, 0x1c, 0x7, 0x5, 0x0,
    0x0, 0x1, 0x80, 0x0, 0x0, 0x50, 0x1f, 0xd0,
    0x42, 0x0, 0x0, 0x10, 0x24, 0x0, 0x50, 0x1,
    0xaa, 0x80, 0x0,
    /* U+0073 "s" */
    0x1, 0xa6, 0xd6, 0x42, 0x0, 0x53, 0x11, 0x0,
    0x51, 0x75, 0x0, 0x4, 0x4, 0x40, 0x0, 0x0,
    0x50, 0x0, 0x0, 0x14, 0x3d, 0x1f, 0x5, 0x0,
    0x0, 0x1, 0x80, 0x0, 0x0, 0x94, 0xf, 0x80,
    0x12, 0x3, 0xf0, 0x20, 0x24, 0x0, 0x60, 0x0,
    0xaa, 0x90, 0x0,
    /* U+0074 "t" */
    0x1, 0xaa, 0x40, 0x2, 0x40, 0x1, 0x1, 0x0,
    0x0, 0x10, 0xff, 0x8b, 0xed, 0xbf, 0xf3, 0xff,
    0x9b, 0xf8, 0xbf, 0xd9, 0xfd, 0xf, 0xd7, 0xe,
    0x1, 0xc3, 0x94, 0x15, 0x5, 0x40, 0x2f, 0xf0,
    0x11, 0x3, 0xf0, 0x10, 0x10, 0x0, 0x10, 0x1,
    0x9a, 0x90, 0x0,
    /* U+0075 "u" */
    0x1, 0x55, 0xbf, 0xc0, 0x40, 0x3, 0xfd, 0x10,
    0x0, 0x3f, 0xc1, 0x1d, 0x1e, 0xb8, 0x41, 0x51,
    0x60, 0x84, 0x0, 0x0, 0x4, 0x86, 0x0, 0x0,
    0x4f, 0xfe, 0xab, 0x44, 0xff, 0xbf, 0x90, 0x47,
    0xf0, 0x7, 0x84, 0x29, 0x0, 0xbf, 0x80, 0x50,
    0x7, 0xf8, 0x0, 0xaa, 0xfe, 0x0,
    /* U+0076 "v" */
    0x0, 0x6a, 0x90, 0x1, 0x40, 0x5, 0x2, 0xfc,
    0xf, 0xe1, 0xff, 0xcf, 0xfd, 0xbf, 0xf3, 0xff,
    0xaf, 0xfc, 0xff, 0xd5, 0xfd, 0x1f, 0xd5, 0x19,
    0x1, 0x81, 0x4f, 0xff, 0xf4, 0x44, 0xf8, 0xfc,
    0x81, 0x5f, 0x3c, 0x50, 0xb, 0x8f, 0x80, 0x0,
    0x7f, 0x40, 0x0,
    /* U+0077 "w" */
    0x0, 0x55, 0x40, 0x1, 0x40, 0x5, 0x1, 0x14,
    0x4, 0x0, 0x1f, 0x4f, 0xc0, 0x40, 0x0, 0x5,
    0x59, 0x55, 0x56, 0x5a, 0x40, 0x1, 0xd6, 0x7f,
    0xaf, 0xe4, 0x4b, 0xeb, 0xf2, 0x8, 0x65, 0x51,
    0x40, 0x80, 0x1, 0x40, 0xa, 0xaa, 0x0,
    /* U+0078 "x" */
    0x0, 0x55, 0x90, 0x0, 0x50, 0x0, 0x80, 0x4,
    0xa0, 0xa2, 0x2, 0x1, 0x4, 0x4, 0x10, 0x0,
    0x0, 0x44, 0xf, 0xf, 0x4, 0x40, 0x0, 0x0,
    0x19, 0x55, 0x9, 0x5, 0x40, 0x5f, 0x94, 0x14,
    0x9, 0x5, 0x1, 0x40, 0x40, 0x10, 0x11, 0xa8,
    0x2, 0xa4, 0x0, 0x55, 0x90, 0x0,
    /* U+0079 "y" */
    0x1, 0x59, 0x50, 0x2, 0x0, 0x5, 0x1, 0x0,
    0x0, 0x10, 0x7, 0x7, 0x44, 0x43, 0xa2, 0xb0,
    0x50, 0x0, 0x0, 0x15, 0x55, 0x55, 0x45, 0x64,
    0x0, 0x75, 0x4f, 0xff, 0xfc, 0x44, 0xf4, 0x78,
    0x41, 0x1, 0x54, 0x10, 0x24, 0x0, 0x50, 0x0,
    0xaa, 0x80, 0x0,
    /* U+007A "z" */
    0x1, 0x59, 0x40, 0x2, 0x50, 0x15, 0x2, 0x10,
    0x1, 0x11, 0x0, 0x0, 0x4, 0x83, 0xd1, 0xe0,
    0x50, 0x0, 0x0, 0x28, 0x2, 0xe0, 0x9, 0x26,
    0xfe, 0x1, 0x56, 0x6f, 0xc0, 0x58, 0x1a, 0xf0,
    0x44, 0x2, 0xf0, 0x20, 0x40, 0x90, 0x60, 0x1a,
    0xea, 0x90, 0x0
};
/*---------------------
 *  GLYPH DESCRIPTION
 *--------------------*/
static const lv_font_fmt_txt_glyph_dsc_t emoji_18_glyph_dsc[] = {
    {.bitmap_index = 0, .adv_w = 0, .box_w = 0, .box_h = 0, .ofs_x = 0, .ofs_y = 0} /* id = 0 reserved */,
    {.bitmap_index = 0, .adv_w = 86, .box_w = 0, .box_h = 0, .ofs_x = 0, .ofs_y = 0},
    {.bitmap_index = 0, .adv_w = 239, .box_w = 13, .box_h = 13, .ofs_x = 1, .ofs_y = 1},
    {.bitmap_index = 43, .adv_w = 241, .box_w = 13, .box_h = 13, .ofs_x = 1, .ofs_y = 1},
    {.bitmap_index = 86, .adv_w = 240, .box_w = 13, .box_h = 13, .ofs_x = 1, .ofs_y = 1},
    {.bitmap_index = 129, .adv_w = 240, .box_w = 13, .box_h = 13, .ofs_x = 1, .ofs_y = 1},
    {.bitmap_index = 172, .adv_w = 239, .box_w = 13, .box_h = 13, .ofs_x = 1, .ofs_y = 1},
    {.bitmap_index = 215, .adv_w = 236, .box_w = 13, .box_h = 13, .ofs_x = 1, .ofs_y = 1},
    {.bitmap_index = 258, .adv_w = 240, .box_w = 13, .box_h = 13, .ofs_x = 1, .ofs_y = 1},
    {.bitmap_index = 301, .adv_w = 238, .box_w = 13, .box_h = 13, .ofs_x = 1, .ofs_y = 1},
    {.bitmap_index = 344, .adv_w = 239, .box_w = 13, .box_h = 13, .ofs_x = 1, .ofs_y = 1},
    {.bitmap_index = 387, .adv_w = 249, .box_w = 14, .box_h = 13, .ofs_x = 1, .ofs_y = 1},
    {.bitmap_index = 433, .adv_w = 241, .box_w = 13, .box_h = 13, .ofs_x = 1, .ofs_y = 1},
    {.bitmap_index = 476, .adv_w = 239, .box_w = 13, .box_h = 13, .ofs_x = 1, .ofs_y = 1},
    {.bitmap_index = 519, .adv_w = 251, .box_w = 14, .box_h = 13, .ofs_x = 1, .ofs_y = 1},
    {.bitmap_index = 565, .adv_w = 239, .box_w = 13, .box_h = 13, .ofs_x = 1, .ofs_y = 1},
    {.bitmap_index = 608, .adv_w = 239, .box_w = 13, .box_h = 13, .ofs_x = 1, .ofs_y = 1},
    {.bitmap_index = 651, .adv_w = 239, .box_w = 13, .box_h = 13, .ofs_x = 1, .ofs_y = 1},
    {.bitmap_index = 694, .adv_w = 240, .box_w = 13, .box_h = 13, .ofs_x = 1, .ofs_y = 1},
    {.bitmap_index = 737, .adv_w = 247, .box_w = 14, .box_h = 13, .ofs_x = 1, .ofs_y = 1},
    {.bitmap_index = 783, .adv_w = 245, .box_w = 14, .box_h = 13, .ofs_x = 1, .ofs_y = 1},
    {.bitmap_index = 829, .adv_w = 242, .box_w = 14, .box_h = 14, .ofs_x = 1, .ofs_y = 1},
    {.bitmap_index = 878, .adv_w = 247, .box_w = 14, .box_h = 13, .ofs_x = 1, .ofs_y = 1},
    {.bitmap_index = 924, .adv_w = 240, .box_w = 13, .box_h = 13, .ofs_x = 1, .ofs_y = 1},
    {.bitmap_index = 967, .adv_w = 239, .box_w = 13, .box_h = 13, .ofs_x = 1, .ofs_y = 1},
    {.bitmap_index = 1010, .adv_w = 238, .box_w = 13, .box_h = 13, .ofs_x = 1, .ofs_y = 1},
    {.bitmap_index = 1053, .adv_w = 239, .box_w = 13, .box_h = 13, .ofs_x = 1, .ofs_y = 1},
    {.bitmap_index = 1096, .adv_w = 239, .box_w = 13, .box_h = 14, .ofs_x = 1, .ofs_y = 1},
    {.bitmap_index = 1142, .adv_w = 242, .box_w = 14, .box_h = 13, .ofs_x = 1, .ofs_y = 1},
    {.bitmap_index = 1188, .adv_w = 250, .box_w = 14, .box_h = 13, .ofs_x = 1, .ofs_y = 1},
    {.bitmap_index = 1234, .adv_w = 240, .box_w = 13, .box_h = 13, .ofs_x = 1, .ofs_y = 1},
    {.bitmap_index = 1277, .adv_w = 240, .box_w = 13, .box_h = 13, .ofs_x = 1, .ofs_y = 1},
    {.bitmap_index = 1320, .adv_w = 239, .box_w = 13, .box_h = 13, .ofs_x = 1, .ofs_y = 1},
    {.bitmap_index = 1363, .adv_w = 240, .box_w = 13, .box_h = 13, .ofs_x = 1, .ofs_y = 1},
    {.bitmap_index = 1406, .adv_w = 240, .box_w = 13, .box_h = 13, .ofs_x = 1, .ofs_y = 1},
    {.bitmap_index = 1449, .adv_w = 238, .box_w = 13, .box_h = 13, .ofs_x = 1, .ofs_y = 1},
    {.bitmap_index = 1492, .adv_w = 257, .box_w = 14, .box_h = 14, .ofs_x = 1, .ofs_y = 1},
    {.bitmap_index = 1541, .adv_w = 241, .box_w = 13, .box_h = 13, .ofs_x = 1, .ofs_y = 1},
    {.bitmap_index = 1584, .adv_w = 242, .box_w = 14, .box_h = 13, .ofs_x = 1, .ofs_y = 1},
    {.bitmap_index = 1630, .adv_w = 239, .box_w = 13, .box_h = 14, .ofs_x = 1, .ofs_y = 0},
    {.bitmap_index = 1676, .adv_w = 248, .box_w = 14, .box_h = 13, .ofs_x = 1, .ofs_y = 1},
    {.bitmap_index = 1722, .adv_w = 240, .box_w = 13, .box_h = 13, .ofs_x = 1, .ofs_y = 1},
    {.bitmap_index = 1765, .adv_w = 239, .box_w = 13, .box_h = 13, .ofs_x = 1, .ofs_y = 1},
    {.bitmap_index = 1808, .adv_w = 243, .box_w = 14, .box_h = 13, .ofs_x = 1, .ofs_y = 1},
    {.bitmap_index = 1854, .adv_w = 238, .box_w = 13, .box_h = 13, .ofs_x = 1, .ofs_y = 1},
    {.bitmap_index = 1897, .adv_w = 239, .box_w = 13, .box_h = 13, .ofs_x = 1, .ofs_y = 1},
    {.bitmap_index = 1940, .adv_w = 239, .box_w = 13, .box_h = 13, .ofs_x = 1, .ofs_y = 1},
    {.bitmap_index = 1983, .adv_w = 246, .box_w = 14, .box_h = 13, .ofs_x = 1, .ofs_y = 1},
    {.bitmap_index = 2029, .adv_w = 241, .box_w = 13, .box_h = 13, .ofs_x = 1, .ofs_y = 1},
    {.bitmap_index = 2072, .adv_w = 241, .box_w = 13, .box_h = 13, .ofs_x = 1, .ofs_y = 1},
    {.bitmap_index = 2115, .adv_w = 240, .box_w = 13, .box_h = 13, .ofs_x = 1, .ofs_y = 1},
    {.bitmap_index = 2158, .adv_w = 247, .box_w = 14, .box_h = 13, .ofs_x = 1, .ofs_y = 1},
    {.bitmap_index = 2204, .adv_w = 239, .box_w = 13, .box_h = 13, .ofs_x = 1, .ofs_y = 1},
    {.bitmap_index = 2247, .adv_w = 239, .box_w = 13, .box_h = 13, .ofs_x = 1, .ofs_y = 1},
    {.bitmap_index = 2290, .adv_w = 240, .box_w = 13, .box_h = 13, .ofs_x = 1, .ofs_y = 1},
    {.bitmap_index = 2333, .adv_w = 239, .box_w = 13, .box_h = 13, .ofs_x = 1, .ofs_y = 1},
    {.bitmap_index = 2376, .adv_w = 240, .box_w = 13, .box_h = 13, .ofs_x = 1, .ofs_y = 1},
    {.bitmap_index = 2419, .adv_w = 241, .box_w = 13, .box_h = 13, .ofs_x = 1, .ofs_y = 1},
    {.bitmap_index = 2462, .adv_w = 247, .box_w = 14, .box_h = 13, .ofs_x = 1, .ofs_y = 1},
    {.bitmap_index = 2508, .adv_w = 239, .box_w = 13, .box_h = 13, .ofs_x = 1, .ofs_y = 1},
    {.bitmap_index = 2551, .adv_w = 232, .box_w = 13, .box_h = 12, .ofs_x = 1, .ofs_y = 1},
    {.bitmap_index = 2590, .adv_w = 253, .box_w = 14, .box_h = 13, .ofs_x = 1, .ofs_y = 1},
    {.bitmap_index = 2636, .adv_w = 239, .box_w = 13, .box_h = 13, .ofs_x = 1, .ofs_y = 1},
    {.bitmap_index = 2679, .adv_w = 237, .box_w = 13, .box_h = 13, .ofs_x = 1, .ofs_y = 1}
};
/*---------------------
 *  CHARACTER MAPPING
 *--------------------*/
/*Collect the unicode lists and glyph_id offsets*/
static const lv_font_fmt_txt_cmap_t emoji_18_cmaps[] =
{
    {
        .range_start = 32, .range_length = 1, .glyph_id_start = 1,
        .unicode_list = NULL, .glyph_id_ofs_list = NULL, .list_length = 0, .type = LV_FONT_FMT_TXT_CMAP_FORMAT0_TINY
    },
    {
        .range_start = 48, .range_length = 10, .glyph_id_start = 2,
        .unicode_list = NULL, .glyph_id_ofs_list = NULL, .list_length = 0, .type = LV_FONT_FMT_TXT_CMAP_FORMAT0_TINY
    },
    {
        .range_start = 65, .range_length = 26, .glyph_id_start = 12,
        .unicode_list = NULL, .glyph_id_ofs_list = NULL, .list_length = 0, .type = LV_FONT_FMT_TXT_CMAP_FORMAT0_TINY
    },
    {
        .range_start = 97, .range_length = 26, .glyph_id_start = 38,
        .unicode_list = NULL, .glyph_id_ofs_list = NULL, .list_length = 0, .type = LV_FONT_FMT_TXT_CMAP_FORMAT0_TINY
    }
};
/*--------------------
 *  ALL CUSTOM DATA
 *--------------------*/
/*Store all the custom data of the font*/
static lv_font_fmt_txt_glyph_cache_t emoji_18_cache;
static const lv_font_fmt_txt_dsc_t emoji_18_font_dsc = {
    .glyph_bitmap = emoji_18_glyph_bitmap,
    .glyph_dsc = emoji_18_glyph_dsc,
    .cmaps = emoji_18_cmaps,
    .kern_dsc = NULL,
    .kern_scale = 0,
    .cmap_num = 4,
    .bpp = 2,
    .kern_classes = 0,
    .bitmap_format = 0,
    .cache = &emoji_18_cache
};
/*-----------------
 *  PUBLIC FONT
 *----------------*/
/*Initialize a public general font descriptor*/
const lv_font_t emoji_18 = {
    .get_glyph_dsc = lv_font_get_glyph_dsc_fmt_txt,    /*Function pointer to get glyph's data*/
    .get_glyph_bitmap = lv_font_get_bitmap_fmt_txt,    /*Function pointer to get glyph's bitmap*/
    .line_height = 15,          /*The maximum line height required by the font*/
    .base_line = 0,             /*Baseline measured from the bottom of the line*/

    .subpx = LV_FONT_SUBPX_NONE,
    .underline_position = -1,
    .underline_thickness = 1,
    .dsc = &emoji_18_font_dsc,          /*The custom font data. Will be accessed by `get_glyph_bitmap/dsc` */
};
#endif

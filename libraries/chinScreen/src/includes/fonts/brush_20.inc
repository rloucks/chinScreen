/*******************************************************************************
 * Size: 20 px
 * Bpp: 2
 ******************************************************************************/


#ifdef __has_include

    #if __has_include("lvgl.h")
         #ifndef LV_LVGL_H_INCLUDE_SIMPLE
             #define LV_LVGL_H_INCLUDE_SIMPLE
         #endif
     #endif
 #endif

 #ifdef LV_LVGL_H_INCLUDE_SIMPLE
     #include "lvgl.h"
 #else
     #include "../lvgl-8.3.11/lvgl.h"
 #endif

 #ifndef BRUSH_20
 #define BRUSH_20 1
 #endif

 #if BRUSH_20

/*-----------------
 *    BITMAPS
 *----------------*/
/*Store the image of the glyphs*/
static LV_ATTRIBUTE_LARGE_CONST const uint8_t brush_20_glyph_bitmap[] = {
    /* U+0020 " " */
    /* U+0021 "!" */
    0xc, 0x1c, 0x28, 0x34, 0x34, 0x30, 0x30, 0x20,
    0x20, 0x0, 0x0, 0xe0, 0x10,
    /* U+0022 "\"" */
    0x1, 0x4a, 0xca, 0xc8, 0x40,
    /* U+0023 "#" */
    0x0, 0x0, 0x0, 0x0, 0x10, 0x0, 0x0, 0x8,
    0x5, 0x0, 0x3, 0x2, 0x80, 0x0, 0xc0, 0xa0,
    0x6, 0xff, 0xff, 0x95, 0x6d, 0x4a, 0x0, 0x7,
    0x2, 0x80, 0x1, 0xc0, 0xa0, 0x0, 0x70, 0x29,
    0x40, 0x6f, 0xff, 0x90, 0xab, 0x52, 0x80, 0x0,
    0xc0, 0x60, 0x0, 0x30, 0x0, 0x0, 0x0, 0x0,
    0x0,
    /* U+0024 "$" */
    0x0, 0x10, 0x0, 0x0, 0xc0, 0x0, 0x3, 0x0,
    0x0, 0xc, 0x0, 0x7, 0xff, 0x40, 0x39, 0xda,
    0x0, 0xc3, 0x0, 0x2, 0xdc, 0x0, 0x0, 0xbf,
    0x90, 0x0, 0xd0, 0x91, 0x43, 0x42, 0xf, 0xff,
    0xe0, 0x0, 0x28, 0x0, 0x0, 0x90, 0x0, 0x0,
    0x40, 0x0,
    /* U+0025 "%" */
    0x0, 0x0, 0x0, 0x0, 0x6, 0x1, 0x40, 0x30,
    0xe, 0x43, 0x40, 0x55, 0x1c, 0x2, 0xb0, 0xd0,
    0x7, 0x7, 0x6, 0x40, 0x34, 0x32, 0x1, 0xc0,
    0xb0, 0xa, 0x1, 0x0, 0x30, 0x0, 0x0, 0xc0,
    0x0, 0x0, 0x0, 0x0,
    /* U+0026 "&" */
    0x1f, 0xc0, 0x3, 0x46, 0x0, 0x90, 0x20, 0xc,
    0x6, 0x0, 0xa0, 0x90, 0x3, 0xc, 0x0, 0x2a,
    0x80, 0x0, 0xf0, 0x0, 0xf, 0x42, 0x82, 0x9d,
    0xa0, 0x30, 0x7c, 0x7, 0xb9, 0xd0, 0x28, 0x2,
    0x0,
    /* U+0027 "'" */
    0x20, 0xc3, 0xc, 0x20, 0x0,
    /* U+0028 "(" */
    0x2, 0x1, 0xc0, 0xc0, 0xa0, 0x34, 0xc, 0x3,
    0x0, 0xd0, 0x2c, 0x3, 0xd0, 0x10,
    /* U+0029 ")" */
    0x7c, 0x2, 0x80, 0x30, 0xc, 0x2, 0x40, 0x90,
    0x24, 0xd, 0x3, 0x2, 0x40, 0x0,
    /* U+002A "*" */
    0x0, 0x0, 0x4, 0x0, 0xea, 0x7, 0xf8, 0x1b,
    0xd0, 0x29, 0x40, 0x0, 0x0,
    /* U+002B "+" */
    0x0, 0x10, 0x0, 0x2, 0x0, 0x0, 0x20, 0x0,
    0x2, 0x0, 0x6, 0xff, 0xe3, 0xff, 0x90, 0x0,
    0x60, 0x0, 0x1, 0x0, 0x0, 0x10, 0x0, 0x0,
    0x0,
    /* U+002C "," */
    0x2, 0xc7, 0x18, 0x40,
    /* U+002D "-" */
    0x1a, 0xff, 0x2f, 0xf9, 0x0,
    /* U+002E "." */
    0x0, 0xd3, 0x0,
    /* U+002F "/" */
    0x1, 0x80, 0xd0, 0x70, 0x3c, 0xd, 0xb, 0x3,
    0xc0, 0xd0, 0x70, 0x18, 0x0, 0x0,
    /* U+0030 "0" */
    0x0, 0x0, 0xf, 0x40, 0x6f, 0x3, 0x1c, 0x18,
    0x34, 0x90, 0xd2, 0x3, 0xc, 0x28, 0x35, 0xc0,
    0x7c, 0x0,
    /* U+0031 "1" */
    0x10, 0xc7, 0x1c, 0x71, 0xc7, 0xc, 0x34, 0xd1,
    0x0,
    /* U+0032 "2" */
    0x1b, 0x0, 0x66, 0x40, 0x2, 0x0, 0x6, 0x0,
    0xc, 0x0, 0x24, 0x6e, 0x7b, 0xe4, 0x24, 0x0,
    /* U+0033 "3" */
    0x0, 0x0, 0xbf, 0x2, 0x8, 0x0, 0x10, 0x2,
    0x0, 0x1b, 0xe0, 0xf6, 0x80, 0xd, 0x0, 0xb0,
    0x3, 0x0, 0x4, 0x0,
    /* U+0034 "4" */
    0x0, 0x10, 0x0, 0x2, 0x90, 0x0, 0x29, 0x40,
    0x1, 0xc6, 0x0, 0xc, 0x18, 0x0, 0xe0, 0x77,
    0xc3, 0x1b, 0xe4, 0x1f, 0xea, 0x0, 0x10, 0x18,
    0x0, 0x0, 0x50, 0x0, 0x0, 0x0, 0x0,
    /* U+0035 "5" */
    0x0, 0x0, 0x20, 0x0, 0x3f, 0xf8, 0x34, 0x0,
    0x20, 0x0, 0x3a, 0xe0, 0x10, 0x20, 0x0, 0x20,
    0x0, 0x30, 0x0, 0x90, 0x3, 0x80, 0x1d, 0x0,
    /* U+0036 "6" */
    0x0, 0x0, 0x70, 0xc, 0x3, 0x40, 0x30, 0xb,
    0xe4, 0xa2, 0xce, 0xc, 0xd0, 0x8d, 0x70, 0xbd,
    0x2, 0x0,
    /* U+0037 "7" */
    0xb, 0xe0, 0x7, 0x97, 0x0, 0x0, 0x30, 0x0,
    0x3, 0xa8, 0x6, 0xf9, 0x0, 0x5a, 0x0, 0x0,
    0xa0, 0x0, 0xd, 0x0, 0x0, 0xc0, 0x0, 0x8,
    0x0, 0x0, 0x40, 0x0, 0x0, 0x0,
    /* U+0038 "8" */
    0x0, 0x0, 0xe, 0x0, 0x4c, 0x8, 0x30, 0x32,
    0x80, 0xfc, 0x0, 0xf8, 0x3, 0xfc, 0x18, 0xb0,
    0x91, 0x43, 0x58, 0xb, 0x40,
    /* U+0039 "9" */
    0x1, 0x40, 0xa9, 0xc, 0xa2, 0x4f, 0x32, 0xf3,
    0xb7, 0x38, 0x70, 0x7, 0x0, 0x30, 0x3, 0x0,
    0x30, 0x2, 0x0, 0x0,
    /* U+003A ":" */
    0x0, 0x2c, 0x4, 0x0, 0x0, 0x34, 0x28,
    /* U+003B ";" */
    0x0, 0x34, 0x1c, 0x0, 0x0, 0x0, 0xc, 0xd,
    0xc, 0x18, 0x0,
    /* U+003C "<" */
    0x0, 0x10, 0x3, 0xc0, 0x3c, 0x2, 0xc0, 0x1c,
    0x0, 0xd0, 0x7, 0x0, 0x1e, 0x0, 0x1e, 0x0,
    0xe, 0x0, 0xe, 0x0, 0xc, 0x0, 0x0,
    /* U+003D "=" */
    0xbf, 0xfe, 0x9, 0x50, 0x0, 0x0, 0x50, 0x6f,
    0xfc, 0x1a, 0x50, 0x0,
    /* U+003E ">" */
    0x0, 0x0, 0xb, 0xd0, 0x0, 0x1b, 0x40, 0x0,
    0x38, 0x0, 0x3, 0x0, 0x1, 0xc0, 0x0, 0xc0,
    0x0, 0xd0, 0x0, 0x60, 0x0, 0x30, 0x0, 0x10,
    0x0, 0x0, 0x0,
    /* U+003F "?" */
    0xb, 0xc0, 0xfa, 0x8f, 0x3, 0x24, 0x18, 0x0,
    0x90, 0x7, 0x0, 0x30, 0x1, 0x80, 0x8, 0x0,
    0x28, 0x0, 0x0, 0x0, 0x80, 0x3, 0x80, 0x0,
    0x0,
    /* U+0040 "@" */
    0x0, 0x0, 0x0, 0xbf, 0x40, 0xe0, 0x74, 0x90,
    0x2, 0x62, 0xe0, 0xe2, 0x8c, 0x2c, 0xc3, 0x7,
    0x62, 0xc8, 0xde, 0x7b, 0x2e, 0x4f, 0x3, 0xef,
    0x40, 0x1a, 0x0,
    /* U+0041 "A" */
    0x0, 0x70, 0x0, 0xe, 0x80, 0x2, 0x5c, 0x0,
    0x30, 0xc0, 0x6, 0xe, 0x0, 0xc0, 0xb0, 0xc,
    0x7, 0x2, 0xff, 0xf8, 0x24, 0x3, 0x82, 0x0,
    0x2c, 0x20, 0x0, 0xc3, 0x40, 0xc, 0x10, 0x0,
    0x80, 0x0, 0x0,
    /* U+0042 "B" */
    0x3f, 0xe4, 0x0, 0x35, 0xc0, 0x3, 0x9, 0x0,
    0x30, 0xc0, 0x3, 0x78, 0x0, 0x3f, 0xf8, 0x3,
    0x80, 0x80, 0x30, 0x8, 0x3, 0x2, 0x40, 0x14,
    0xa0, 0x0, 0x28, 0x0, 0x2, 0x0,
    /* U+0043 "C" */
    0x0, 0x0, 0x2, 0xfc, 0xb, 0x40, 0x1c, 0x0,
    0x28, 0x0, 0x30, 0x0, 0x30, 0x0, 0x34, 0x0,
    0x1d, 0x18, 0xb, 0xf0,
    /* U+0044 "D" */
    0x1, 0x0, 0x3f, 0xe0, 0x70, 0x4, 0x30, 0x8,
    0x34, 0xc, 0x24, 0xc, 0x28, 0x28, 0x1c, 0x70,
    0xd, 0xd0, 0xb, 0x80, 0x9, 0x0,
    /* U+0045 "E" */
    0x3f, 0xf4, 0x2, 0x95, 0x0, 0x18, 0x0, 0x2,
    0x80, 0x0, 0x3f, 0xff, 0x3, 0x80, 0x0, 0x28,
    0x1, 0x82, 0x86, 0xf0, 0x2f, 0xf4, 0x0, 0x90,
    0x0,
    /* U+0046 "F" */
    0x2f, 0xf8, 0x0, 0x75, 0x40, 0x3, 0x0, 0x0,
    0x30, 0x0, 0x2, 0x0, 0x40, 0x2f, 0xf4, 0x1,
    0x90, 0x0, 0x8, 0x0, 0x0, 0x80, 0x0, 0x8,
    0x0, 0x0, 0x0, 0x0,
    /* U+0047 "G" */
    0x2, 0xf8, 0x0, 0x3d, 0x68, 0x3, 0x80, 0x0,
    0xc, 0x0, 0x0, 0x20, 0x6b, 0xe0, 0xc6, 0x9c,
    0x2, 0x80, 0x70, 0x3, 0xeb, 0xc0, 0x2, 0xe1,
    0x40, 0x0, 0x2, 0x0, 0x0, 0x0, 0x0,
    /* U+0048 "H" */
    0x10, 0x0, 0xc, 0x0, 0x83, 0x0, 0x30, 0xc0,
    0xc, 0x30, 0x6f, 0xf, 0xfe, 0xc3, 0xd0, 0x30,
    0x90, 0xc, 0x14, 0x2, 0x1, 0x0, 0x10, 0x0,
    0x0,
    /* U+0049 "I" */
    0x0, 0x83, 0xc, 0x30, 0xc3, 0xd, 0x34, 0x91,
    0x40,
    /* U+004A "J" */
    0x1f, 0xfe, 0x0, 0x59, 0x0, 0x1, 0x0, 0x0,
    0x20, 0x0, 0x8, 0x0, 0x3, 0x0, 0x0, 0xc0,
    0x0, 0x30, 0x40, 0x1c, 0x2f, 0xae, 0x1, 0xfe,
    0x0, 0x0, 0x0,
    /* U+004B "K" */
    0x0, 0x0, 0x8, 0x0, 0x0, 0x80, 0x2d, 0xc,
    0xf, 0x0, 0xd2, 0xc0, 0xd, 0xb4, 0x0, 0xde,
    0x0, 0xa, 0xfd, 0x0, 0xa0, 0xbd, 0x3, 0x0,
    0x78, 0x30, 0x0, 0x90, 0x0, 0x0,
    /* U+004C "L" */
    0x0, 0x0, 0x20, 0x0, 0x8, 0x0, 0x2, 0x40,
    0x0, 0x90, 0x0, 0x34, 0x0, 0xd, 0x0, 0x3,
    0x40, 0x19, 0xd6, 0xfe, 0x1f, 0xf8, 0x2, 0x40,
    0x0,
    /* U+004D "M" */
    0x0, 0x0, 0x0, 0xc0, 0x1, 0xc3, 0xd0, 0x1f,
    0x4c, 0xd1, 0xd9, 0x30, 0xce, 0x24, 0xc0, 0xf0,
    0xa3, 0x0, 0x2, 0x8c, 0x0, 0x6, 0x10, 0x0,
    0x4, 0x0, 0x0, 0x10,
    /* U+004E "N" */
    0x0, 0x0, 0x6, 0x0, 0x22, 0xd0, 0x18, 0xea,
    0xa, 0x34, 0xa3, 0x4c, 0xc, 0xc3, 0x1, 0xf0,
    0xc0, 0x3c, 0x30, 0x7, 0x4c, 0x0, 0xa1, 0x0,
    0x0, 0x0, 0x0,
    /* U+004F "O" */
    0x0, 0x0, 0xb, 0x90, 0x1c, 0x78, 0x30, 0xc,
    0x30, 0x8, 0x30, 0xc, 0x30, 0xc, 0x1c, 0x24,
    0xf, 0xe0, 0x2, 0x40,
    /* U+0050 "P" */
    0x0, 0x0, 0x0, 0x1f, 0xf4, 0xf, 0xc0, 0xc3,
    0xb8, 0xc, 0x2, 0x80, 0xc0, 0x28, 0x1c, 0x2,
    0x8b, 0x40, 0x1f, 0xe0, 0x1, 0xc0, 0x0, 0xc,
    0x0, 0x0, 0xc0, 0x0, 0x4, 0x0, 0x0, 0x0,
    0x0,
    /* U+0051 "Q" */
    0x2, 0xc0, 0x0, 0xff, 0x40, 0x1c, 0x1c, 0x3,
    0x40, 0xd0, 0x30, 0x5, 0x3, 0x0, 0x60, 0x60,
    0xd5, 0x2, 0x7, 0xd0, 0x30, 0x1f, 0x41, 0xe9,
    0x1c, 0x0, 0x0, 0x0,
    /* U+0052 "R" */
    0x6, 0xff, 0x40, 0xb, 0xe4, 0x70, 0x1, 0x20,
    0x28, 0x0, 0x8, 0xc, 0x0, 0x3, 0xd, 0x0,
    0x0, 0xcf, 0x0, 0x0, 0x26, 0xfe, 0x0, 0x8,
    0x2, 0xf4, 0x1, 0x0, 0x7, 0x0, 0x0, 0x0,
    0x0, 0x0, 0x0, 0x0,
    /* U+0053 "S" */
    0x7, 0xf8, 0xb, 0x41, 0x42, 0x0, 0x1, 0x80,
    0x0, 0x34, 0x0, 0xb, 0xff, 0x80, 0x0, 0x18,
    0x0, 0x2, 0x8, 0x2, 0x42, 0xeb, 0x80, 0x2a,
    0x40,
    /* U+0054 "T" */
    0x0, 0x0, 0x1, 0xbf, 0xf8, 0x7e, 0x60, 0x0,
    0x2, 0x0, 0x0, 0x20, 0x0, 0x2, 0x0, 0x0,
    0x20, 0x0, 0x2, 0x0, 0x0, 0x10, 0x0, 0x1,
    0x0, 0x0, 0x0, 0x0,
    /* U+0055 "U" */
    0x4, 0x0, 0x3, 0x0, 0x1, 0x80, 0x10, 0xd0,
    0x4, 0x30, 0x2, 0xc, 0x0, 0xc3, 0x0, 0xa0,
    0xc0, 0xb0, 0x3f, 0xe0, 0x2, 0x40, 0x0,
    /* U+0056 "V" */
    0x0, 0x0, 0x40, 0x0, 0x60, 0x4, 0x30, 0x8,
    0x30, 0x24, 0x28, 0x30, 0x1c, 0x70, 0xc, 0xd0,
    0xa, 0xc0, 0x3, 0x80, 0x1, 0x0,
    /* U+0057 "W" */
    0x0, 0x0, 0x0, 0x0, 0x0, 0x0, 0x8, 0x60,
    0x2, 0x2, 0x3, 0x0, 0xf0, 0x30, 0x28, 0x1b,
    0x4a, 0x1, 0xc3, 0x28, 0xc0, 0xc, 0x71, 0xdc,
    0x0, 0x99, 0xf, 0x80, 0x7, 0xc0, 0xf4, 0x0,
    0x3c, 0xb, 0x0, 0x1, 0x40, 0x10, 0x0,
    /* U+0058 "X" */
    0x0, 0x0, 0x91, 0x0, 0x38, 0x3d, 0xf, 0x0,
    0xba, 0xc0, 0x1, 0xf4, 0x0, 0xf, 0xc0, 0x1,
    0xce, 0x0, 0x30, 0x30, 0x6, 0x1, 0x40, 0x40,
    0x0, 0x0, 0x0, 0x0,
    /* U+0059 "Y" */
    0x0, 0x0, 0x0, 0x0, 0xc, 0x60, 0x2, 0x82,
    0xc0, 0xb0, 0xa, 0x1d, 0x0, 0x3b, 0x40, 0x0,
    0xf0, 0x0, 0x3, 0x0, 0x0, 0x70, 0x0, 0x7,
    0x0, 0x0, 0x30, 0x0, 0x3, 0x0, 0x0, 0x10,
    0x0,
    /* U+005A "Z" */
    0x2f, 0xf8, 0x0, 0x0, 0x30, 0x0, 0x2, 0xc0,
    0x0, 0x1d, 0x10, 0x1a, 0xff, 0x80, 0x1e, 0x0,
    0x0, 0xa0, 0x0, 0x7, 0x1, 0x68, 0x36, 0xfe,
    0x40, 0xfe, 0x0, 0x0, 0x0, 0x0, 0x0,
    /* U+005B "[" */
    0x7f, 0x83, 0x0, 0x30, 0x3, 0x0, 0x30, 0x3,
    0x0, 0x30, 0x3, 0x0, 0x30, 0x3, 0x0, 0x30,
    0x3, 0x0, 0x3f, 0xc0, 0x0,
    /* U+005C "\\" */
    0x0, 0x0, 0x0, 0x0, 0x0, 0x0, 0x0, 0x20,
    0xe, 0x0, 0x90, 0x70, 0x7, 0x1, 0xe0, 0xd0,
    0x3, 0x3, 0x71, 0xc0, 0x1b, 0xff, 0xff, 0xf8,
    0x1, 0xdc, 0x3f, 0x40, 0x0, 0xfc, 0x2f, 0x0,
    0x0, 0xb8, 0x1f, 0x0, 0x0, 0x74, 0xd, 0x0,
    0x0, 0x20, 0x0, 0x0,
    /* U+005D "]" */
    0x7f, 0x80, 0x90, 0x24, 0x9, 0x2, 0x80, 0x90,
    0x24, 0x9, 0x2, 0x40, 0x90, 0x24, 0x9, 0x7f,
    0x40, 0x0,
    /* U+005E "^" */
    0x2, 0x0, 0x3e, 0x3, 0x4c, 0x18, 0x28, 0x80,
    0x71, 0x0, 0x0,
    /* U+005F "_" */
    0x2b, 0xff, 0xf4, 0x55, 0x40, 0x0,
    /* U+0061 "a" */
    0x0, 0x0, 0x2f, 0x3, 0x9a, 0x14, 0xc, 0x7,
    0xf4, 0x21, 0xd1, 0x43, 0x49, 0xbc, 0x1d, 0x0,
    /* U+0062 "b" */
    0x20, 0x2, 0x0, 0x20, 0x3, 0x0, 0x37, 0xc3,
    0xc5, 0x34, 0x23, 0x8, 0x3b, 0x42, 0x80, 0x0,
    0x0,
    /* U+0063 "c" */
    0xb, 0x43, 0x9c, 0x70, 0x7, 0x0, 0x70, 0x43,
    0xf4, 0x0, 0x0,
    /* U+0064 "d" */
    0x0, 0x0, 0x8, 0x0, 0xc0, 0xc, 0x0, 0xc0,
    0xc, 0x5, 0xd3, 0xbd, 0x50, 0xe5, 0xa, 0x70,
    0xa2, 0xf8, 0x0, 0x0,
    /* U+0065 "e" */
    0x7, 0xc0, 0x92, 0x83, 0x1e, 0x1f, 0xe0, 0x60,
    0x14, 0xeb, 0x40, 0x90, 0x0,
    /* U+0066 "f" */
    0x6, 0x0, 0x3f, 0x0, 0x8d, 0x6, 0x0, 0x1c,
    0x0, 0x30, 0x0, 0xd0, 0x1f, 0xf8, 0xb, 0x0,
    0x1c, 0x0, 0x30, 0x0, 0x80, 0x1, 0x0,
    /* U+0067 "g" */
    0x0, 0x0, 0xf0, 0x2a, 0x83, 0x5c, 0x31, 0xc3,
    0xc, 0x32, 0xd3, 0xda, 0x0, 0x60, 0x6, 0x0,
    0xa0, 0x2c, 0xb, 0x0, 0x80,
    /* U+0068 "h" */
    0x20, 0x0, 0x30, 0x0, 0x30, 0x0, 0x30, 0x0,
    0x30, 0x0, 0x30, 0x0, 0x31, 0xe0, 0x3e, 0x14,
    0x3c, 0x8, 0x2c, 0x8, 0x1c, 0x0, 0x4, 0x0,
    /* U+0069 "i" */
    0x78, 0x0, 0x0, 0x28, 0x1c, 0x1c, 0x1c, 0x4,
    /* U+006A "j" */
    0x5, 0x0, 0xf0, 0x0, 0x0, 0x10, 0x2, 0x80,
    0x1c, 0x0, 0xd0, 0xe, 0x0, 0xa0, 0x9, 0x0,
    0xd0, 0x1c, 0x2e, 0x0,
    /* U+006B "k" */
    0x0, 0x0, 0x20, 0x0, 0xa, 0x0, 0x1, 0xc1,
    0x0, 0x71, 0x80, 0xc, 0xc0, 0x3, 0xe8, 0x0,
    0xb7, 0xd0, 0x18, 0x2d, 0x2, 0x1, 0xc0, 0x0,
    0x0,
    /* U+006C "l" */
    0x3, 0x4d, 0x38, 0xe2, 0xcb, 0x1c, 0x30, 0xd2,
    0x40,
    /* U+006D "m" */
    0x10, 0x0, 0x1, 0x42, 0xc3, 0xc5, 0x13, 0x37,
    0x16, 0xf, 0x4d, 0x74, 0x2c, 0x24, 0xd0, 0x50,
    0x40, 0x0, 0x0, 0x0,
    /* U+006E "n" */
    0x40, 0x0, 0x70, 0xb4, 0x32, 0x1c, 0x3e, 0xc,
    0x2c, 0xd, 0x18, 0x4, 0x0, 0x0,
    /* U+006F "o" */
    0x0, 0x0, 0xf8, 0x21, 0xc2, 0xc, 0x20, 0xc6,
    0x28, 0x3e, 0x0, 0x0,
    /* U+0070 "p" */
    0x0, 0x0, 0x1f, 0xf8, 0x2a, 0x9, 0x6, 0xd,
    0x7, 0x2c, 0x7, 0xd0, 0x3, 0x0, 0x3, 0x0,
    0x3, 0x40, 0x3, 0x40, 0x2, 0x40, 0x1, 0x40,
    0x0, 0x0,
    /* U+0071 "q" */
    0x1d, 0x63, 0x4a, 0x70, 0xa6, 0xf, 0xa3, 0xf6,
    0x97, 0x0, 0x70, 0x3, 0x0, 0x30, 0x3, 0x0,
    0x20, 0x0,
    /* U+0072 "r" */
    0x0, 0x4, 0x90, 0xbc, 0x72, 0x80, 0x3a, 0x0,
    0x3c, 0x0, 0x2c, 0x0, 0x1c, 0x0, 0xd, 0x0,
    0x4, 0x0,
    /* U+0073 "s" */
    0x1, 0x0, 0x7b, 0x42, 0x1, 0x5, 0x0, 0x6,
    0x40, 0x1, 0xc9, 0xb, 0xf, 0xe0, 0x0, 0x0,
    /* U+0074 "t" */
    0x0, 0x80, 0x0, 0x30, 0x0, 0x1c, 0x0, 0x6,
    0x0, 0x2, 0x80, 0x0, 0xa0, 0x7, 0xff, 0x90,
    0x9, 0x0, 0x2, 0x41, 0x0, 0xaa, 0x0, 0x18,
    0x0,
    /* U+0075 "u" */
    0x20, 0x20, 0xc0, 0xc7, 0x7, 0x1c, 0x3c, 0x72,
    0xf0, 0xec, 0xc1, 0x81, 0x0,
    /* U+0076 "v" */
    0x0, 0x8, 0x8, 0x60, 0xc3, 0x18, 0x37, 0x42,
    0xf0, 0xc, 0x0, 0x0,
    /* U+0077 "w" */
    0x0, 0x0, 0x0, 0x0, 0x0, 0x5, 0x0, 0x2,
    0x28, 0xe, 0x18, 0x70, 0xf8, 0xd0, 0xca, 0x73,
    0x3, 0xb0, 0xe8, 0x7, 0x3, 0xc0, 0x0, 0x9,
    0x0,
    /* U+0078 "x" */
    0x0, 0x18, 0x34, 0xb0, 0x1e, 0xc0, 0xb, 0x40,
    0xf, 0xc0, 0x2c, 0xa0, 0x30, 0x10, 0x10, 0x0,
    /* U+0079 "y" */
    0x0, 0x12, 0x40, 0xc7, 0xb, 0xc, 0x7c, 0x3b,
    0x70, 0x74, 0xc0, 0x2, 0x0, 0x18, 0x0, 0x50,
    0x2, 0x0, 0x2c, 0x3, 0xc0, 0x0, 0x0,
    /* U+007A "z" */
    0x0, 0x0, 0x0, 0xbc, 0x3, 0xed, 0x0, 0x7,
    0x0, 0x7f, 0xa4, 0x2, 0x40, 0x0, 0x86, 0xa4,
    0x69, 0x0,
    /* U+007B "{" */
    0x3, 0x40, 0x24, 0x0, 0xc0, 0x3, 0x0, 0xc,
    0x0, 0x30, 0x0, 0x90, 0x7, 0xe0, 0x3e, 0x40,
    0x4, 0x0, 0x10, 0x0, 0x40, 0x1, 0x14, 0xf,
    0x80, 0x0, 0x0,
    /* U+007C "|" */
    0x10, 0x83, 0xc, 0x30, 0xc3, 0xc, 0x30, 0xd2,
    0x49, 0x14,
    /* U+007D "}" */
    0x1e, 0x0, 0xd9, 0x0, 0x20, 0x0, 0x80, 0x2,
    0x0, 0x8, 0x80, 0x2d, 0x0, 0x90, 0x1, 0x40,
    0x5, 0x0, 0x24, 0x4, 0x80, 0x2f, 0x0, 0x78,
    0x0, 0x0, 0x0,
    /* U+007E "~" */
    0x2, 0xc0, 0x0, 0x3f, 0x80, 0x12, 0x87, 0x86,
    0x8, 0x7, 0xe0, 0x0, 0x0, 0x0
};
/*---------------------
 *  GLYPH DESCRIPTION
 *--------------------*/
static const lv_font_fmt_txt_glyph_dsc_t brush_20_glyph_dsc[] = {
    {.bitmap_index = 0, .adv_w = 0, .box_w = 0, .box_h = 0, .ofs_x = 0, .ofs_y = 0} /* id = 0 reserved */,
    {.bitmap_index = 0, .adv_w = 90, .box_w = 0, .box_h = 0, .ofs_x = 0, .ofs_y = 0},
    {.bitmap_index = 0, .adv_w = 84, .box_w = 4, .box_h = 13, .ofs_x = 1, .ofs_y = 1},
    {.bitmap_index = 13, .adv_w = 90, .box_w = 4, .box_h = 5, .ofs_x = 1, .ofs_y = 11},
    {.bitmap_index = 18, .adv_w = 237, .box_w = 13, .box_h = 15, .ofs_x = 1, .ofs_y = 1},
    {.bitmap_index = 67, .adv_w = 176, .box_w = 11, .box_h = 15, .ofs_x = 0, .ofs_y = 0},
    {.bitmap_index = 109, .adv_w = 208, .box_w = 11, .box_h = 13, .ofs_x = 1, .ofs_y = 1},
    {.bitmap_index = 145, .adv_w = 177, .box_w = 10, .box_h = 13, .ofs_x = 1, .ofs_y = 1},
    {.bitmap_index = 178, .adv_w = 79, .box_w = 3, .box_h = 6, .ofs_x = 1, .ofs_y = 10},
    {.bitmap_index = 183, .adv_w = 112, .box_w = 5, .box_h = 11, .ofs_x = 1, .ofs_y = 2},
    {.bitmap_index = 197, .adv_w = 112, .box_w = 5, .box_h = 11, .ofs_x = 1, .ofs_y = 2},
    {.bitmap_index = 211, .adv_w = 122, .box_w = 7, .box_h = 7, .ofs_x = 0, .ofs_y = 8},
    {.bitmap_index = 224, .adv_w = 170, .box_w = 10, .box_h = 10, .ofs_x = 0, .ofs_y = 3},
    {.bitmap_index = 249, .adv_w = 74, .box_w = 3, .box_h = 5, .ofs_x = 1, .ofs_y = -3},
    {.bitmap_index = 253, .adv_w = 170, .box_w = 9, .box_h = 2, .ofs_x = 1, .ofs_y = 7},
    {.bitmap_index = 258, .adv_w = 64, .box_w = 3, .box_h = 4, .ofs_x = 0, .ofs_y = -3},
    {.bitmap_index = 261, .adv_w = 109, .box_w = 5, .box_h = 11, .ofs_x = 1, .ofs_y = 2},
    {.bitmap_index = 275, .adv_w = 118, .box_w = 7, .box_h = 10, .ofs_x = 0, .ofs_y = 3},
    {.bitmap_index = 293, .adv_w = 77, .box_w = 3, .box_h = 11, .ofs_x = 1, .ofs_y = 2},
    {.bitmap_index = 302, .adv_w = 122, .box_w = 8, .box_h = 8, .ofs_x = 0, .ofs_y = 4},
    {.bitmap_index = 318, .adv_w = 117, .box_w = 7, .box_h = 11, .ofs_x = 0, .ofs_y = 3},
    {.bitmap_index = 338, .adv_w = 167, .box_w = 11, .box_h = 11, .ofs_x = 0, .ofs_y = 2},
    {.bitmap_index = 369, .adv_w = 122, .box_w = 8, .box_h = 12, .ofs_x = 0, .ofs_y = 2},
    {.bitmap_index = 393, .adv_w = 115, .box_w = 6, .box_h = 12, .ofs_x = 1, .ofs_y = 3},
    {.bitmap_index = 411, .adv_w = 150, .box_w = 10, .box_h = 12, .ofs_x = 0, .ofs_y = 1},
    {.bitmap_index = 441, .adv_w = 106, .box_w = 7, .box_h = 12, .ofs_x = 0, .ofs_y = 3},
    {.bitmap_index = 462, .adv_w = 118, .box_w = 6, .box_h = 13, .ofs_x = 0, .ofs_y = 1},
    {.bitmap_index = 482, .adv_w = 97, .box_w = 4, .box_h = 7, .ofs_x = 1, .ofs_y = 4},
    {.bitmap_index = 489, .adv_w = 97, .box_w = 4, .box_h = 11, .ofs_x = 1, .ofs_y = 1},
    {.bitmap_index = 500, .adv_w = 144, .box_w = 7, .box_h = 13, .ofs_x = 1, .ofs_y = 0},
    {.bitmap_index = 523, .adv_w = 170, .box_w = 9, .box_h = 5, .ofs_x = 1, .ofs_y = 5},
    {.bitmap_index = 535, .adv_w = 144, .box_w = 9, .box_h = 12, .ofs_x = 0, .ofs_y = 1},
    {.bitmap_index = 562, .adv_w = 128, .box_w = 7, .box_h = 14, .ofs_x = 1, .ofs_y = 0},
    {.bitmap_index = 587, .adv_w = 176, .box_w = 9, .box_h = 12, .ofs_x = 1, .ofs_y = 2},
    {.bitmap_index = 614, .adv_w = 160, .box_w = 10, .box_h = 14, .ofs_x = 0, .ofs_y = 1},
    {.bitmap_index = 649, .adv_w = 147, .box_w = 10, .box_h = 12, .ofs_x = -1, .ofs_y = 2},
    {.bitmap_index = 679, .adv_w = 132, .box_w = 8, .box_h = 10, .ofs_x = 0, .ofs_y = 3},
    {.bitmap_index = 699, .adv_w = 122, .box_w = 8, .box_h = 11, .ofs_x = 0, .ofs_y = 3},
    {.bitmap_index = 721, .adv_w = 147, .box_w = 10, .box_h = 10, .ofs_x = 0, .ofs_y = 3},
    {.bitmap_index = 746, .adv_w = 138, .box_w = 10, .box_h = 11, .ofs_x = -1, .ofs_y = 3},
    {.bitmap_index = 774, .adv_w = 170, .box_w = 11, .box_h = 11, .ofs_x = 0, .ofs_y = 2},
    {.bitmap_index = 805, .adv_w = 144, .box_w = 9, .box_h = 11, .ofs_x = 0, .ofs_y = 3},
    {.bitmap_index = 830, .adv_w = 82, .box_w = 3, .box_h = 12, .ofs_x = 1, .ofs_y = 2},
    {.bitmap_index = 839, .adv_w = 138, .box_w = 9, .box_h = 12, .ofs_x = 0, .ofs_y = 2},
    {.bitmap_index = 866, .adv_w = 170, .box_w = 10, .box_h = 12, .ofs_x = 1, .ofs_y = 1},
    {.bitmap_index = 896, .adv_w = 160, .box_w = 9, .box_h = 11, .ofs_x = 1, .ofs_y = 2},
    {.bitmap_index = 921, .adv_w = 182, .box_w = 11, .box_h = 10, .ofs_x = 0, .ofs_y = 3},
    {.bitmap_index = 949, .adv_w = 154, .box_w = 9, .box_h = 12, .ofs_x = 0, .ofs_y = 1},
    {.bitmap_index = 976, .adv_w = 131, .box_w = 8, .box_h = 10, .ofs_x = 0, .ofs_y = 2},
    {.bitmap_index = 996, .adv_w = 144, .box_w = 10, .box_h = 13, .ofs_x = -1, .ofs_y = 1},
    {.bitmap_index = 1029, .adv_w = 138, .box_w = 10, .box_h = 11, .ofs_x = 0, .ofs_y = 2},
    {.bitmap_index = 1057, .adv_w = 170, .box_w = 13, .box_h = 11, .ofs_x = -1, .ofs_y = 2},
    {.bitmap_index = 1093, .adv_w = 150, .box_w = 9, .box_h = 11, .ofs_x = 0, .ofs_y = 2},
    {.bitmap_index = 1118, .adv_w = 157, .box_w = 10, .box_h = 11, .ofs_x = 0, .ofs_y = 2},
    {.bitmap_index = 1146, .adv_w = 144, .box_w = 9, .box_h = 10, .ofs_x = 0, .ofs_y = 2},
    {.bitmap_index = 1169, .adv_w = 125, .box_w = 8, .box_h = 11, .ofs_x = 0, .ofs_y = 2},
    {.bitmap_index = 1191, .adv_w = 219, .box_w = 14, .box_h = 11, .ofs_x = 0, .ofs_y = 3},
    {.bitmap_index = 1230, .adv_w = 160, .box_w = 10, .box_h = 11, .ofs_x = 0, .ofs_y = 2},
    {.bitmap_index = 1258, .adv_w = 154, .box_w = 10, .box_h = 13, .ofs_x = 0, .ofs_y = 1},
    {.bitmap_index = 1291, .adv_w = 166, .box_w = 11, .box_h = 11, .ofs_x = 0, .ofs_y = 2},
    {.bitmap_index = 1322, .adv_w = 118, .box_w = 6, .box_h = 14, .ofs_x = 1, .ofs_y = 0},
    {.bitmap_index = 1343, .adv_w = 259, .box_w = 16, .box_h = 11, .ofs_x = 0, .ofs_y = 3},
    {.bitmap_index = 1387, .adv_w = 118, .box_w = 5, .box_h = 14, .ofs_x = 1, .ofs_y = 0},
    {.bitmap_index = 1405, .adv_w = 128, .box_w = 7, .box_h = 6, .ofs_x = 1, .ofs_y = 10},
    {.bitmap_index = 1416, .adv_w = 174, .box_w = 11, .box_h = 2, .ofs_x = 0, .ofs_y = -4},
    {.bitmap_index = 1422, .adv_w = 115, .box_w = 7, .box_h = 9, .ofs_x = 0, .ofs_y = 3},
    {.bitmap_index = 1438, .adv_w = 99, .box_w = 6, .box_h = 11, .ofs_x = 0, .ofs_y = 3},
    {.bitmap_index = 1455, .adv_w = 99, .box_w = 6, .box_h = 7, .ofs_x = 0, .ofs_y = 2},
    {.bitmap_index = 1466, .adv_w = 102, .box_w = 6, .box_h = 13, .ofs_x = 0, .ofs_y = 3},
    {.bitmap_index = 1486, .adv_w = 106, .box_w = 7, .box_h = 7, .ofs_x = 0, .ofs_y = 3},
    {.bitmap_index = 1499, .adv_w = 109, .box_w = 7, .box_h = 13, .ofs_x = 0, .ofs_y = 3},
    {.bitmap_index = 1522, .adv_w = 102, .box_w = 6, .box_h = 14, .ofs_x = 0, .ofs_y = -2},
    {.bitmap_index = 1543, .adv_w = 116, .box_w = 8, .box_h = 12, .ofs_x = 0, .ofs_y = 3},
    {.bitmap_index = 1567, .adv_w = 68, .box_w = 4, .box_h = 8, .ofs_x = 0, .ofs_y = 3},
    {.bitmap_index = 1575, .adv_w = 82, .box_w = 6, .box_h = 13, .ofs_x = -1, .ofs_y = -1},
    {.bitmap_index = 1595, .adv_w = 131, .box_w = 9, .box_h = 11, .ofs_x = 0, .ofs_y = 3},
    {.bitmap_index = 1620, .adv_w = 71, .box_w = 3, .box_h = 11, .ofs_x = 1, .ofs_y = 3},
    {.bitmap_index = 1629, .adv_w = 176, .box_w = 11, .box_h = 7, .ofs_x = 0, .ofs_y = 3},
    {.bitmap_index = 1649, .adv_w = 128, .box_w = 8, .box_h = 7, .ofs_x = 0, .ofs_y = 3},
    {.bitmap_index = 1663, .adv_w = 93, .box_w = 6, .box_h = 8, .ofs_x = 0, .ofs_y = 2},
    {.bitmap_index = 1675, .adv_w = 112, .box_w = 8, .box_h = 13, .ofs_x = -1, .ofs_y = -2},
    {.bitmap_index = 1701, .adv_w = 109, .box_w = 6, .box_h = 12, .ofs_x = 0, .ofs_y = -2},
    {.bitmap_index = 1719, .adv_w = 115, .box_w = 8, .box_h = 9, .ofs_x = 0, .ofs_y = 2},
    {.bitmap_index = 1737, .adv_w = 109, .box_w = 7, .box_h = 9, .ofs_x = 0, .ofs_y = 2},
    {.bitmap_index = 1753, .adv_w = 131, .box_w = 9, .box_h = 11, .ofs_x = 0, .ofs_y = 3},
    {.bitmap_index = 1778, .adv_w = 109, .box_w = 7, .box_h = 7, .ofs_x = 0, .ofs_y = 3},
    {.bitmap_index = 1791, .adv_w = 90, .box_w = 6, .box_h = 8, .ofs_x = 0, .ofs_y = 2},
    {.bitmap_index = 1803, .adv_w = 166, .box_w = 11, .box_h = 9, .ofs_x = 0, .ofs_y = 3},
    {.bitmap_index = 1828, .adv_w = 122, .box_w = 8, .box_h = 8, .ofs_x = 0, .ofs_y = 2},
    {.bitmap_index = 1844, .adv_w = 106, .box_w = 7, .box_h = 13, .ofs_x = 0, .ofs_y = -2},
    {.bitmap_index = 1867, .adv_w = 138, .box_w = 9, .box_h = 8, .ofs_x = 0, .ofs_y = 3},
    {.bitmap_index = 1885, .adv_w = 116, .box_w = 7, .box_h = 15, .ofs_x = 0, .ofs_y = -1},
    {.bitmap_index = 1912, .adv_w = 77, .box_w = 3, .box_h = 13, .ofs_x = 1, .ofs_y = 1},
    {.bitmap_index = 1922, .adv_w = 107, .box_w = 7, .box_h = 15, .ofs_x = 0, .ofs_y = -1},
    {.bitmap_index = 1949, .adv_w = 188, .box_w = 11, .box_h = 5, .ofs_x = 0, .ofs_y = 5}
};
/*---------------------
 *  CHARACTER MAPPING
 *--------------------*/
/*Collect the unicode lists and glyph_id offsets*/
static const lv_font_fmt_txt_cmap_t brush_20_cmaps[] =
{
    {
        .range_start = 32, .range_length = 64, .glyph_id_start = 1,
        .unicode_list = NULL, .glyph_id_ofs_list = NULL, .list_length = 0, .type = LV_FONT_FMT_TXT_CMAP_FORMAT0_TINY
    },
    {
        .range_start = 97, .range_length = 30, .glyph_id_start = 65,
        .unicode_list = NULL, .glyph_id_ofs_list = NULL, .list_length = 0, .type = LV_FONT_FMT_TXT_CMAP_FORMAT0_TINY
    }
};
/*--------------------
 *  ALL CUSTOM DATA
 *--------------------*/
/*Store all the custom data of the font*/
static lv_font_fmt_txt_glyph_cache_t brush_20_cache;
static const lv_font_fmt_txt_dsc_t brush_20_font_dsc = {
    .glyph_bitmap = brush_20_glyph_bitmap,
    .glyph_dsc = brush_20_glyph_dsc,
    .cmaps = brush_20_cmaps,
    .kern_dsc = NULL,
    .kern_scale = 0,
    .cmap_num = 2,
    .bpp = 2,
    .kern_classes = 0,
    .bitmap_format = 0,
    .cache = &brush_20_cache
};
/*-----------------
 *  PUBLIC FONT
 *----------------*/
/*Initialize a public general font descriptor*/
const lv_font_t brush_20 = {
    .get_glyph_dsc = lv_font_get_glyph_dsc_fmt_txt,    /*Function pointer to get glyph's data*/
    .get_glyph_bitmap = lv_font_get_bitmap_fmt_txt,    /*Function pointer to get glyph's bitmap*/
    .line_height = 20,          /*The maximum line height required by the font*/
    .base_line = 4,             /*Baseline measured from the bottom of the line*/

    .subpx = LV_FONT_SUBPX_NONE,
    .underline_position = -1,
    .underline_thickness = 1,
    .dsc = &brush_20_font_dsc,          /*The custom font data. Will be accessed by `get_glyph_bitmap/dsc` */
};
#endif

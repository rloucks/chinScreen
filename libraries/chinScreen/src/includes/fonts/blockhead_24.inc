/*******************************************************************************
 * Size: 24 px
 * Bpp: 2
 ******************************************************************************/


#ifdef __has_include

    #if __has_include("lvgl.h")
         #ifndef LV_LVGL_H_INCLUDE_SIMPLE
             #define LV_LVGL_H_INCLUDE_SIMPLE
         #endif
     #endif
 #endif

 #ifdef LV_LVGL_H_INCLUDE_SIMPLE
     #include "lvgl.h"
 #else
     #include "../lvgl-8.3.11/lvgl.h"
 #endif

 #ifndef BLOCKHEAD_24
 #define BLOCKHEAD_24 1
 #endif

 #if BLOCKHEAD_24

/*-----------------
 *    BITMAPS
 *----------------*/
/*Store the image of the glyphs*/
static LV_ATTRIBUTE_LARGE_CONST const uint8_t blockhead_24_glyph_bitmap[] = {
    /* U+0020 " " */
    /* U+002F "/" */
    0x0, 0x0, 0x0, 0x2, 0xff, 0x80, 0xf, 0xff,
    0xf0, 0x19, 0x54, 0xf4, 0x26, 0x5, 0x78, 0x30,
    0x0, 0x3c, 0x53, 0x48, 0x25, 0x61, 0x0, 0x1,
    0x20, 0x40, 0x8, 0x11, 0xa4, 0x20, 0x8, 0x0,
    0x80, 0x2, 0xa5, 0x0,
    /* U+0030 "0" */
    0x0, 0x55, 0x40, 0x0, 0xff, 0xf8, 0x0, 0xbf,
    0xff, 0xc0, 0xb9, 0xfb, 0xf4, 0x28, 0x0, 0x3e,
    0x6, 0xa0, 0x97, 0xc2, 0x51, 0x10, 0xe1, 0x55,
    0x48, 0x15, 0x50, 0x40, 0x4, 0x49, 0x3f, 0x41,
    0x80, 0xba, 0xb6, 0x40, 0x3c, 0x4b, 0xc0, 0x3,
    0xff, 0x80, 0x0, 0x15, 0x0, 0x0,
    /* U+0031 "1" */
    0x0, 0x3, 0xe0, 0x0, 0x16, 0xff, 0x0, 0x2f,
    0xff, 0xc0, 0x2f, 0xfb, 0xf0, 0xf, 0xe0, 0xfc,
    0x6, 0x0, 0x1f, 0x1, 0xb8, 0xab, 0xd0, 0x99,
    0x88, 0xa4, 0x29, 0x85, 0x85, 0xd, 0x24, 0x1,
    0x80, 0x85, 0x2, 0x80, 0x20, 0x1, 0x80, 0x3,
    0x42, 0x80, 0x0, 0x2a, 0x40, 0x0,
    /* U+0032 "2" */
    0x0, 0x15, 0x0, 0x0, 0x60, 0x24, 0x0, 0x10,
    0x0, 0x40, 0x20, 0x0, 0x20, 0x8, 0x0, 0x4,
    0x1, 0x50, 0xa0, 0x42, 0x45, 0x14, 0x65, 0x51,
    0x80, 0x19, 0x24, 0x69, 0x5, 0x45, 0x7f, 0xd2,
    0x40, 0x58, 0x14, 0x80, 0x10, 0x0, 0x50, 0x1,
    0x40, 0x50, 0x0, 0x1, 0x0, 0x0,
    /* U+0033 "3" */
    0x0, 0x0, 0x0, 0x0, 0x2f, 0xe0, 0x0, 0x7f,
    0xff, 0x40, 0x7f, 0xff, 0xf4, 0x2f, 0xbe, 0x7f,
    0x2, 0x50, 0x4f, 0xc1, 0x40, 0x2, 0xe1, 0x45,
    0x48, 0x78, 0x50, 0x82, 0x5, 0x4c, 0x24, 0x0,
    0x40, 0x40, 0x10, 0x90, 0x21, 0x60, 0x80, 0x5,
    0x0, 0x80, 0x0, 0x2a, 0x80, 0x0,
    /* U+0034 "4" */
    0x0, 0x7, 0xc0, 0x0, 0xf, 0xf0, 0x0, 0x1f,
    0xf0, 0x2, 0xff, 0xe0, 0xb, 0xfb, 0xf0, 0xa,
    0x2, 0xf8, 0x1a, 0x46, 0xb8, 0x62, 0xa0, 0x7e,
    0x49, 0x93, 0x45, 0x29, 0x85, 0x41, 0x4, 0x40,
    0x10, 0x8, 0x10, 0x10, 0x4, 0x0, 0x40, 0x1,
    0x95, 0x0,
    /* U+0035 "5" */
    0x0, 0x2b, 0x90, 0x0, 0x3, 0xff, 0xf0, 0x0,
    0x3f, 0xff, 0xe0, 0x2, 0xfa, 0xff, 0xf0, 0xe,
    0x40, 0x1f, 0xc0, 0x34, 0x1, 0x7f, 0x82, 0xc8,
    0x8, 0x7e, 0xf, 0x14, 0x31, 0xfc, 0x3c, 0x24,
    0x3, 0xf0, 0xf0, 0x0, 0x2f, 0xc2, 0xd2, 0x50,
    0xfe, 0x0, 0x80, 0xb, 0xd0, 0x0, 0x56, 0x80,
    0x0,
    /* U+0036 "6" */
    0x0, 0x6a, 0x80, 0x0, 0x90, 0x9, 0x0, 0x50,
    0x40, 0x80, 0x20, 0x0, 0x14, 0x6, 0xc7, 0x81,
    0x5, 0x0, 0x0, 0x45, 0x29, 0x30, 0x65, 0x42,
    0x0, 0x1, 0x30, 0x88, 0x0, 0x84, 0xbf, 0xc1,
    0x80, 0x6a, 0xb0, 0x40, 0x20, 0x40, 0x80, 0x2,
    0x0, 0x80, 0x0, 0x15, 0x40, 0x0,
    /* U+0037 "7" */
    0x0, 0x16, 0x90, 0x0, 0x0, 0xff, 0xfe, 0x0,
    0x3, 0xff, 0xff, 0x80, 0x6, 0x0, 0x0, 0xc0,
    0xb, 0xbe, 0xfe, 0xc0, 0x2c, 0xfd, 0xbc, 0xe4,
    0x44, 0x65, 0x24, 0x88, 0x54, 0x1, 0x0, 0x88,
    0x1c, 0x6, 0x90, 0xa0, 0x1, 0x0, 0x0, 0x80,
    0x2, 0x0, 0x2, 0x40, 0x0, 0x6a, 0xa8, 0x0,
    /* U+0038 "8" */
    0x1, 0xaf, 0x80, 0x2, 0xff, 0xfd, 0x0, 0xd0,
    0x1, 0x80, 0x31, 0x5, 0x60, 0x8, 0x0, 0x18,
    0x6, 0x34, 0x56, 0x84, 0x81, 0x0, 0x50, 0xa0,
    0x0, 0x24, 0x8, 0x15, 0x10, 0x0, 0x40, 0x8,
    0x0, 0x15, 0x54, 0x0,
    /* U+0039 "9" */
    0x1, 0xaf, 0xa4, 0x2, 0xff, 0xef, 0x0, 0xe5,
    0x1, 0xe0, 0x71, 0x1, 0x28, 0x18, 0x4, 0x2,
    0xa, 0x11, 0x20, 0x84, 0x85, 0x4, 0x29, 0x20,
    0x50, 0x19, 0x18, 0x0, 0x6, 0x82, 0x5, 0x41,
    0x40, 0x10, 0x0, 0x80, 0x1, 0x5a, 0x80,
    /* U+003A ":" */
    0x0, 0x0, 0x0, 0x0, 0xb, 0x59, 0x0, 0x7,
    0xe0, 0x18, 0x0, 0xfd, 0x0, 0x40, 0xe, 0x0,
    0xd2, 0x0, 0x86, 0xde, 0x20, 0x54, 0xfe, 0x42,
    0x84, 0x40, 0x40, 0x18, 0x28, 0x0, 0x3, 0x0,
    0x85, 0x4, 0x50, 0x1, 0x0, 0x8, 0x0, 0x1a,
    0xaa, 0x0,
    /* U+003B ";" */
    0x0, 0x0, 0x0, 0x0, 0x6f, 0xf4, 0x2, 0xff,
    0xff, 0x80, 0x3f, 0xff, 0xf0, 0x8, 0x11, 0x7d,
    0x1, 0x90, 0x9f, 0x42, 0x50, 0x12, 0xd1, 0x44,
    0x8, 0x58, 0x50, 0x40, 0x5, 0x8, 0x0, 0x1,
    0x40, 0x85, 0x42, 0x0, 0x14, 0x2, 0x0, 0x1,
    0xa9, 0x0, 0x0, 0x0, 0x0, 0x0,
    /* U+003C "<" */
    0x0, 0x14, 0x0, 0x6, 0xff, 0x40, 0x1f, 0xff,
    0xf4, 0x1f, 0xbe, 0xb8, 0x18, 0x0, 0x3c, 0x15,
    0x46, 0x3c, 0x61, 0x11, 0x29, 0x61, 0x42, 0x15,
    0x60, 0x50, 0x1, 0x10, 0x44, 0x14, 0x4, 0x10,
    0x40, 0x1, 0x1, 0x40, 0x0, 0x10, 0x0,
    /* U+003D "=" */
    0x0, 0x0, 0x0, 0x0, 0x7f, 0xe0, 0x0, 0x7f,
    0xff, 0x0, 0x3b, 0xfe, 0xe0, 0x8, 0x4, 0x3c,
    0x5, 0x91, 0x97, 0x2, 0x11, 0x20, 0x91, 0x80,
    0x44, 0x18, 0x50, 0x40, 0x6, 0x9, 0x4, 0x6,
    0x0, 0x86, 0x42, 0x0, 0x28, 0x2, 0x0, 0x1,
    0xae, 0x0, 0x0,
    /* U+003E ">" */
    0x0, 0x6a, 0x40, 0x0, 0x2f, 0xff, 0x0, 0x7,
    0xff, 0xfc, 0x0, 0xfb, 0xbf, 0xc0, 0xc, 0x0,
    0x3d, 0x3, 0x94, 0x15, 0xe0, 0x78, 0x92, 0x46,
    0xc3, 0x82, 0x0, 0x2c, 0x78, 0x0, 0xf, 0x87,
    0xc5, 0x82, 0xfc, 0xa, 0x0, 0x7d, 0x0, 0xa,
    0xa4, 0x0,
    /* U+003F "?" */
    0x0, 0xbf, 0x80, 0x2, 0xff, 0xfc, 0x1, 0xff,
    0xff, 0xc0, 0x7f, 0xff, 0xf8, 0x9, 0x44, 0x6e,
    0x1, 0x50, 0x97, 0x82, 0x50, 0x30, 0xe1, 0x55,
    0x0, 0x25, 0x24, 0x50, 0x1, 0x45, 0x0, 0x42,
    0x80, 0x81, 0x42, 0x0, 0x18, 0x6, 0x0, 0x0,
    0xa9, 0x0, 0x0,
    /* U+0040 "@" */
    0x0, 0x0, 0x0, 0x0, 0x2f, 0x80, 0x0, 0x3f,
    0xfd, 0x0, 0x2b, 0xbf, 0xe0, 0x24, 0x5, 0xfc,
    0xc, 0x41, 0x6e, 0x46, 0x20, 0x54, 0x10, 0x84,
    0x10, 0x14, 0x12, 0x40, 0x39, 0x4, 0x0, 0x18,
    0x1, 0x45, 0x8, 0x0, 0x20, 0x8, 0x0, 0x1,
    0xa8, 0x0, 0x0,
    /* U+0041 "A" */
    0x0, 0x5, 0x44, 0x0, 0x1, 0xff, 0xfe, 0x0,
    0xff, 0xff, 0xfd, 0x7, 0xff, 0xff, 0xfc, 0x3f,
    0xfe, 0x6f, 0xf4, 0xf9, 0x0, 0x2, 0xe3, 0xd1,
    0x1, 0x8b, 0x8f, 0x50, 0x0, 0x1d, 0x2d, 0x24,
    0x24, 0x74, 0x64, 0x44, 0x41, 0x22, 0x50, 0x20,
    0x5, 0x42, 0x41, 0xa4, 0x10, 0x2, 0x0, 0x0,
    0x40, 0x6, 0xa5, 0xa4, 0x0,
    /* U+0042 "B" */
    0x0, 0x0, 0x0, 0x0, 0x15, 0x59, 0x40, 0x5,
    0x40, 0x6, 0x0, 0x80, 0x0, 0x14, 0x20, 0x0,
    0x4, 0x82, 0x1a, 0xaa, 0x48, 0x24, 0x60, 0x81,
    0x41, 0x80, 0x0, 0x38, 0x58, 0x94, 0x82, 0x52,
    0x80, 0x40, 0x28, 0x8, 0x4, 0x2, 0x0, 0x81,
    0x54, 0x10, 0x5, 0x0, 0x8, 0x0, 0x1a, 0xaa,
    0x0,
    /* U+0043 "C" */
    0x0, 0xbf, 0xd0, 0x7, 0xff, 0xf4, 0xf, 0xff,
    0xf8, 0x2d, 0x7f, 0xf4, 0x39, 0x46, 0xb8, 0x3e,
    0xaa, 0xb4, 0x19, 0x66, 0x20, 0x58, 0x25, 0x28,
    0x24, 0x11, 0x7c, 0x4, 0x20, 0x20, 0x4, 0x0,
    0x10, 0x8, 0x18, 0x40, 0x4, 0x0, 0x40, 0x2,
    0xaa, 0x40,
    /* U+0044 "D" */
    0x0, 0x1a, 0x90, 0x0, 0xf, 0xff, 0xc0, 0x3,
    0xff, 0xff, 0x0, 0xff, 0xff, 0xf8, 0x1f, 0xf7,
    0xff, 0xc2, 0xe9, 0x15, 0xbc, 0x39, 0x41, 0x47,
    0xc3, 0x84, 0x14, 0x7c, 0x39, 0x90, 0x85, 0x87,
    0x41, 0x0, 0x24, 0x78, 0x20, 0x1, 0xc7, 0x81,
    0x40, 0xf8, 0xbc, 0x0, 0x1f, 0x82, 0xf4, 0x7,
    0xe0, 0x0, 0x69, 0x0, 0x0, 0x0, 0x0, 0x0,
    /* U+0045 "E" */
    0x0, 0x0, 0x0, 0x0, 0x15, 0x99, 0x40, 0x4,
    0x0, 0x5, 0x0, 0x44, 0x4, 0x20, 0x11, 0x8,
    0x20, 0x41, 0x15, 0x65, 0x48, 0x20, 0x0, 0x4,
    0x41, 0x14, 0x5, 0x4, 0x24, 0x0, 0x2, 0x80,
    0x46, 0x4c, 0x21, 0x54, 0x4, 0x1, 0x81, 0x10,
    0x40, 0x54, 0x26, 0xa, 0x8, 0x80, 0x78, 0x7,
    0xe0, 0x0, 0x7f, 0xd0, 0x0, 0x0, 0x0, 0x0,
    /* U+0046 "F" */
    0x0, 0x5e, 0x80, 0x0, 0xbf, 0xf8, 0x0, 0xff,
    0xff, 0xc0, 0x7f, 0xff, 0xf8, 0x2d, 0x40, 0x5f,
    0x7, 0x50, 0x17, 0xc2, 0x84, 0x4, 0xe1, 0x60,
    0x42, 0x21, 0x58, 0x90, 0x9, 0x45, 0xa, 0x2,
    0x80, 0x81, 0x50, 0x80, 0x20, 0x0, 0x10, 0x1,
    0x0, 0x20, 0x0, 0x2a, 0xa0, 0x0,
    /* U+0047 "G" */
    0x0, 0x3f, 0x80, 0x0, 0x3f, 0xfc, 0x0, 0xbf,
    0xff, 0x80, 0xbd, 0xbf, 0xf4, 0x3d, 0xb, 0xff,
    0xf, 0x0, 0x57, 0x82, 0xc0, 0x65, 0xd1, 0x7a,
    0x56, 0x38, 0x6a, 0xb2, 0x69, 0x52, 0x15, 0x12,
    0x41, 0x80, 0x40, 0x90, 0x20, 0xa4, 0x20, 0x5,
    0x0, 0x10, 0x0, 0x64, 0x24, 0x0, 0x1, 0x50,
    0x0,
    /* U+0048 "H" */
    0x0, 0x1b, 0xc0, 0x0, 0x3f, 0xef, 0xe0, 0xf,
    0xff, 0xff, 0x40, 0xff, 0xff, 0xf8, 0x2f, 0xff,
    0xff, 0xc3, 0xfe, 0x13, 0xfd, 0x7f, 0x0, 0x1b,
    0xf7, 0xf1, 0x6, 0x3e, 0x7a, 0x24, 0x2, 0x93,
    0x20, 0x50, 0x1d, 0x3e, 0x0, 0x3, 0xd0, 0xf0,
    0xa4, 0x74, 0x0, 0x0, 0x4, 0x0, 0x0, 0x0,
    0x0, 0x0, 0x0, 0x0, 0x0,
    /* U+0049 "I" */
    0x0, 0x0, 0x0, 0x0, 0xb, 0xff, 0x40, 0x3,
    0xff, 0xfd, 0x0, 0xbf, 0xff, 0xf0, 0x1f, 0xff,
    0xff, 0x42, 0xfe, 0xef, 0xfc, 0x3a, 0x81, 0x9f,
    0xc3, 0x44, 0x4, 0xfc, 0x75, 0x61, 0x8f, 0xc7,
    0x41, 0x0, 0xfc, 0x78, 0x10, 0xf, 0xcb, 0xc1,
    0x50, 0xfc, 0xbd, 0x0, 0x2f, 0xc3, 0xf9, 0x5a,
    0xf4, 0x0, 0x0, 0x10, 0x0,
    /* U+004A "J" */
    0x0, 0x15, 0x40, 0x0, 0x3f, 0xfe, 0x40, 0x7,
    0xff, 0xfc, 0x1, 0xff, 0xff, 0xf0, 0x1e, 0x4,
    0x1f, 0x2, 0xc8, 0x9, 0xb4, 0x28, 0x40, 0x4b,
    0x5, 0x4d, 0x4c, 0x54, 0x54, 0x10, 0x2, 0x42,
    0x2, 0x80, 0x14, 0x4, 0x91, 0x45, 0x0, 0x81,
    0x40, 0x80, 0x5, 0x0, 0x20, 0x0, 0xa, 0xa8,
    0x0, 0x0, 0x0, 0x0, 0x0,
    /* U+004B "K" */
    0x0, 0x0, 0x0, 0x0, 0x1f, 0xf8, 0x0, 0x2f,
    0xff, 0xc0, 0x2f, 0xff, 0xf4, 0x2e, 0x1f, 0xfe,
    0xf, 0x40, 0xbf, 0x83, 0xec, 0x1d, 0xe0, 0xe0,
    0x55, 0xb8, 0x49, 0x68, 0xce, 0x17, 0x59, 0x46,
    0x41, 0x58, 0x14, 0x50, 0x10, 0x90, 0x20, 0x4,
    0x0, 0x4, 0x1, 0x5, 0x4, 0x0, 0x10, 0x4,
    0x0, 0x1, 0x54, 0x0,
    /* U+004C "L" */
    0x0, 0xbf, 0x90, 0x0, 0xff, 0xfd, 0x0, 0xff,
    0xff, 0xd0, 0xbf, 0xfe, 0x7c, 0x3f, 0xf4, 0x1f,
    0x4a, 0x0, 0x3, 0xd2, 0x58, 0x14, 0xb1, 0x46,
    0x82, 0x15, 0x50, 0x10, 0x46, 0x88, 0x19, 0x1,
    0x20, 0x44, 0x10, 0x90, 0x21, 0xa0, 0x10, 0x1,
    0x0, 0x10, 0x0, 0x15, 0x50, 0x0,
    /* U+004D "M" */
    0x1, 0xaa, 0xa0, 0x0, 0x7f, 0xff, 0xd0, 0xa,
    0x55, 0x6b, 0x0, 0xc0, 0x0, 0x30, 0x8, 0x0,
    0x3, 0x1, 0x84, 0x4, 0x29, 0x49, 0x94, 0x92,
    0x25, 0x40, 0x40, 0x25, 0x14, 0x5, 0x2, 0x0,
    0x41, 0xf0, 0x20, 0x4, 0x5, 0x1, 0x0, 0x40,
    0x0, 0x10, 0x6, 0xa9, 0x54, 0x0,
    /* U+004E "N" */
    0x0, 0x0, 0x0, 0x0, 0x2f, 0xff, 0x0, 0x7f,
    0xff, 0xc0, 0x3e, 0xbf, 0xa0, 0xd, 0x0, 0x2d,
    0x3, 0x10, 0x7, 0x42, 0x95, 0xe9, 0xe1, 0x26,
    0x13, 0x34, 0x19, 0x61, 0x69, 0x5, 0x5, 0x2,
    0x40, 0x41, 0x54, 0x40, 0x10, 0x0, 0x10, 0x8,
    0x0, 0x8, 0x0, 0xaa, 0xa8, 0x0,
    /* U+004F "O" */
    0x1, 0x42, 0x81, 0x0, 0x69, 0x65, 0x9a, 0x42,
    0x59, 0x56, 0x66, 0x15, 0x65, 0x59, 0x68, 0x15,
    0x89, 0xaa, 0x80, 0xa8, 0x11, 0x6e, 0x0, 0xd0,
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    0x0,
    /* U+0050 "P" */
    0x0, 0x1, 0x0, 0x0, 0x3, 0xfe, 0x0, 0x1,
    0xff, 0xf4, 0x0, 0xff, 0xff, 0x80, 0x3f, 0xff,
    0xff, 0x7, 0xff, 0xd3, 0xf0, 0x3f, 0xf4, 0xf,
    0x3, 0xd9, 0x4, 0x70, 0x28, 0x0, 0x7, 0x6,
    0x88, 0x58, 0x58, 0x48, 0x10, 0x4, 0x82, 0x80,
    0x40, 0xb4, 0x8, 0x1, 0x8, 0x0, 0x10, 0x50,
    0x40, 0x1, 0x0, 0x20, 0x0, 0x6, 0xa4, 0x0,
    /* U+0051 "Q" */
    0x0, 0xff, 0x40, 0x3, 0xff, 0xfc, 0x1, 0xff,
    0xff, 0x80, 0x7f, 0xff, 0xf4, 0x8, 0x40, 0x6e,
    0x1, 0x0, 0xb, 0x82, 0x69, 0xf5, 0xe1, 0x49,
    0x8, 0x15, 0x50, 0x41, 0x5, 0x48, 0x28, 0x0,
    0x11, 0x0, 0x0, 0x90, 0x11, 0x50, 0x40, 0x8,
    0x0, 0x10, 0x0, 0x5a, 0x90, 0x0,
    /* U+0052 "R" */
    0x0, 0xa9, 0x0, 0x0, 0xff, 0xe0, 0x0, 0xbe,
    0xff, 0x40, 0x3f, 0xff, 0xf0, 0xc, 0x0, 0x3d,
    0x2, 0x90, 0xa7, 0x42, 0x40, 0x10, 0xd1, 0x58,
    0x48, 0x24, 0x50, 0x40, 0x5, 0x8, 0x8, 0x1,
    0x40, 0x45, 0x51, 0x0, 0x20, 0x40, 0x80, 0x2,
    0x41, 0x80, 0x0, 0x1a, 0x40, 0x0,
    /* U+0053 "S" */
    0x0, 0x54, 0x40, 0x0, 0x40, 0x4, 0x0, 0x40,
    0x0, 0x40, 0x10, 0x0, 0x10, 0x5, 0x81, 0x84,
    0x9, 0x10, 0x12, 0x45, 0x49, 0x8, 0x95, 0x10,
    0x40, 0x21, 0x54, 0x7e, 0x9, 0x2, 0x3f, 0xe2,
    0x0, 0x86, 0x51, 0x40, 0x8, 0x0, 0x80, 0x0,
    0x6a, 0x40, 0x0,
    /* U+0054 "T" */
    0x0, 0x5, 0x0, 0x0, 0x7f, 0xf8, 0x0, 0x7f,
    0xff, 0x80, 0x3f, 0xff, 0xf4, 0x1f, 0x7b, 0xbe,
    0xa, 0x50, 0x5b, 0xc3, 0x54, 0x14, 0xf1, 0x50,
    0x4, 0x21, 0x54, 0x10, 0x1, 0x49, 0x4, 0x1,
    0x80, 0x42, 0x80, 0xf0, 0x20, 0x0, 0xfd, 0x2,
    0x41, 0xad, 0x0, 0x5, 0x0, 0x0,
    /* U+0055 "U" */
    0x0, 0x0, 0x0, 0x0, 0x6, 0xa9, 0x0, 0x2,
    0x40, 0x8, 0x0, 0x50, 0x0, 0x70, 0x8, 0x14,
    0xf, 0x40, 0x54, 0x14, 0xf4, 0x24, 0x0, 0xf,
    0x45, 0x9, 0x24, 0x44, 0x50, 0x40, 0x1, 0x42,
    0x8, 0x40, 0x4, 0x11, 0x10, 0x45, 0x1, 0x12,
    0x44, 0x40, 0x4, 0x0, 0x4, 0x0, 0x10, 0x5,
    0x0, 0x0, 0x15, 0x0, 0x0,
    /* U+0056 "V" */
    0x0, 0xbf, 0x80, 0x0, 0xff, 0xf8, 0x0, 0x7f,
    0xff, 0x0, 0x30, 0x50, 0xe0, 0x9, 0x42, 0x5c,
    0x5, 0x0, 0x7, 0x2, 0x9, 0x30, 0xd1, 0x41,
    0x40, 0x14, 0x50, 0x20, 0x5, 0x8, 0x9, 0x6,
    0x40, 0x4b, 0xc2, 0x0, 0x20, 0x50, 0x40, 0x2,
    0x0, 0x80, 0x0, 0x15, 0x40, 0x0,
    /* U+0057 "W" */
    0x0, 0x0, 0x0, 0x0, 0x1, 0xff, 0xf4, 0x0,
    0x1f, 0xff, 0xf4, 0x0, 0xff, 0xff, 0xf0, 0xb,
    0xdd, 0xff, 0xc0, 0x2c, 0x0, 0xaf, 0x40, 0x96,
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    0x0,
    /* U+0058 "X" */
    0x0, 0x14, 0x0, 0x0, 0x7f, 0xf8, 0x0, 0xff,
    0xff, 0xc0, 0x7f, 0xaf, 0xf8, 0x3c, 0x0, 0x7f,
    0xe, 0x0, 0x7, 0xc3, 0x6c, 0x38, 0xf1, 0x55,
    0x48, 0x31, 0x50, 0x41, 0x8, 0x48, 0x36, 0x42,
    0x10, 0x5a, 0xa0, 0x80, 0x20, 0x40, 0x80, 0x5,
    0x0, 0x90, 0x0, 0x5a, 0x80, 0x0, 0x0, 0x0,
    0x0,
    /* U+0059 "Y" */
    0x0, 0x6, 0xa4, 0x0, 0x0, 0x7, 0xff, 0xe0,
    0x0, 0xb, 0xff, 0xfc, 0x0, 0x3, 0xff, 0xff,
    0x80, 0x2, 0xf9, 0xa, 0xf8, 0x2, 0xf1, 0x2,
    0x3f, 0x83, 0xfc, 0x84, 0xcb, 0xf5, 0xfe, 0x11,
    0x10, 0xfc, 0x3f, 0x40, 0x40, 0x2f, 0xf, 0x80,
    0x0, 0x45, 0x0, 0x10, 0x6, 0x2, 0x0, 0x2,
    0x0, 0x0, 0x40, 0x0, 0x6a, 0xa9, 0x40, 0x0,
    /* U+005A "Z" */
    0x0, 0x54, 0x0, 0x7, 0xff, 0x80, 0x1f, 0xff,
    0xe0, 0x3f, 0x97, 0xf4, 0x3c, 0x0, 0xbc, 0x34,
    0x0, 0x3c, 0x31, 0x1, 0x1c, 0x30, 0x11, 0x1c,
    0x60, 0x11, 0x5, 0x60, 0x20, 0x15, 0x10, 0x10,
    0x10, 0x4, 0x54, 0x10, 0x4, 0x0, 0x40, 0x1,
    0x1, 0x0, 0x0, 0x0, 0x0,
    /* U+0061 "a" */
    0x0, 0x0, 0x0, 0x0, 0x14, 0x50, 0x0, 0x40,
    0x0, 0x40, 0x20, 0x0, 0x30, 0x8, 0x1, 0x4c,
    0x5, 0x36, 0x57, 0x5, 0x16, 0x41, 0x94, 0x85,
    0x44, 0x1c, 0x10, 0x14, 0x1, 0x4, 0x5, 0x40,
    0x42, 0x0, 0x0, 0x10, 0x40, 0x0, 0x20, 0x6,
    0xaa, 0xa0, 0x0,
    /* U+0062 "b" */
    0x0, 0x0, 0x0, 0x0, 0x1, 0xaa, 0xa0, 0x0,
    0x19, 0x6a, 0x64, 0x1, 0x96, 0xa6, 0xf0, 0x9,
    0x16, 0xea, 0xa0, 0x30, 0x5, 0x91, 0x80, 0xc0,
    0x0, 0x6, 0x2, 0x28, 0x4a, 0x28, 0x58, 0x44,
    0x14, 0x95, 0x60, 0x14, 0x2, 0x81, 0x80, 0x0,
    0x4, 0x0, 0x81, 0x50, 0x40, 0x1, 0x80, 0x4,
    0x0, 0x0, 0xaa, 0x80, 0x0,
    /* U+0063 "c" */
    0x1, 0x6e, 0x40, 0x1, 0xff, 0xfd, 0x1, 0xff,
    0xff, 0xc0, 0xbe, 0x7, 0xf8, 0x3d, 0x0, 0x3f,
    0xd, 0x90, 0xa3, 0xc3, 0x40, 0x0, 0xf1, 0x85,
    0x48, 0x25, 0x50, 0x84, 0x0, 0x48, 0x4, 0x1,
    0x80, 0x45, 0x91, 0x80, 0x20, 0x0, 0x80, 0x2,
    0xaa, 0x80, 0x0, 0x0, 0x0, 0x0,
    /* U+0064 "d" */
    0x4, 0x0, 0x28, 0x3f, 0x0, 0x7e, 0x3f, 0xff,
    0xfe, 0x1f, 0xff, 0xf8, 0xf, 0xef, 0xf8, 0x2e,
    0x41, 0xbc, 0x25, 0x1, 0x6c, 0x66, 0x42, 0x19,
    0x60, 0x21, 0x6, 0x50, 0x0, 0x2, 0x14, 0x38,
    0x24, 0x8, 0x34, 0x10, 0x2, 0x46, 0x40, 0x0,
    0x14, 0x0,
    /* U+0065 "e" */
    0x0, 0x6a, 0x80, 0x0, 0x80, 0x8, 0x0, 0x85,
    0x50, 0x80, 0x20, 0x11, 0x4, 0x5, 0x81, 0x81,
    0x9, 0x0, 0x1, 0x46, 0x9, 0x8, 0xa1, 0x40,
    0x40, 0x25, 0x60, 0x24, 0x5, 0x4, 0x0, 0x42,
    0x40, 0x86, 0x81, 0x0, 0x14, 0x0, 0x40, 0x0,
    0x95, 0x40, 0x0, 0x0, 0x0, 0x0,
    /* U+0066 "f" */
    0x0, 0x0, 0x0, 0x0, 0x7, 0xfe, 0x0, 0x2,
    0xff, 0xfc, 0x0, 0x7f, 0xff, 0xe0, 0xf, 0xff,
    0xff, 0x1, 0xe2, 0x7b, 0xf4, 0x1c, 0x40, 0x5f,
    0x43, 0xc8, 0x4, 0xb8, 0x7c, 0x50, 0x8b, 0xdb,
    0xc2, 0x0, 0xbe, 0xbc, 0x0, 0xf, 0xe7, 0xc1,
    0x40, 0xfd, 0xa, 0x0, 0x2e, 0x0, 0x5, 0x54,
    0x0,
    /* U+0067 "g" */
    0x0, 0x10, 0x0, 0x0, 0x2f, 0xd5, 0x0, 0xb,
    0xff, 0xfc, 0x3, 0xff, 0xff, 0xc0, 0x3f, 0xff,
    0xff, 0x41, 0xfe, 0x2, 0xfc, 0x5, 0x2, 0x5f,
    0x82, 0x54, 0x12, 0xf0, 0x52, 0x93, 0x14, 0x45,
    0x8, 0x0, 0x44, 0x30, 0x90, 0x1, 0x41, 0x0,
    0x11, 0xd0, 0x4, 0x64, 0x20, 0x0, 0x90, 0x9,
    0x0, 0x1, 0xfa, 0x0, 0x0,
    /* U+0068 "h" */
    0x0, 0x55, 0x80, 0x0, 0x80, 0x8, 0x0, 0x40,
    0x0, 0x80, 0x10, 0x0, 0x20, 0xe, 0x86, 0xa8,
    0x9, 0x5a, 0xb, 0x45, 0x55, 0x56, 0x44, 0xaa,
    0x9, 0x61, 0x20, 0xe8, 0xa, 0x4, 0xff, 0xc2,
    0x1, 0x25, 0xa0, 0x40, 0x20, 0x0, 0x80, 0x6,
    0x41, 0x80, 0x0, 0x5, 0x0, 0x0,
    /* U+0069 "i" */
    0x0, 0xbf, 0x80, 0x1, 0xff, 0xfd, 0x0, 0xff,
    0xff, 0xc0, 0x7a, 0x7a, 0xb4, 0x18, 0x41, 0x5d,
    0x5, 0x50, 0x13, 0x42, 0x18, 0x14, 0xe1, 0x41,
    0x45, 0x11, 0x60, 0x50, 0x0, 0x48, 0x4, 0x2,
    0x80, 0x9, 0x60, 0x40, 0x20, 0x0, 0x80, 0x2,
    0x40, 0x80, 0x0, 0x1a, 0x40, 0x0,
    /* U+006A "j" */
    0x0, 0x5, 0x0, 0x0, 0xb, 0xff, 0x40, 0x3,
    0xff, 0xfd, 0x0, 0xbf, 0xff, 0xf0, 0xf, 0xff,
    0xff, 0x41, 0xd4, 0x42, 0xf8, 0x29, 0x81, 0x8f,
    0xc3, 0x84, 0x4, 0xbc, 0x38, 0x91, 0x40, 0x97,
    0x81, 0x0, 0xe, 0xb8, 0x0, 0x2, 0xe7, 0xc1,
    0x80, 0xfe, 0x2f, 0x0, 0x3f, 0xd0, 0x6, 0x95,
    0x50,
    /* U+006B "k" */
    0x0, 0x0, 0x0, 0x0, 0x6, 0xff, 0xe8, 0x0,
    0xff, 0xff, 0xfc, 0xf, 0xff, 0xff, 0xf8, 0x7f,
    0xff, 0xff, 0xf0, 0xff, 0xff, 0x8f, 0xc0, 0x94,
    0x5, 0x2e, 0x19, 0x14, 0x14, 0x34, 0x55, 0x50,
    0x14, 0x55, 0x11, 0x91, 0x11, 0x11, 0x40, 0x85,
    0xa, 0x2, 0x3, 0x80, 0x50, 0x5, 0xf, 0x5,
    0x0, 0x1, 0x6a, 0x90, 0x0,
    /* U+006C "l" */
    0x0, 0xbf, 0x90, 0x1, 0xff, 0xfe, 0x0, 0xff,
    0xff, 0xd0, 0xbf, 0xff, 0xfc, 0x2e, 0xba, 0x6b,
    0x5, 0x0, 0x16, 0x85, 0x89, 0x44, 0x91, 0x54,
    0xc4, 0x59, 0x11, 0x54, 0x2, 0x4, 0x5, 0x40,
    0x40, 0x40, 0x0, 0x40, 0xa, 0xa5, 0x40,
    /* U+006D "m" */
    0x0, 0x7d, 0x0, 0x2, 0xff, 0xe0, 0x3, 0xff,
    0xf0, 0xb, 0xff, 0xf0, 0x7, 0xfe, 0xf0, 0x8,
    0x0, 0x10, 0x18, 0x40, 0x14, 0x54, 0x51, 0x15,
    0x50, 0x54, 0x5, 0x20, 0x0, 0x8, 0x10, 0x96,
    0x44, 0x4, 0x55, 0x14, 0x6, 0x55, 0xa0, 0x0,
    0x14, 0x0,
    /* U+006E "n" */
    0x0, 0x1a, 0x40, 0x0, 0xb, 0xff, 0x0, 0x2,
    0xff, 0xfc, 0x0, 0x3f, 0xff, 0xd0, 0xf, 0xea,
    0xef, 0x2, 0xd0, 0x5, 0xbc, 0x3c, 0x0, 0x43,
    0xdb, 0xc1, 0x4, 0x3e, 0x3c, 0x4, 0x7, 0xd3,
    0xc0, 0x40, 0x2c, 0x6, 0x0, 0x5, 0x0, 0xa,
    0xa9, 0x40,
    /* U+006F "o" */
    0x0, 0x0, 0x0, 0x0, 0x6f, 0xf5, 0x0, 0xbf,
    0xff, 0xd0, 0x7f, 0xff, 0xf8, 0x2e, 0xbb, 0xee,
    0x2, 0x50, 0x97, 0x81, 0x80, 0x1, 0xe0, 0x56,
    0x9, 0x25, 0x14, 0x10, 0x1, 0x49, 0x8, 0x0,
    0x50, 0x83, 0xc0, 0x90, 0x20, 0xf0, 0x80, 0x2,
    0x91, 0x80, 0x0, 0x5, 0x0, 0x0,
    /* U+0070 "p" */
    0x0, 0x0, 0x0, 0x0, 0xbf, 0xf0, 0x0, 0xbf,
    0xff, 0x80, 0xbf, 0xbb, 0xf4, 0x1c, 0x0, 0xfd,
    0x5, 0x50, 0x4b, 0x42, 0x40, 0x2, 0xd1, 0x44,
    0x48, 0x58, 0x51, 0x41, 0x5, 0x18, 0x28, 0x0,
    0x40, 0x40, 0x22, 0xd0, 0x20, 0x90, 0xb8, 0x2,
    0x1, 0x8f, 0x0, 0x1a, 0x40, 0x0,
    /* U+0071 "q" */
    0x0, 0x6e, 0x40, 0x0, 0xff, 0xf8, 0x0, 0xd6,
    0xa7, 0x40, 0x20, 0x0, 0x60, 0x18, 0x0, 0x1c,
    0x9, 0x50, 0x53, 0x6, 0x55, 0x14, 0xe1, 0x80,
    0x40, 0x14, 0x60, 0x10, 0x5, 0x8, 0x4, 0x2,
    0x40, 0x45, 0x92, 0x0, 0x20, 0x1, 0x40, 0x2,
    0x96, 0x40, 0x0, 0x4, 0x0, 0x0,
    /* U+0072 "r" */
    0x0, 0x5, 0x0, 0x0, 0xb, 0xff, 0x40, 0x3,
    0xff, 0xfc, 0x0, 0x7f, 0xff, 0xf0, 0xb, 0xff,
    0xff, 0x0, 0xe9, 0x6a, 0xf4, 0x1c, 0x41, 0x4f,
    0x83, 0xcc, 0x8, 0xbc, 0x7c, 0x10, 0xb, 0xeb,
    0xc1, 0x0, 0xff, 0x2c, 0x18, 0xf, 0xe0, 0x50,
    0x2, 0xe0, 0x0, 0x51, 0x40, 0x0, 0x0, 0x0,
    0x0,
    /* U+0073 "s" */
    0x0, 0x0, 0x0, 0x0, 0xbe, 0x74, 0x0, 0xff,
    0xff, 0x40, 0xbf, 0xff, 0xf0, 0x1f, 0x7, 0xfc,
    0x3, 0xe0, 0x7, 0xc0, 0x54, 0x79, 0xf0, 0x95,
    0x0, 0x7c, 0x51, 0x53, 0x19, 0x58, 0x20, 0x41,
    0x12, 0x9, 0x0, 0x10, 0x10, 0x8, 0x60, 0x8,
    0x14, 0x20, 0x1, 0x40, 0x20, 0x0, 0xa, 0x90,
    0x0, 0x0, 0x0, 0x0,
    /* U+0074 "t" */
    0x0, 0xbf, 0x80, 0x0, 0xff, 0xfd, 0x0, 0x81,
    0x51, 0xc0, 0x20, 0x0, 0x30, 0x6, 0x82, 0x8d,
    0x9, 0x0, 0x3, 0x84, 0x29, 0x20, 0x85, 0x81,
    0x0, 0x35, 0x21, 0xfd, 0x19, 0x47, 0xfb, 0xdf,
    0x0, 0xf6, 0xbf, 0x40, 0x2f, 0xff, 0x80, 0x1,
    0xff, 0x40, 0x0,
    /* U+0075 "u" */
    0x0, 0xbf, 0xd0, 0x0, 0xff, 0xfd, 0x0, 0xff,
    0xff, 0xc0, 0x7c, 0xbf, 0xf8, 0x28, 0x0, 0x7e,
    0x5, 0x90, 0x67, 0xc2, 0x14, 0x11, 0xe1, 0x45,
    0x49, 0x14, 0x50, 0x50, 0x4, 0x4c, 0x0, 0x40,
    0x80, 0x4a, 0x91, 0x80, 0x20, 0x0, 0x80, 0x2,
    0x41, 0x80, 0x0, 0x5, 0x0, 0x0,
    /* U+0076 "v" */
    0x0, 0x1a, 0x40, 0x0, 0xf, 0xff, 0x80, 0x3,
    0xff, 0xfd, 0x0, 0x74, 0x1f, 0xf0, 0xd, 0x40,
    0xaf, 0x41, 0xe9, 0x1, 0xf8, 0x3c, 0xaa, 0xaf,
    0xd7, 0xd6, 0x59, 0x4e, 0x39, 0xa2, 0x90, 0xa7,
    0x81, 0x0, 0x1e, 0x7c, 0x14, 0xf, 0xf1, 0xe0,
    0x2, 0xfc, 0x0, 0xaa, 0xae, 0x0,
    /* U+0077 "w" */
    0x0, 0x6f, 0xe0, 0x0, 0xb, 0xff, 0xf0, 0x0,
    0x7f, 0xff, 0xf4, 0x3, 0xff, 0xff, 0xf0, 0x1f,
    0xef, 0xdb, 0xd0, 0xbe, 0x3d, 0x1f, 0x43, 0xd5,
    0x1, 0x7c, 0x15, 0x14, 0x4, 0x98, 0x84, 0x54,
    0x52, 0x61, 0x10, 0x20, 0x4, 0x82, 0x90, 0x50,
    0x28, 0x0, 0x50, 0x1, 0x0, 0x0, 0x29, 0x50,
    0x0,
    /* U+0078 "x" */
    0x0, 0xbd, 0x0, 0x3, 0xff, 0x0, 0x3, 0xff,
    0x40, 0x3, 0xff, 0xd0, 0x7, 0xff, 0xf0, 0xf,
    0xff, 0xf8, 0xf, 0x63, 0xf0, 0x8, 0x42, 0x58,
    0x44, 0xa2, 0x15, 0x28, 0x10, 0x2c, 0x8, 0x0,
    0x20, 0x5, 0x18, 0x60, 0x3, 0x96, 0xc0, 0x0,
    0x69, 0x0,
    /* U+0079 "y" */
    0x1, 0xaa, 0xa0, 0x0, 0x8b, 0xe4, 0x40, 0x8,
    0x0, 0x1, 0x0, 0x40, 0x0, 0x10, 0x74, 0x90,
    0xc1, 0x9, 0x40, 0x40, 0x24, 0x64, 0x18, 0x2,
    0x80, 0x41, 0x50, 0x20, 0x8, 0x0, 0x2, 0x0,
    0x40, 0x0, 0x80, 0x1, 0xa5, 0xa4, 0x0, 0x0,
    0x0, 0x0,
    /* U+007A "z" */
    0x0, 0x1a, 0x40, 0x0, 0x2f, 0xff, 0x40, 0xb,
    0xff, 0xfc, 0x0, 0xff, 0xff, 0xe0, 0x1f, 0xff,
    0xff, 0x2, 0xe9, 0x49, 0xf0, 0x28, 0x0, 0x46,
    0x44, 0x4c, 0x8, 0x64, 0x54, 0x0, 0x6, 0x83,
    0x80, 0x0, 0x74, 0x7c, 0x5, 0xf, 0x43, 0xe0,
    0x2, 0xf0, 0x0, 0x5a, 0x40, 0x0
};
/*---------------------
 *  GLYPH DESCRIPTION
 *--------------------*/
static const lv_font_fmt_txt_glyph_dsc_t blockhead_24_glyph_dsc[] = {
    {.bitmap_index = 0, .adv_w = 0, .box_w = 0, .box_h = 0, .ofs_x = 0, .ofs_y = 0} /* id = 0 reserved */,
    {.bitmap_index = 0, .adv_w = 74, .box_w = 0, .box_h = 0, .ofs_x = 0, .ofs_y = 0},
    {.bitmap_index = 0, .adv_w = 192, .box_w = 12, .box_h = 12, .ofs_x = 0, .ofs_y = 2},
    {.bitmap_index = 36, .adv_w = 208, .box_w = 13, .box_h = 14, .ofs_x = 0, .ofs_y = 1},
    {.bitmap_index = 82, .adv_w = 205, .box_w = 13, .box_h = 14, .ofs_x = 0, .ofs_y = 1},
    {.bitmap_index = 128, .adv_w = 215, .box_w = 13, .box_h = 14, .ofs_x = 0, .ofs_y = 1},
    {.bitmap_index = 174, .adv_w = 207, .box_w = 13, .box_h = 14, .ofs_x = 0, .ofs_y = 2},
    {.bitmap_index = 220, .adv_w = 198, .box_w = 12, .box_h = 14, .ofs_x = 0, .ofs_y = 2},
    {.bitmap_index = 262, .adv_w = 236, .box_w = 15, .box_h = 13, .ofs_x = 0, .ofs_y = 2},
    {.bitmap_index = 311, .adv_w = 216, .box_w = 13, .box_h = 14, .ofs_x = 0, .ofs_y = 1},
    {.bitmap_index = 357, .adv_w = 250, .box_w = 16, .box_h = 12, .ofs_x = 0, .ofs_y = 1},
    {.bitmap_index = 405, .adv_w = 203, .box_w = 13, .box_h = 11, .ofs_x = 0, .ofs_y = 1},
    {.bitmap_index = 441, .adv_w = 215, .box_w = 13, .box_h = 12, .ofs_x = 0, .ofs_y = 1},
    {.bitmap_index = 480, .adv_w = 217, .box_w = 14, .box_h = 12, .ofs_x = 0, .ofs_y = 1},
    {.bitmap_index = 522, .adv_w = 200, .box_w = 13, .box_h = 14, .ofs_x = 0, .ofs_y = 0},
    {.bitmap_index = 568, .adv_w = 197, .box_w = 12, .box_h = 13, .ofs_x = 0, .ofs_y = 1},
    {.bitmap_index = 607, .adv_w = 199, .box_w = 13, .box_h = 13, .ofs_x = 0, .ofs_y = 1},
    {.bitmap_index = 650, .adv_w = 214, .box_w = 14, .box_h = 12, .ofs_x = 0, .ofs_y = 2},
    {.bitmap_index = 692, .adv_w = 206, .box_w = 13, .box_h = 13, .ofs_x = 0, .ofs_y = 1},
    {.bitmap_index = 735, .adv_w = 201, .box_w = 13, .box_h = 13, .ofs_x = 0, .ofs_y = 2},
    {.bitmap_index = 778, .adv_w = 245, .box_w = 15, .box_h = 14, .ofs_x = 0, .ofs_y = 2},
    {.bitmap_index = 831, .adv_w = 223, .box_w = 14, .box_h = 14, .ofs_x = 0, .ofs_y = 2},
    {.bitmap_index = 880, .adv_w = 189, .box_w = 12, .box_h = 14, .ofs_x = 0, .ofs_y = 1},
    {.bitmap_index = 922, .adv_w = 220, .box_w = 14, .box_h = 16, .ofs_x = 0, .ofs_y = 0},
    {.bitmap_index = 978, .adv_w = 224, .box_w = 14, .box_h = 16, .ofs_x = 0, .ofs_y = 0},
    {.bitmap_index = 1034, .adv_w = 207, .box_w = 13, .box_h = 14, .ofs_x = 0, .ofs_y = 2},
    {.bitmap_index = 1080, .adv_w = 205, .box_w = 13, .box_h = 15, .ofs_x = 0, .ofs_y = 0},
    {.bitmap_index = 1129, .adv_w = 232, .box_w = 14, .box_h = 15, .ofs_x = 0, .ofs_y = 0},
    {.bitmap_index = 1182, .adv_w = 218, .box_w = 14, .box_h = 15, .ofs_x = 0, .ofs_y = 1},
    {.bitmap_index = 1235, .adv_w = 218, .box_w = 14, .box_h = 15, .ofs_x = 0, .ofs_y = 1},
    {.bitmap_index = 1288, .adv_w = 204, .box_w = 13, .box_h = 16, .ofs_x = 0, .ofs_y = 1},
    {.bitmap_index = 1340, .adv_w = 214, .box_w = 13, .box_h = 14, .ofs_x = 0, .ofs_y = 1},
    {.bitmap_index = 1386, .adv_w = 224, .box_w = 14, .box_h = 13, .ofs_x = 0, .ofs_y = 2},
    {.bitmap_index = 1432, .adv_w = 199, .box_w = 13, .box_h = 14, .ofs_x = 0, .ofs_y = 2},
    {.bitmap_index = 1478, .adv_w = 236, .box_w = 15, .box_h = 15, .ofs_x = 0, .ofs_y = 1},
    {.bitmap_index = 1535, .adv_w = 218, .box_w = 14, .box_h = 16, .ofs_x = 0, .ofs_y = 1},
    {.bitmap_index = 1591, .adv_w = 211, .box_w = 13, .box_h = 14, .ofs_x = 0, .ofs_y = 1},
    {.bitmap_index = 1637, .adv_w = 203, .box_w = 13, .box_h = 14, .ofs_x = 0, .ofs_y = 1},
    {.bitmap_index = 1683, .adv_w = 206, .box_w = 13, .box_h = 13, .ofs_x = 0, .ofs_y = 2},
    {.bitmap_index = 1726, .adv_w = 210, .box_w = 13, .box_h = 14, .ofs_x = 0, .ofs_y = 1},
    {.bitmap_index = 1772, .adv_w = 218, .box_w = 14, .box_h = 15, .ofs_x = 0, .ofs_y = 1},
    {.bitmap_index = 1825, .adv_w = 200, .box_w = 13, .box_h = 14, .ofs_x = 0, .ofs_y = 1},
    {.bitmap_index = 1871, .adv_w = 246, .box_w = 15, .box_h = 15, .ofs_x = 0, .ofs_y = 1},
    {.bitmap_index = 1928, .adv_w = 214, .box_w = 13, .box_h = 15, .ofs_x = 0, .ofs_y = 1},
    {.bitmap_index = 1977, .adv_w = 272, .box_w = 17, .box_h = 13, .ofs_x = 0, .ofs_y = 2},
    {.bitmap_index = 2033, .adv_w = 190, .box_w = 12, .box_h = 15, .ofs_x = 0, .ofs_y = 1},
    {.bitmap_index = 2078, .adv_w = 209, .box_w = 13, .box_h = 13, .ofs_x = 0, .ofs_y = 2},
    {.bitmap_index = 2121, .adv_w = 238, .box_w = 15, .box_h = 14, .ofs_x = 0, .ofs_y = 2},
    {.bitmap_index = 2174, .adv_w = 210, .box_w = 13, .box_h = 14, .ofs_x = 0, .ofs_y = 1},
    {.bitmap_index = 2220, .adv_w = 197, .box_w = 12, .box_h = 14, .ofs_x = 0, .ofs_y = 1},
    {.bitmap_index = 2262, .adv_w = 207, .box_w = 13, .box_h = 14, .ofs_x = 0, .ofs_y = 1},
    {.bitmap_index = 2308, .adv_w = 223, .box_w = 14, .box_h = 14, .ofs_x = 0, .ofs_y = 2},
    {.bitmap_index = 2357, .adv_w = 214, .box_w = 14, .box_h = 15, .ofs_x = 0, .ofs_y = 1},
    {.bitmap_index = 2410, .adv_w = 209, .box_w = 13, .box_h = 14, .ofs_x = 0, .ofs_y = 1},
    {.bitmap_index = 2456, .adv_w = 207, .box_w = 13, .box_h = 14, .ofs_x = 0, .ofs_y = 1},
    {.bitmap_index = 2502, .adv_w = 227, .box_w = 14, .box_h = 14, .ofs_x = 0, .ofs_y = 2},
    {.bitmap_index = 2551, .adv_w = 240, .box_w = 15, .box_h = 14, .ofs_x = 0, .ofs_y = 2},
    {.bitmap_index = 2604, .adv_w = 204, .box_w = 13, .box_h = 12, .ofs_x = 0, .ofs_y = 2},
    {.bitmap_index = 2643, .adv_w = 192, .box_w = 12, .box_h = 14, .ofs_x = 0, .ofs_y = 1},
    {.bitmap_index = 2685, .adv_w = 227, .box_w = 14, .box_h = 12, .ofs_x = 0, .ofs_y = 2},
    {.bitmap_index = 2727, .adv_w = 212, .box_w = 13, .box_h = 14, .ofs_x = 0, .ofs_y = 1},
    {.bitmap_index = 2773, .adv_w = 201, .box_w = 13, .box_h = 14, .ofs_x = 0, .ofs_y = 2},
    {.bitmap_index = 2819, .adv_w = 201, .box_w = 13, .box_h = 14, .ofs_x = 0, .ofs_y = 1},
    {.bitmap_index = 2865, .adv_w = 228, .box_w = 14, .box_h = 14, .ofs_x = 0, .ofs_y = 1},
    {.bitmap_index = 2914, .adv_w = 206, .box_w = 13, .box_h = 16, .ofs_x = 0, .ofs_y = 0},
    {.bitmap_index = 2966, .adv_w = 211, .box_w = 13, .box_h = 13, .ofs_x = 0, .ofs_y = 2},
    {.bitmap_index = 3009, .adv_w = 205, .box_w = 13, .box_h = 14, .ofs_x = 0, .ofs_y = 1},
    {.bitmap_index = 3055, .adv_w = 235, .box_w = 14, .box_h = 13, .ofs_x = 0, .ofs_y = 2},
    {.bitmap_index = 3101, .adv_w = 232, .box_w = 15, .box_h = 13, .ofs_x = 0, .ofs_y = 2},
    {.bitmap_index = 3150, .adv_w = 190, .box_w = 12, .box_h = 14, .ofs_x = 0, .ofs_y = 1},
    {.bitmap_index = 3192, .adv_w = 220, .box_w = 14, .box_h = 12, .ofs_x = 0, .ofs_y = 2},
    {.bitmap_index = 3234, .adv_w = 215, .box_w = 14, .box_h = 13, .ofs_x = 0, .ofs_y = 2}
};
/*---------------------
 *  CHARACTER MAPPING
 *--------------------*/
/*Collect the unicode lists and glyph_id offsets*/
static const lv_font_fmt_txt_cmap_t blockhead_24_cmaps[] =
{
    {
        .range_start = 32, .range_length = 1, .glyph_id_start = 1,
        .unicode_list = NULL, .glyph_id_ofs_list = NULL, .list_length = 0, .type = LV_FONT_FMT_TXT_CMAP_FORMAT0_TINY
    },
    {
        .range_start = 47, .range_length = 44, .glyph_id_start = 2,
        .unicode_list = NULL, .glyph_id_ofs_list = NULL, .list_length = 0, .type = LV_FONT_FMT_TXT_CMAP_FORMAT0_TINY
    },
    {
        .range_start = 97, .range_length = 26, .glyph_id_start = 46,
        .unicode_list = NULL, .glyph_id_ofs_list = NULL, .list_length = 0, .type = LV_FONT_FMT_TXT_CMAP_FORMAT0_TINY
    }
};
/*--------------------
 *  ALL CUSTOM DATA
 *--------------------*/
/*Store all the custom data of the font*/
static lv_font_fmt_txt_glyph_cache_t blockhead_24_cache;
static const lv_font_fmt_txt_dsc_t blockhead_24_font_dsc = {
    .glyph_bitmap = blockhead_24_glyph_bitmap,
    .glyph_dsc = blockhead_24_glyph_dsc,
    .cmaps = blockhead_24_cmaps,
    .kern_dsc = NULL,
    .kern_scale = 0,
    .cmap_num = 3,
    .bpp = 2,
    .kern_classes = 0,
    .bitmap_format = 0,
    .cache = &blockhead_24_cache
};
/*-----------------
 *  PUBLIC FONT
 *----------------*/
/*Initialize a public general font descriptor*/
const lv_font_t blockhead_24 = {
    .get_glyph_dsc = lv_font_get_glyph_dsc_fmt_txt,    /*Function pointer to get glyph's data*/
    .get_glyph_bitmap = lv_font_get_bitmap_fmt_txt,    /*Function pointer to get glyph's bitmap*/
    .line_height = 17,          /*The maximum line height required by the font*/
    .base_line = 0,             /*Baseline measured from the bottom of the line*/

    .subpx = LV_FONT_SUBPX_NONE,
    .underline_position = -1,
    .underline_thickness = 1,
    .dsc = &blockhead_24_font_dsc,          /*The custom font data. Will be accessed by `get_glyph_bitmap/dsc` */
};
#endif

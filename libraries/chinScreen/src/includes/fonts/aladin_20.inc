/*******************************************************************************
 * Size: 20 px
 * Bpp: 2
 ******************************************************************************/


#ifdef __has_include

    #if __has_include("lvgl.h")
         #ifndef LV_LVGL_H_INCLUDE_SIMPLE
             #define LV_LVGL_H_INCLUDE_SIMPLE
         #endif
     #endif
 #endif

 #ifdef LV_LVGL_H_INCLUDE_SIMPLE
     #include "lvgl.h"
 #else
     #include "../lvgl-8.3.11/lvgl.h"
 #endif

 #ifndef ALADIN_20
 #define ALADIN_20 1
 #endif

 #if ALADIN_20

/*-----------------
 *    BITMAPS
 *----------------*/
/*Store the image of the glyphs*/
static LV_ATTRIBUTE_LARGE_CONST const uint8_t aladin_20_glyph_bitmap[] = {
    /* U+0020 " " */
    /* U+0021 "!" */
    0xbb, 0xeb, 0x6d, 0xb2, 0xc7, 0x1c, 0x71, 0xc1,
    0x0, 0xf6, 0xd0,
    /* U+0022 "\"" */
    0xe3, 0x6c, 0xd6, 0x20, 0x4,
    /* U+0023 "#" */
    0x0, 0x82, 0x40, 0x7, 0xd, 0x0, 0x1c, 0x34,
    0xf, 0xff, 0xff, 0x16, 0xd7, 0x90, 0x7, 0xd,
    0x3, 0xff, 0xff, 0xc0, 0xb0, 0xe0, 0x1, 0xc3,
    0x40, 0x6, 0xd, 0x0,
    /* U+0024 "$" */
    0x0, 0x30, 0x0, 0x0, 0xc0, 0x0, 0x2f, 0xf4,
    0x3, 0xee, 0xf4, 0x3e, 0x33, 0xd0, 0xf8, 0xc5,
    0x3, 0xfb, 0x0, 0x7, 0xfe, 0x0, 0x7, 0xff,
    0x80, 0x1, 0xff, 0x42, 0xe3, 0x7f, 0x1f, 0xcc,
    0xfc, 0xbc, 0x32, 0xf1, 0xf4, 0xcf, 0x83, 0xff,
    0xf8, 0x2, 0xfe, 0x40, 0x0, 0x30, 0x0, 0x0,
    0x40, 0x0,
    /* U+0025 "%" */
    0x1f, 0x40, 0x28, 0x35, 0xc0, 0x30, 0x70, 0xd0,
    0xd0, 0x70, 0xd2, 0x80, 0x70, 0xd3, 0x0, 0x34,
    0xcd, 0x0, 0x1a, 0x5c, 0x0, 0x0, 0x32, 0xe0,
    0x0, 0x9b, 0x28, 0x1, 0xce, 0x1c, 0x3, 0xe,
    0x1c, 0xa, 0xe, 0x1c, 0x1c, 0xb, 0x28, 0x30,
    0x2, 0xb0,
    /* U+0026 "&" */
    0x0, 0xbd, 0x0, 0x3, 0xcf, 0x0, 0x3, 0xce,
    0x0, 0x3, 0xec, 0x0, 0x2, 0xf0, 0x0, 0x3,
    0xf0, 0x0, 0xf, 0xb8, 0x10, 0x2d, 0x3c, 0x3c,
    0x3c, 0x2f, 0x3c, 0x7c, 0xf, 0x78, 0x7c, 0xb,
    0xf4, 0x3e, 0x3, 0xf0, 0x2f, 0xef, 0xf4, 0x6,
    0xfd, 0xbc,
    /* U+0027 "'" */
    0xeb, 0x60,
    /* U+0028 "(" */
    0x0, 0x40, 0x28, 0x7, 0x0, 0xe0, 0x1d, 0x2,
    0xc0, 0x3c, 0x3, 0xc0, 0x3c, 0x3, 0xc0, 0x3c,
    0x3, 0xc0, 0x3c, 0x2, 0xc0, 0xd, 0x0, 0xb0,
    0x3, 0x40, 0x8,
    /* U+0029 ")" */
    0x0, 0xc, 0x2, 0xc0, 0x34, 0xf, 0x2, 0xc0,
    0x74, 0x1e, 0x7, 0x80, 0xe0, 0x78, 0x1e, 0x7,
    0x42, 0xc0, 0xe0, 0x70, 0x34, 0x18, 0x0,
    /* U+002A "*" */
    0x49, 0xb, 0x42, 0xf0, 0x10,
    /* U+002B "+" */
    0x0, 0x0, 0x0, 0x7, 0x0, 0x0, 0x70, 0x0,
    0x7, 0x0, 0x0, 0xb0, 0x7, 0xff, 0xfe, 0x0,
    0xb0, 0x0, 0xb, 0x0, 0x0, 0xb0, 0x0, 0x6,
    0x0,
    /* U+002C "," */
    0xb3, 0xd3, 0x4,
    /* U+002D "-" */
    0x3f, 0xff, 0x80, 0x0, 0x0,
    /* U+002E "." */
    0xf3, 0xd0,
    /* U+002F "/" */
    0x0, 0x0, 0x1c, 0x0, 0x0, 0x30, 0x0, 0x0,
    0xa0, 0x0, 0x1, 0xc0, 0x0, 0x3, 0x40, 0x0,
    0xa, 0x0, 0x0, 0xc, 0x0, 0x0, 0x34, 0x0,
    0x0, 0x70, 0x0, 0x0, 0xd0, 0x0, 0x2, 0x80,
    0x0, 0x7, 0x0, 0x0, 0xd, 0x0, 0x0, 0x28,
    0x0, 0x0, 0x30, 0x0, 0x0, 0x90, 0x0, 0x0,
    /* U+0030 "0" */
    0x2, 0xfe, 0x0, 0x3e, 0x7e, 0x2, 0xf0, 0x3d,
    0xf, 0x80, 0xf8, 0x3d, 0x2, 0xf1, 0xf4, 0xb,
    0xc7, 0xc0, 0x2f, 0x1f, 0x0, 0xbc, 0x7d, 0x2,
    0xf1, 0xf4, 0xb, 0xc3, 0xe0, 0x3e, 0xb, 0xc0,
    0xf4, 0xf, 0x9f, 0x80, 0xb, 0xf8, 0x0,
    /* U+0031 "1" */
    0x7, 0x4f, 0xdb, 0xf4, 0x3d, 0xf, 0x43, 0xc0,
    0xf0, 0x3d, 0xf, 0x43, 0xd0, 0xf4, 0x7d, 0x1f,
    0x47, 0x80,
    /* U+0032 "2" */
    0x2, 0xfd, 0x1, 0xf5, 0xf8, 0x3d, 0xb, 0xc3,
    0xe0, 0xbc, 0x3f, 0xf, 0xc0, 0x41, 0xf4, 0x0,
    0x3d, 0x0, 0xf, 0x40, 0x3, 0xc0, 0x0, 0xb0,
    0x0, 0x1d, 0x0, 0x3, 0xe5, 0x6c, 0x7f, 0xff,
    0xcb, 0xff, 0xf4,
    /* U+0033 "3" */
    0x7, 0xfd, 0x2, 0xe1, 0xf4, 0x3d, 0xb, 0x81,
    0x80, 0xf8, 0x0, 0x2f, 0x0, 0x7f, 0xc0, 0x1,
    0x7d, 0x0, 0x0, 0xf8, 0x9, 0xb, 0xc3, 0xe0,
    0x7c, 0x7c, 0xb, 0xc7, 0xc0, 0xfc, 0x3e, 0x6f,
    0x40, 0xbf, 0x80,
    /* U+0034 "4" */
    0x0, 0xb, 0x40, 0x2, 0xf4, 0x0, 0x7f, 0x40,
    0xd, 0xf0, 0x3, 0x4f, 0x0, 0xb0, 0xf0, 0x1d,
    0xf, 0x3, 0xc0, 0xf0, 0x7f, 0xff, 0xdf, 0xff,
    0xfc, 0x0, 0x1f, 0x0, 0x1, 0xf0, 0x0, 0x1f,
    0x40, 0x2, 0xe0,
    /* U+0035 "5" */
    0xf, 0xff, 0x81, 0xff, 0xf0, 0x1e, 0x0, 0x1,
    0xc0, 0x0, 0x2c, 0x0, 0x2, 0xff, 0xd0, 0x3f,
    0xbf, 0x42, 0x80, 0xfc, 0x0, 0xb, 0xc2, 0xe0,
    0xbc, 0x7d, 0xb, 0xc7, 0xc0, 0xf8, 0x3e, 0x6f,
    0x0, 0xbf, 0x80,
    /* U+0036 "6" */
    0x1, 0xfe, 0x0, 0xb8, 0xbc, 0x1f, 0x7, 0xc2,
    0xe0, 0x78, 0x3d, 0x0, 0x3, 0xeb, 0xe0, 0x7f,
    0xaf, 0x87, 0xe0, 0xbc, 0x7d, 0x7, 0xd7, 0xd0,
    0x3d, 0x3d, 0x7, 0xc3, 0xe0, 0xbc, 0x1f, 0x5f,
    0x0, 0x7f, 0xd0,
    /* U+0037 "7" */
    0x3f, 0xff, 0x7f, 0xff, 0x74, 0x1d, 0x0, 0x3c,
    0x0, 0x74, 0x0, 0xf0, 0x1, 0xd0, 0x3, 0xc0,
    0x7, 0xc0, 0xb, 0x40, 0xf, 0x40, 0x1f, 0x40,
    0x2f, 0x0, 0x1f, 0x40,
    /* U+0038 "8" */
    0x2, 0xfd, 0x1, 0xf5, 0xf8, 0x3d, 0x7, 0xc3,
    0xe0, 0x7c, 0x2f, 0x8f, 0x40, 0xff, 0xd0, 0x7,
    0xff, 0x2, 0xf6, 0xfc, 0x7d, 0x7, 0xdb, 0xc0,
    0x3e, 0xbc, 0x3, 0xeb, 0xd0, 0x7c, 0x3f, 0x5f,
    0x80, 0x7f, 0xd0,
    /* U+0039 "9" */
    0x7, 0xf9, 0x1, 0xf6, 0xf4, 0x3e, 0xb, 0xc3,
    0xd0, 0x7c, 0x7c, 0x7, 0xd7, 0xd0, 0xbd, 0x3f,
    0x5f, 0xd0, 0xff, 0xfd, 0x1, 0x47, 0xc0, 0x0,
    0x7c, 0x3c, 0xb, 0x87, 0xc0, 0xf4, 0x3d, 0x2e,
    0x1, 0xbf, 0x40,
    /* U+003A ":" */
    0xf3, 0xd0, 0x0, 0x0, 0x0, 0x3c, 0xf4,
    /* U+003B ";" */
    0xf3, 0xd0, 0x0, 0x0, 0x0, 0x2c, 0xf4, 0xc1,
    0x0,
    /* U+003C "<" */
    0x0, 0x1, 0x0, 0x1e, 0x0, 0xb4, 0x7, 0x80,
    0x2d, 0x0, 0x7c, 0x0, 0x1f, 0x40, 0x2, 0xf0,
    0x0, 0x3d, 0x0, 0xa,
    /* U+003D "=" */
    0x3f, 0xff, 0xd1, 0x55, 0x54, 0x0, 0x0, 0x7,
    0xff, 0xfd, 0x0, 0x0, 0x0,
    /* U+003E ">" */
    0x0, 0x0, 0x38, 0x0, 0xf, 0x0, 0x1, 0xe0,
    0x0, 0x3c, 0x0, 0x1e, 0x0, 0xf8, 0xb, 0xc0,
    0x3d, 0x0, 0x30, 0x0,
    /* U+003F "?" */
    0xb, 0xf8, 0xf, 0x8b, 0xc7, 0xc0, 0xf1, 0xe0,
    0x3c, 0x3c, 0xf, 0x1, 0xb, 0x40, 0x7, 0x40,
    0xb, 0x40, 0x7, 0x80, 0x0, 0xe0, 0x0, 0x4,
    0x0, 0x0, 0x0, 0x7, 0xc0, 0x0, 0xf0, 0x0,
    /* U+0040 "@" */
    0x0, 0x6, 0xff, 0x80, 0x0, 0xb, 0xd0, 0x1f,
    0x80, 0x3, 0xd0, 0x0, 0x2e, 0x0, 0xb4, 0x2f,
    0xd0, 0xb8, 0x1e, 0xf, 0x4f, 0x3, 0xc2, 0xd0,
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    0xbf, 0xc0, 0x0, 0x0, 0x0, 0x0, 0x0, 0x0,
    /* U+0041 "A" */
    0x0, 0x7, 0x40, 0x0, 0x2f, 0x80, 0x0, 0xbb,
    0xc0, 0x1, 0xc3, 0xc0, 0x3, 0x43, 0xd0, 0xb,
    0x3, 0xd0, 0xbf, 0xff, 0xe0, 0x3d, 0x56, 0xf0,
    0x3c, 0x1, 0xf0, 0x3c, 0x1, 0xf0, 0x3c, 0x0,
    0xf4, 0x7f, 0x40, 0xf8, 0x3f, 0x80, 0xfc, 0x2e,
    0x0, 0xbd,
    /* U+0042 "B" */
    0x2f, 0xfe, 0x1, 0xfd, 0x7f, 0x3, 0xe0, 0x3d,
    0xf, 0x80, 0xf4, 0x3e, 0x1f, 0xc0, 0xfa, 0xf8,
    0x3, 0xe1, 0xb4, 0xf, 0x80, 0xb8, 0x3e, 0x1,
    0xf0, 0xf8, 0x3, 0xc3, 0xfc, 0x1f, 0xf, 0xf8,
    0xfc, 0x3f, 0xff, 0xd1, 0xe2, 0xfd, 0x0,
    /* U+0043 "C" */
    0x0, 0xbf, 0x40, 0x7d, 0x7d, 0xf, 0x3, 0xe2,
    0xe0, 0x7e, 0x3d, 0xb, 0xd3, 0xc0, 0x24, 0x7c,
    0x0, 0x7, 0xc0, 0x0, 0x7c, 0x0, 0x7, 0xd0,
    0x0, 0x3f, 0x0, 0xa3, 0xfd, 0x2d, 0x1f, 0xff,
    0xc0, 0xbf, 0xf4, 0x0, 0x54, 0x0, 0x0, 0x0,
    /* U+0044 "D" */
    0x2f, 0xfd, 0x0, 0xfd, 0x7f, 0x3, 0xf0, 0x3d,
    0xf, 0x80, 0xbc, 0x3e, 0x1, 0xf0, 0xf8, 0x7,
    0xc3, 0xe0, 0x1f, 0x4f, 0x80, 0x7c, 0x3e, 0x2,
    0xf0, 0xf8, 0xf, 0xc3, 0xe0, 0x7e, 0xf, 0xeb,
    0xf0, 0x3f, 0xff, 0x80, 0xe7, 0xf4, 0x0,
    /* U+0045 "E" */
    0x0, 0x1b, 0xf0, 0x3, 0xfa, 0x80, 0x3f, 0x0,
    0x1, 0xf0, 0x0, 0xb, 0xc0, 0x0, 0xff, 0xff,
    0x1, 0xf9, 0x50, 0x3, 0xd0, 0x0, 0xf, 0x80,
    0x0, 0x3f, 0x0, 0x0, 0xbd, 0x0, 0x1, 0xff,
    0xac, 0x2, 0xff, 0xf0, 0x1, 0xfe, 0x0,
    /* U+0046 "F" */
    0x1b, 0xff, 0x4f, 0xf9, 0x52, 0xf0, 0x0, 0x7c,
    0x0, 0x1f, 0x0, 0x2f, 0xff, 0x46, 0xf5, 0x40,
    0x7c, 0x0, 0x2f, 0x0, 0xb, 0xc0, 0x2, 0xf0,
    0x0, 0xbc, 0x0, 0x2f, 0x0, 0xf, 0x40, 0x0,
    /* U+0047 "G" */
    0x1, 0xbf, 0x80, 0x2f, 0x4f, 0xc1, 0xf0, 0x2f,
    0xf, 0xc0, 0xf8, 0x3e, 0x0, 0x1, 0xf4, 0x0,
    0x7, 0xd0, 0xff, 0x1f, 0x1, 0xbc, 0x7d, 0x1,
    0xf1, 0xf4, 0x7, 0xc3, 0xf0, 0x1f, 0xb, 0xe0,
    0xbc, 0xf, 0xff, 0xf0, 0xb, 0xfe, 0x0,
    /* U+0048 "H" */
    0x2f, 0x1, 0xf4, 0xbc, 0xb, 0xc1, 0xf0, 0x2f,
    0x7, 0xc0, 0x7c, 0x1f, 0x1, 0xf1, 0xff, 0xff,
    0xc6, 0xf5, 0x6f, 0x7, 0xc0, 0xbc, 0x1f, 0x2,
    0xf0, 0x7c, 0xb, 0xc1, 0xf0, 0x2f, 0x7, 0xc0,
    0xbc, 0x2f, 0x2, 0xf0, 0xb8, 0xb, 0xc0,
    /* U+0049 "I" */
    0x2f, 0xf, 0xc2, 0xf0, 0xbc, 0x2f, 0xb, 0xc2,
    0xf0, 0xbc, 0x2f, 0xb, 0xc2, 0xf0, 0xbc, 0x2f,
    0xf, 0x80,
    /* U+004A "J" */
    0xb, 0xc0, 0xfc, 0xb, 0xc0, 0xbc, 0x7, 0xc0,
    0x7c, 0x7, 0xc0, 0x7c, 0x7, 0xc0, 0x7c, 0xb,
    0xc0, 0xbc, 0xb, 0xc0, 0xfc, 0xf, 0xc2, 0xf0,
    0x38, 0x0,
    /* U+004B "K" */
    0x2e, 0x1, 0xf0, 0xf8, 0x1e, 0x3, 0xe1, 0xe0,
    0xf, 0x8e, 0x0, 0x3e, 0xf0, 0x0, 0xff, 0xe0,
    0x3, 0xf0, 0xf0, 0xf, 0x82, 0xe0, 0x3d, 0x7,
    0xc0, 0xf8, 0x1f, 0x3, 0xe0, 0x7c, 0xf, 0x81,
    0xf4, 0x3e, 0x7, 0xe0, 0xf4, 0xf, 0x80,
    /* U+004C "L" */
    0x7e, 0x0, 0x1f, 0x80, 0x3, 0xe0, 0x0, 0xf4,
    0x0, 0x3d, 0x0, 0xf, 0x40, 0x3, 0xd0, 0x0,
    0xf4, 0x0, 0x3d, 0x1, 0xf, 0x40, 0xd3, 0xd0,
    0x38, 0xf8, 0x2f, 0x3f, 0x6f, 0x9f, 0xff, 0xe0,
    /* U+004D "M" */
    0x2f, 0x80, 0xb, 0xd3, 0xfc, 0x2, 0xfd, 0x3f,
    0xd0, 0x3f, 0xc3, 0xfe, 0x3, 0xfc, 0x3b, 0xf0,
    0xb7, 0xc3, 0xaf, 0xe, 0x7c, 0x39, 0xf4, 0xc7,
    0xc3, 0x8f, 0xac, 0x7c, 0x38, 0xbf, 0x8b, 0xc3,
    0x87, 0xf0, 0xbc, 0x38, 0x3f, 0xb, 0xc3, 0x83,
    0xe0, 0xbc, 0x38, 0x2d, 0xb, 0xc7, 0x81, 0xc0,
    0x7c,
    /* U+004E "N" */
    0x2f, 0x40, 0xb0, 0xff, 0x3, 0xc3, 0xfc, 0xe,
    0xf, 0xf4, 0x38, 0x3f, 0xf0, 0xe0, 0xf7, 0xc3,
    0x83, 0x8f, 0x8e, 0xe, 0x2f, 0x38, 0x38, 0x7e,
    0xe0, 0xe0, 0xff, 0x83, 0x82, 0xfe, 0xf, 0x3,
    0xf8, 0x3c, 0xb, 0xf1, 0xe0, 0xf, 0x80,
    /* U+004F "O" */
    0x0, 0xbf, 0x40, 0xf, 0xaf, 0x40, 0x74, 0x2f,
    0x7, 0xc0, 0x3d, 0x3f, 0x0, 0xf9, 0xfc, 0x3,
    0xe7, 0xf8, 0xb, 0xef, 0x40, 0x2f, 0xbc, 0x0,
    0xf9, 0xf0, 0x3, 0xd7, 0xd0, 0xf, 0xf, 0xc0,
    0xf8, 0x1f, 0xef, 0xc0, 0xb, 0xf4, 0x0,
    /* U+0050 "P" */
    0x2f, 0xfe, 0x0, 0xfd, 0x7f, 0x3, 0xe0, 0x3e,
    0xf, 0x80, 0xbc, 0x3e, 0x2, 0xf0, 0xf8, 0xaf,
    0x83, 0xe7, 0xfc, 0xf, 0x8f, 0xd0, 0x3e, 0x0,
    0x0, 0xf8, 0x0, 0x3, 0xe0, 0x0, 0xf, 0x80,
    0x0, 0x3f, 0x0, 0x0, 0xf4, 0x0, 0x0,
    /* U+0051 "Q" */
    0x0, 0xbf, 0x40, 0xf, 0xbf, 0x40, 0x74, 0x3f,
    0xb, 0xc0, 0x7d, 0x3e, 0x0, 0xf9, 0xfc, 0x3,
    0xe7, 0xf8, 0xf, 0xef, 0x80, 0x2e, 0xbc, 0x0,
    0xfa, 0xf0, 0x3, 0xd7, 0xd1, 0x9f, 0xf, 0xc3,
    0xf8, 0x1f, 0xef, 0xc0, 0x1b, 0xff, 0xd0, 0x0,
    0x2f, 0x40,
    /* U+0052 "R" */
    0x2f, 0xfe, 0x40, 0xfd, 0x6f, 0x43, 0xe0, 0x3f,
    0xf, 0x80, 0xbc, 0x2e, 0x3, 0xf0, 0xb8, 0x2f,
    0x42, 0xe7, 0xe0, 0xb, 0x87, 0xe0, 0x2e, 0x7,
    0xc0, 0xf8, 0x1f, 0x43, 0xe0, 0x7d, 0xf, 0x81,
    0xf8, 0x3f, 0x3, 0xf0, 0xf4, 0xb, 0xd0,
    /* U+0053 "S" */
    0x2, 0xfe, 0x41, 0xf9, 0xbc, 0x3d, 0x3, 0xc3,
    0xd0, 0x24, 0x3f, 0x40, 0x2, 0xff, 0x40, 0xb,
    0xff, 0x40, 0xb, 0xfc, 0x19, 0xb, 0xe7, 0xe0,
    0x3f, 0xbc, 0x3, 0xeb, 0xc0, 0x7d, 0x3f, 0xaf,
    0x80, 0xbf, 0x90,
    /* U+0054 "T" */
    0x1f, 0xff, 0xc7, 0xbf, 0xa0, 0x1, 0xf0, 0x0,
    0x1f, 0x0, 0x1, 0xf0, 0x0, 0x1f, 0x0, 0x1,
    0xf0, 0x0, 0x1f, 0x0, 0x1, 0xf0, 0x0, 0x2f,
    0x0, 0x2, 0xf0, 0x0, 0x2f, 0x0, 0x2, 0xf0,
    0x0, 0x3e, 0x0,
    /* U+0055 "U" */
    0x2f, 0x1, 0xf4, 0xfc, 0xb, 0xc3, 0xe0, 0x2f,
    0xf, 0x80, 0xbc, 0x3e, 0x2, 0xf0, 0xf8, 0xb,
    0xc3, 0xe0, 0x2f, 0xf, 0x80, 0xbc, 0x3e, 0x2,
    0xf0, 0xf8, 0xf, 0xc3, 0xe0, 0x3f, 0xf, 0xe7,
    0xfc, 0x1f, 0xfe, 0xf0, 0x2f, 0x87, 0xc0,
    /* U+0056 "V" */
    0x2f, 0x0, 0x6e, 0x3f, 0x40, 0xfe, 0xf, 0x80,
    0x3e, 0xf, 0xc0, 0x3d, 0x7, 0xc0, 0x3c, 0x3,
    0xd0, 0x38, 0x3, 0xe0, 0x74, 0x2, 0xf0, 0xb0,
    0x1, 0xf0, 0xd0, 0x0, 0xf6, 0xc0, 0x0, 0xff,
    0x0, 0x0, 0xbe, 0x0, 0x0, 0x3c, 0x0, 0x0,
    0x24, 0x0,
    /* U+0057 "W" */
    0x2f, 0x1, 0xf4, 0x6, 0xf3, 0xf0, 0xf, 0x80,
    0xbf, 0xf, 0x40, 0xbc, 0x3, 0xe0, 0xf8, 0x7,
    0xc0, 0x2d, 0xb, 0xc0, 0x3d, 0x2, 0xc0, 0x7c,
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    0x3, 0xd0, 0x0, 0x3, 0x0, 0x28, 0x0,
    /* U+0058 "X" */
    0x7, 0xe0, 0xf, 0x80, 0xfd, 0xb, 0x80, 0xf,
    0x83, 0xc0, 0x2, 0xf2, 0xc0, 0x0, 0x3e, 0xe0,
    0x0, 0xb, 0xf0, 0x0, 0x0, 0xf8, 0x0, 0x0,
    0xbf, 0x0, 0x0, 0x3b, 0xd0, 0x0, 0x2c, 0xbc,
    0x0, 0x1d, 0xf, 0x80, 0xf, 0x2, 0xf0, 0xf,
    0x80, 0x3f, 0x4b, 0x80, 0xb, 0xd0,
    /* U+0059 "Y" */
    0x2f, 0x0, 0x3f, 0xf, 0xd0, 0xf, 0x40, 0xfc,
    0x7, 0x80, 0x1f, 0x42, 0xc0, 0x3, 0xf0, 0xd0,
    0x0, 0x7d, 0xb0, 0x0, 0xf, 0xf4, 0x0, 0x1,
    0xfc, 0x0, 0x0, 0x3d, 0x0, 0x0, 0xf, 0x40,
    0x0, 0x3, 0xd0, 0x0, 0x0, 0xf4, 0x0, 0x0,
    0x7e, 0x0, 0x0, 0x1e, 0x0, 0x0,
    /* U+005A "Z" */
    0xf, 0xff, 0xfc, 0xf, 0xd6, 0xfc, 0xd, 0x3,
    0xf0, 0x8, 0x7, 0xe0, 0x0, 0xf, 0xc0, 0x0,
    0x1f, 0x40, 0x0, 0x3f, 0x0, 0x0, 0xbc, 0x0,
    0x1, 0xf8, 0xfc, 0x3, 0xf0, 0xfc, 0x7, 0xe0,
    0x2d, 0xf, 0xc0, 0x3c, 0x2f, 0xd5, 0xfc, 0x3f,
    0xff, 0xf4,
    /* U+005B "[" */
    0x27, 0xcf, 0x3c, 0xf3, 0x8e, 0x38, 0xe3, 0x8e,
    0x38, 0xe3, 0xcf, 0x3c, 0x74, 0x0,
    /* U+005C "\\" */
    0xa0, 0x0, 0x0, 0x30, 0x0, 0x0, 0x1c, 0x0,
    0x0, 0xd, 0x0, 0x0, 0x3, 0x0, 0x0, 0x2,
    0x80, 0x0, 0x0, 0xd0, 0x0, 0x0, 0x70, 0x0,
    0x0, 0x28, 0x0, 0x0, 0xc, 0x0, 0x0, 0x7,
    0x0, 0x0, 0x3, 0x40, 0x0, 0x0, 0xc0, 0x0,
    0x0, 0xa0, 0x0, 0x0, 0x34, 0x0, 0x0, 0x1c,
    /* U+005D "]" */
    0x10, 0x2c, 0xe, 0xe, 0xe, 0xe, 0xe, 0xe,
    0xe, 0xe, 0xe, 0xe, 0xe, 0xe, 0xe, 0xe,
    0x1d, 0x24,
    /* U+005E "^" */
    0x5, 0x1, 0xf8, 0x20, 0x80,
    /* U+005F "_" */
    0x3f, 0xff, 0x80, 0x0, 0x0,
    /* U+0061 "a" */
    0xb, 0xf4, 0x3d, 0x3c, 0x3c, 0x2d, 0x2, 0xfd,
    0x2f, 0x7d, 0x78, 0x2c, 0xb8, 0x3d, 0xbf, 0x7d,
    0x3f, 0x2e,
    /* U+0062 "b" */
    0x6c, 0x0, 0x2f, 0x0, 0x3, 0xc0, 0x0, 0xf0,
    0x0, 0x3c, 0x0, 0xf, 0x2e, 0x3, 0xdf, 0xe0,
    0xf0, 0xbc, 0x3c, 0xf, 0xf, 0x3, 0xc3, 0xc0,
    0xf0, 0xf0, 0x74, 0x3d, 0x78, 0xf, 0xf4, 0x0,
    /* U+0063 "c" */
    0x7, 0xf4, 0x1e, 0x3c, 0x3c, 0x3c, 0x78, 0x24,
    0x78, 0x0, 0x7c, 0x0, 0x7d, 0x1c, 0x3f, 0xfc,
    0xb, 0xe0,
    /* U+0064 "d" */
    0x0, 0x2e, 0x0, 0x3e, 0x0, 0x2e, 0x0, 0x1e,
    0x0, 0x1e, 0x7, 0xfe, 0x1e, 0x2e, 0x3c, 0x1e,
    0x3c, 0x1e, 0x78, 0x1e, 0x78, 0x2e, 0x7d, 0x2e,
    0x3f, 0xae, 0x1f, 0x5f,
    /* U+0065 "e" */
    0xb, 0xf0, 0x2d, 0x3c, 0x38, 0x3c, 0x78, 0xb8,
    0xbf, 0xe0, 0xbd, 0x0, 0x7c, 0xc, 0x3f, 0xf8,
    0xf, 0xe0,
    /* U+0066 "f" */
    0x1, 0xd0, 0xb8, 0xb, 0x40, 0xb4, 0xb, 0x42,
    0xfe, 0xb, 0x40, 0xb0, 0xb, 0x0, 0xb0, 0xb,
    0x0, 0xf4, 0xf, 0x40, 0xf0, 0xf, 0x1, 0xe0,
    0x3c, 0x1, 0x0,
    /* U+0067 "g" */
    0x7, 0xfe, 0x1e, 0x3d, 0x3c, 0x2d, 0x78, 0x2d,
    0xb8, 0x2d, 0xb8, 0x2d, 0xbc, 0x2d, 0x7f, 0xad,
    0x2f, 0x3d, 0x0, 0x3d, 0x0, 0x3d, 0x0, 0x3c,
    0x0, 0x7c, 0x0, 0xf4, 0x3, 0xd0,
    /* U+0068 "h" */
    0x2c, 0x0, 0x1f, 0x0, 0x3, 0xc0, 0x0, 0xf0,
    0x0, 0x3c, 0x0, 0xf, 0xfe, 0x3, 0xe2, 0xe0,
    0xf0, 0x3c, 0x3c, 0x1e, 0xf, 0x7, 0x83, 0xc2,
    0xe0, 0xf0, 0xf8, 0x3d, 0x3e, 0xe, 0x7, 0xc0,
    /* U+0069 "i" */
    0x2d, 0x3d, 0x0, 0x0, 0x2d, 0x3d, 0x3d, 0x2d,
    0x3d, 0x3d, 0x3d, 0x3d, 0x2d,
    /* U+006A "j" */
    0x2, 0xd0, 0x3d, 0x0, 0x0, 0x0, 0x2, 0xe0,
    0x3d, 0x2, 0xd0, 0x2d, 0x2, 0xd0, 0x2d, 0x2,
    0xd0, 0x2d, 0x2, 0xd0, 0x2d, 0x3, 0xd0, 0x3c,
    0x7, 0xc0, 0xf4, 0x3d, 0x0,
    /* U+006B "k" */
    0x6c, 0x0, 0x2f, 0x0, 0x3, 0xc0, 0x0, 0xf0,
    0x0, 0x3c, 0x0, 0xf, 0xb, 0x43, 0xcb, 0x0,
    0xfb, 0x0, 0x3f, 0xb4, 0xf, 0xf, 0x3, 0xc3,
    0xc0, 0xf0, 0xf4, 0x3c, 0x3d, 0x1e, 0x7, 0xc0,
    /* U+006C "l" */
    0x2c, 0x7d, 0x3d, 0x3d, 0x3d, 0x2c, 0x2c, 0x2c,
    0x3c, 0x3c, 0x3c, 0x3c, 0x3d, 0x2d,
    /* U+006D "m" */
    0x3a, 0xf5, 0xfc, 0xf, 0x9f, 0xdb, 0xc3, 0xc2,
    0xd0, 0xf0, 0xf0, 0xb4, 0x3c, 0x3c, 0x2d, 0x1f,
    0xf, 0xb, 0x4b, 0x83, 0xc2, 0xd2, 0xe0, 0xf0,
    0xb4, 0xbc, 0x78, 0x3c, 0xf, 0x0,
    /* U+006E "n" */
    0x3a, 0xf8, 0x3e, 0x7d, 0x3c, 0x1e, 0x3c, 0x1e,
    0x3c, 0x2d, 0x3c, 0x3d, 0x3c, 0x3d, 0x7c, 0x3d,
    0x78, 0x1f,
    /* U+006F "o" */
    0x6, 0xfe, 0x2, 0xbe, 0x0, 0xc3, 0xd0, 0xe0,
    0x7c, 0x74, 0xf, 0x2d, 0x3, 0xc7, 0x81, 0xe0,
    0xf4, 0xf0, 0xf, 0xe0, 0x0,
    /* U+0070 "p" */
    0x7b, 0xf4, 0x3d, 0x7c, 0x3c, 0x2d, 0x3c, 0x1e,
    0x3c, 0x1f, 0x3c, 0x1e, 0x38, 0x7d, 0x3a, 0xfc,
    0x78, 0xf4, 0x78, 0x0, 0x78, 0x0, 0x7c, 0x0,
    0x7c, 0x0, 0xbc, 0x0, 0xa0, 0x0,
    /* U+0071 "q" */
    0x7, 0xff, 0x7, 0x8b, 0x83, 0xc1, 0xe1, 0xf0,
    0x78, 0x78, 0x1e, 0x1e, 0x7, 0x87, 0xc1, 0xf0,
    0xfe, 0x7c, 0x1f, 0x6e, 0x0, 0x1f, 0x40, 0x2,
    0xd0, 0x0, 0xb8, 0x0, 0x2e, 0x0, 0xb, 0x80,
    0x0, 0xb0,
    /* U+0072 "r" */
    0x3a, 0xf0, 0xfa, 0xe3, 0xc3, 0xcf, 0x1e, 0x3c,
    0x24, 0xf0, 0x3, 0xc0, 0xf, 0x0, 0x78, 0x0,
    /* U+0073 "s" */
    0xb, 0xf0, 0xf5, 0x83, 0xc0, 0xf, 0xe0, 0xb,
    0xf0, 0x83, 0xeb, 0xb, 0xae, 0xbd, 0x2f, 0xd0,
    /* U+0074 "t" */
    0xd, 0xb, 0x42, 0xd2, 0xfe, 0x2d, 0xb, 0x2,
    0xc0, 0xb0, 0x3c, 0xf, 0x43, 0xd0, 0xb4,
    /* U+0075 "u" */
    0x7c, 0x1e, 0x3d, 0x3e, 0x3d, 0x2d, 0x3c, 0x2d,
    0x3c, 0x2d, 0x38, 0x2d, 0x78, 0x3d, 0x3e, 0xbd,
    0x1f, 0x9d,
    /* U+0076 "v" */
    0x2e, 0xb, 0x4b, 0xc3, 0xe0, 0xf0, 0x78, 0x3d,
    0x1d, 0xb, 0x8b, 0x1, 0xf3, 0x40, 0x3f, 0xc0,
    0xf, 0xc0, 0x1, 0xc0, 0x0,
    /* U+0077 "w" */
    0x2e, 0xb, 0x7, 0xc2, 0xf0, 0xf4, 0xbc, 0xf,
    0xb, 0x83, 0xc0, 0xf0, 0x7c, 0x2c, 0xb, 0x47,
    0xc3, 0x80, 0x78, 0xfd, 0x30, 0x3, 0xee, 0xed,
    0x0, 0x3f, 0xf, 0x80, 0x1, 0x80, 0x90, 0x0,
    /* U+0078 "x" */
    0x7c, 0xf, 0xf, 0xcb, 0x0, 0xfb, 0x0, 0x1f,
    0x40, 0x3, 0xe0, 0x1, 0xfc, 0x1, 0xdb, 0x83,
    0xf0, 0xf8, 0xb0, 0x1e, 0x0,
    /* U+0079 "y" */
    0x2d, 0xb, 0xc3, 0xf0, 0xbc, 0xf, 0x3, 0x80,
    0xf4, 0x34, 0x7, 0x87, 0x0, 0x3c, 0xd0, 0x2,
    0xfc, 0x0, 0x1f, 0x40, 0x0, 0xf0, 0x0, 0xd,
    0x0, 0x1, 0xc0, 0x0, 0x3c, 0x0, 0x3, 0xc0,
    0x0, 0x7c, 0x0, 0x2, 0xc0, 0x0,
    /* U+007A "z" */
    0x3f, 0xfd, 0x34, 0xbc, 0x10, 0xf4, 0x2, 0xe0,
    0x7, 0xc0, 0xf, 0x58, 0x2e, 0x1e, 0x7d, 0x7d,
    0xff, 0xf8,
    /* U+007B "{" */
    0x6, 0xb, 0x42, 0xc0, 0xb0, 0x2c, 0xb, 0x2,
    0xc0, 0xe0, 0xb0, 0xe, 0x2, 0xc0, 0xb0, 0x2c,
    0xb, 0x2, 0xc0, 0xb0, 0xa, 0x0, 0x0,
    /* U+007C "|" */
    0xaa, 0xaa, 0xaa, 0xee, 0xee, 0xee, 0xee, 0xe9,
    /* U+007D "}" */
    0x10, 0xb, 0x1, 0xe0, 0x38, 0xe, 0x3, 0x80,
    0xe0, 0x38, 0xb, 0x0, 0xd0, 0xe0, 0x38, 0xe,
    0x3, 0x80, 0xe0, 0x38, 0x1d, 0x9, 0x0,
    /* U+007E "~" */
    0x6f, 0x0, 0x0,
    /* U+00C0 "À" */
    0x0, 0x0, 0x0, 0x0, 0xc, 0x0, 0x0, 0xe,
    0x0, 0x0, 0x2, 0x0, 0x0, 0x0, 0x0, 0x0,
    0x7, 0x40, 0x0, 0x2f, 0x80, 0x0, 0xa7, 0xc0,
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    0xbd,
    /* U+00C2 "Â" */
    0x0, 0x5, 0x0, 0x0, 0x1f, 0x40, 0x0, 0x35,
    0xc0, 0x0, 0x0, 0x0, 0x0, 0x7, 0x40, 0x0,
    0x2f, 0x80, 0x0, 0xa7, 0xc0, 0x1, 0xc3, 0xc0,
    0x3, 0x43, 0xd0, 0xb, 0x3, 0xd0, 0xbf, 0xff,
    0xe0, 0x3d, 0x56, 0xf0, 0x3c, 0x1, 0xf0, 0x3c,
    0x1, 0xf0, 0x3c, 0x0, 0xf4, 0x7f, 0x40, 0xf8,
    0x3f, 0x80, 0xfc, 0x2e, 0x0, 0xbd,
    /* U+00C4 "Ä" */
    0x0, 0x34, 0xb0, 0x0, 0x24, 0x60, 0x0, 0x0,
    0x0, 0x0, 0x0, 0x0, 0x0, 0x7, 0x40, 0x0,
    0x2f, 0x80, 0x0, 0xbb, 0xc0, 0x1, 0xc3, 0xc0,
    0x3, 0x43, 0xd0, 0xb, 0x3, 0xd0, 0xbf, 0xff,
    0xe0, 0x3d, 0x56, 0xf0, 0x3c, 0x1, 0xf0, 0x3c,
    0x1, 0xf0, 0x3c, 0x0, 0xf4, 0x7f, 0x40, 0xf8,
    0x3f, 0x80, 0xfc, 0x2e, 0x0, 0xbd,
    /* U+00C6 "Æ" */
    0x0, 0x7, 0x41, 0xfd, 0x0, 0x2f, 0x8f, 0xea,
    0x0, 0xbb, 0xfe, 0x0, 0x1, 0xc3, 0xfc, 0x0,
    0x3, 0x43, 0xf4, 0x0, 0xf, 0x3, 0xff, 0xf4,
    0xbf, 0xff, 0xf5, 0x50, 0x7d, 0x56, 0xf0, 0x0,
    0x3c, 0x1, 0xf0, 0x0, 0x3c, 0x1, 0xf4, 0x0,
    0x7c, 0x0, 0xfc, 0x0, 0x7e, 0x0, 0xff, 0x9b,
    0x3f, 0x80, 0xff, 0xfe, 0x2e, 0x0, 0xbf, 0xf8,
    /* U+00C7 "Ç" */
    0x0, 0xbf, 0x40, 0x7d, 0x7d, 0xf, 0x3, 0xe2,
    0xe0, 0x7e, 0x3d, 0xb, 0xd3, 0xc0, 0x24, 0x7c,
    0x0, 0x7, 0xc0, 0x0, 0x7c, 0x0, 0x7, 0xd0,
    0x0, 0x3f, 0x0, 0xa3, 0xfd, 0x6d, 0x1f, 0xff,
    0xc0, 0x7f, 0xf0, 0x0, 0xa0, 0x0, 0x3, 0x0,
    0x0, 0xa0, 0x0,
    /* U+00C8 "È" */
    0x0, 0x4, 0x0, 0x0, 0x3c, 0x0, 0x0, 0x14,
    0x0, 0x0, 0x0, 0x0, 0x1b, 0xf0, 0x3, 0xfa,
    0x80, 0x3f, 0x0, 0x1, 0xf0, 0x0, 0xb, 0xc0,
    0x0, 0xff, 0xff, 0x1, 0xf9, 0x50, 0x3, 0xd0,
    0x0, 0xf, 0x80, 0x0, 0x3f, 0x0, 0x0, 0xbd,
    0x0, 0x1, 0xff, 0xac, 0x2, 0xff, 0xf0, 0x1,
    0xfe, 0x0,
    /* U+00C9 "É" */
    0x0, 0x0, 0x40, 0x0, 0xb, 0x0, 0x0, 0x20,
    0x0, 0x0, 0x0, 0x0, 0x1b, 0xf0, 0x3, 0xfa,
    0x80, 0x3f, 0x0, 0x1, 0xf0, 0x0, 0xb, 0xc0,
    0x0, 0xff, 0xff, 0x1, 0xf9, 0x50, 0x3, 0xd0,
    0x0, 0xf, 0x80, 0x0, 0x3f, 0x0, 0x0, 0xbd,
    0x0, 0x1, 0xff, 0xac, 0x2, 0xff, 0xf0, 0x1,
    0xfe, 0x0,
    /* U+00CA "Ê" */
    0x0, 0x1, 0x0, 0x0, 0x3f, 0x0, 0x1, 0x45,
    0x0, 0x0, 0x0, 0x0, 0x1b, 0xf0, 0x3, 0xfa,
    0x80, 0x3f, 0x0, 0x1, 0xf0, 0x0, 0xb, 0xc0,
    0x0, 0xff, 0xff, 0x1, 0xf9, 0x50, 0x3, 0xd0,
    0x0, 0xf, 0x80, 0x0, 0x3f, 0x0, 0x0, 0xbd,
    0x0, 0x1, 0xff, 0xac, 0x2, 0xff, 0xf0, 0x1,
    0xfe, 0x0,
    /* U+00CB "Ë" */
    0x0, 0xb0, 0xd0, 0x1, 0x82, 0x40, 0x0, 0x0,
    0x0, 0x6, 0xfc, 0x0, 0xfe, 0xa0, 0xf, 0xc0,
    0x0, 0x7c, 0x0, 0x2, 0xf0, 0x0, 0x3f, 0xff,
    0xc0, 0x7e, 0x54, 0x0, 0xf4, 0x0, 0x3, 0xe0,
    0x0, 0xf, 0xc0, 0x0, 0x2f, 0x40, 0x0, 0x7f,
    0xeb, 0x0, 0xbf, 0xfc, 0x0, 0x7f, 0x80,
    /* U+00CE "Î" */
    0x5, 0xf, 0xc5, 0x18, 0x0, 0x2f, 0xf, 0xc2,
    0xf0, 0xbc, 0x2f, 0xb, 0xc2, 0xf0, 0xbc, 0x2f,
    0xb, 0xc2, 0xf0, 0xbc, 0x2f, 0xf, 0x80,
    /* U+00CF "Ï" */
    0x38, 0xb0, 0xa1, 0x80, 0x0, 0x2, 0xf0, 0xf,
    0xc0, 0x2f, 0x0, 0xbc, 0x2, 0xf0, 0xb, 0xc0,
    0x2f, 0x0, 0xbc, 0x2, 0xf0, 0xb, 0xc0, 0x2f,
    0x0, 0xbc, 0x2, 0xf0, 0xf, 0x80,
    /* U+00D4 "Ô" */
    0x0, 0x14, 0x0, 0x2, 0xf4, 0x0, 0x8, 0x20,
    0x0, 0x0, 0x0, 0x0, 0xbf, 0x40, 0xf, 0xaf,
    0x40, 0x74, 0x2f, 0x7, 0xc0, 0x3d, 0x3f, 0x0,
    0xf9, 0xfc, 0x3, 0xe7, 0xf8, 0xb, 0xef, 0x40,
    0x2f, 0xbc, 0x0, 0xf9, 0xf0, 0x3, 0xd7, 0xd0,
    0xf, 0xf, 0xc0, 0xf8, 0x1f, 0xef, 0xc0, 0xb,
    0xf4, 0x0,
    /* U+00D6 "Ö" */
    0x2, 0xc3, 0x40, 0x6, 0xa, 0x0, 0x0, 0x0,
    0x0, 0x2f, 0xd0, 0x3, 0xeb, 0xd0, 0x1d, 0xb,
    0xc1, 0xf0, 0xf, 0x4f, 0xc0, 0x3e, 0x7f, 0x0,
    0xf9, 0xfe, 0x2, 0xfb, 0xd0, 0xb, 0xef, 0x0,
    0x3e, 0x7c, 0x0, 0xf5, 0xf4, 0x3, 0xc3, 0xf0,
    0x3e, 0x7, 0xfb, 0xf0, 0x2, 0xfd, 0x0,
    /* U+00DB "Û" */
    0x0, 0x14, 0x0, 0x2, 0xf0, 0x0, 0x18, 0x60,
    0x0, 0x0, 0x0, 0x2f, 0x1, 0xf4, 0xfc, 0xb,
    0xc3, 0xe0, 0x2f, 0xf, 0x80, 0xbc, 0x3e, 0x2,
    0xf0, 0xf8, 0xb, 0xc3, 0xe0, 0x2f, 0xf, 0x80,
    0xbc, 0x3e, 0x2, 0xf0, 0xf8, 0xf, 0xc3, 0xe0,
    0x3f, 0xf, 0xe7, 0xfc, 0x1f, 0xfe, 0xf0, 0x2f,
    0x87, 0xc0,
    /* U+00DC "Ü" */
    0x3, 0x87, 0x0, 0xa, 0x19, 0x0, 0x0, 0x0,
    0xb, 0xc0, 0x7d, 0x3f, 0x2, 0xf0, 0xf8, 0xb,
    0xc3, 0xe0, 0x2f, 0xf, 0x80, 0xbc, 0x3e, 0x2,
    0xf0, 0xf8, 0xb, 0xc3, 0xe0, 0x2f, 0xf, 0x80,
    0xbc, 0x3e, 0x3, 0xf0, 0xf8, 0xf, 0xc3, 0xf9,
    0xff, 0x7, 0xff, 0xbc, 0xb, 0xe1, 0xf0,
    /* U+00E0 "à" */
    0x2, 0x80, 0x0, 0xd0, 0x0, 0x10, 0x0, 0x0,
    0xb, 0xf4, 0x3d, 0x3c, 0x3c, 0x2d, 0x2, 0xfd,
    0x2f, 0x7d, 0x78, 0x2c, 0xb8, 0x3d, 0xbf, 0x7d,
    0x3f, 0x2e,
    /* U+00E2 "â" */
    0x2, 0xe0, 0x7, 0x74, 0x4, 0x4, 0x0, 0x0,
    0xb, 0xf4, 0x3d, 0x3c, 0x3c, 0x2d, 0x2, 0xfd,
    0x2f, 0x7d, 0x78, 0x2c, 0xb8, 0x3d, 0xbf, 0x7d,
    0x3f, 0x2e,
    /* U+00E4 "ä" */
    0x8, 0x14, 0x1d, 0x3c, 0x0, 0x0, 0x0, 0x0,
    0xb, 0xf4, 0x3d, 0x3c, 0x3c, 0x2d, 0x2, 0xfd,
    0x2f, 0x7d, 0x78, 0x2c, 0xb8, 0x3d, 0xbf, 0x7d,
    0x3f, 0x2e,
    /* U+00E6 "æ" */
    0xb, 0xf6, 0xfc, 0x3d, 0x3f, 0x5f, 0x2c, 0x3f,
    0xf, 0x2, 0xfe, 0x2d, 0x2e, 0x7f, 0xf8, 0x78,
    0x3f, 0x40, 0xb8, 0x3f, 0x6, 0xbf, 0x7f, 0xfd,
    0x3f, 0x2f, 0xf4,
    /* U+00E7 "ç" */
    0x7, 0xf4, 0x1e, 0x3c, 0x3c, 0x3c, 0x78, 0x24,
    0x78, 0x0, 0x7c, 0x0, 0x7d, 0xc, 0x3f, 0xfc,
    0xf, 0xe0, 0x1, 0x40, 0x1, 0x40,
    /* U+00E8 "è" */
    0x7, 0x0, 0x2, 0x80, 0x0, 0x40, 0x0, 0x0,
    0xb, 0xf0, 0x2d, 0x3c, 0x38, 0x3c, 0x78, 0xb8,
    0xbf, 0xe0, 0xbd, 0x0, 0x7c, 0xc, 0x3f, 0xf8,
    0xf, 0xe0,
    /* U+00E9 "é" */
    0x0, 0xd0, 0x2, 0xc0, 0x1, 0x0, 0x0, 0x0,
    0xb, 0xf0, 0x2d, 0x3c, 0x38, 0x3c, 0x78, 0xb8,
    0xbf, 0xe0, 0xbd, 0x0, 0x7c, 0xc, 0x3f, 0xf8,
    0xf, 0xe0,
    /* U+00EA "ê" */
    0x3, 0xc0, 0xa, 0xb0, 0x4, 0x0, 0x0, 0x0,
    0xb, 0xf0, 0x2d, 0x3c, 0x38, 0x3c, 0x78, 0xb8,
    0xbf, 0xe0, 0xbd, 0x0, 0x7c, 0xc, 0x3f, 0xf8,
    0xf, 0xe0,
    /* U+00EB "ë" */
    0x14, 0x20, 0x3c, 0x74, 0x0, 0x0, 0x0, 0x0,
    0xb, 0xf0, 0x2d, 0x3c, 0x38, 0x3c, 0x78, 0xb8,
    0xbf, 0xe0, 0xbd, 0x0, 0x7c, 0xc, 0x3f, 0xf8,
    0xf, 0xe0,
    /* U+00EE "î" */
    0xf, 0x42, 0x9c, 0x10, 0x0, 0x0, 0xb, 0x40,
    0xf4, 0xf, 0x40, 0xb4, 0xf, 0x40, 0xf4, 0xf,
    0x40, 0xf4, 0xb, 0x40,
    /* U+00EF "ï" */
    0x60, 0x97, 0x4f, 0x0, 0x0, 0x0, 0xb, 0x40,
    0xf4, 0xf, 0x40, 0xb4, 0xf, 0x40, 0xf4, 0xf,
    0x40, 0xf4, 0xb, 0x40,
    /* U+00F4 "ô" */
    0x1, 0xf0, 0x0, 0xda, 0x0, 0x0, 0x40, 0x0,
    0x0, 0x6, 0xfe, 0x2, 0xbe, 0x0, 0xc3, 0xd0,
    0xe0, 0x7c, 0x74, 0xf, 0x2d, 0x3, 0xc7, 0x81,
    0xe0, 0xf4, 0xf0, 0xf, 0xe0, 0x0,
    /* U+00F6 "ö" */
    0x8, 0x18, 0x3, 0x8b, 0x0, 0x0, 0x0, 0x0,
    0x0, 0x6, 0xfe, 0x2, 0xbe, 0x0, 0xc3, 0xd0,
    0xe0, 0x7c, 0x74, 0xf, 0x2d, 0x3, 0xc7, 0x81,
    0xe0, 0xf4, 0xf0, 0xf, 0xe0, 0x0,
    /* U+00FB "û" */
    0x2, 0xe0, 0x7, 0x70, 0x4, 0x0, 0x0, 0x0,
    0x7c, 0x1e, 0x3d, 0x3e, 0x3d, 0x2d, 0x3c, 0x2d,
    0x3c, 0x2d, 0x38, 0x2d, 0x78, 0x3d, 0x3e, 0xbd,
    0x1f, 0x9d,
    /* U+00FC "ü" */
    0x18, 0x24, 0x1d, 0x3c, 0x0, 0x0, 0x0, 0x0,
    0x7c, 0x1e, 0x3d, 0x3e, 0x3d, 0x2d, 0x3c, 0x2d,
    0x3c, 0x2d, 0x38, 0x2d, 0x78, 0x3d, 0x3e, 0xbd,
    0x1f, 0x9d,
    /* U+00FF "ÿ" */
    0xb, 0xd, 0x0, 0x60, 0x90, 0x0, 0x0, 0x2,
    0xd0, 0xbc, 0x3f, 0xb, 0xc0, 0xf0, 0x38, 0xf,
    0x43, 0x40, 0x78, 0x70, 0x3, 0xcd, 0x0, 0x2f,
    0xc0, 0x1, 0xf4, 0x0, 0xf, 0x0, 0x0, 0xd0,
    0x0, 0x1c, 0x0, 0x3, 0xc0, 0x0, 0x3c, 0x0,
    0x7, 0xc0, 0x0, 0x2c, 0x0,
    /* U+0152 "Œ" */
    0x0, 0xbe, 0x0, 0xbf, 0x0, 0xfb, 0xf1, 0xfa,
    0x90, 0xb0, 0x3f, 0xf0, 0x0, 0xbc, 0x7, 0xf4,
    0x0, 0x3f, 0x0, 0xfc, 0x0, 0x1f, 0xd0, 0x3f,
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    0xbf, 0x41, 0xbf, 0x40,
    /* U+0153 "œ" */
    0x6, 0xff, 0xbf, 0x2, 0xbf, 0xf5, 0xf0, 0x83,
    0xf8, 0x3c, 0xf0, 0x3d, 0x2d, 0x78, 0xf, 0xfe,
    0x1e, 0x3, 0xe4, 0x7, 0x81, 0xfc, 0x18, 0xf4,
    0xff, 0xfd, 0xb, 0xe1, 0xfd, 0x0,
    /* U+0178 "Ÿ" */
    0x0, 0x81, 0x80, 0x0, 0x38, 0xb0, 0x0, 0x0,
    0x0, 0x0, 0x0, 0x0, 0x0, 0x2f, 0x0, 0x3f,
    0xf, 0xd0, 0xf, 0x40, 0xfc, 0x7, 0x80, 0x1f,
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    0x1e, 0x0, 0x0
};
/*---------------------
 *  GLYPH DESCRIPTION
 *--------------------*/
static const lv_font_fmt_txt_glyph_dsc_t aladin_20_glyph_dsc[] = {
    {.bitmap_index = 0, .adv_w = 0, .box_w = 0, .box_h = 0, .ofs_x = 0, .ofs_y = 0} /* id = 0 reserved */,
    {.bitmap_index = 0, .adv_w = 58, .box_w = 0, .box_h = 0, .ofs_x = 0, .ofs_y = 0},
    {.bitmap_index = 0, .adv_w = 77, .box_w = 3, .box_h = 14, .ofs_x = 1, .ofs_y = 0},
    {.bitmap_index = 11, .adv_w = 88, .box_w = 5, .box_h = 4, .ofs_x = 1, .ofs_y = 10},
    {.bitmap_index = 16, .adv_w = 188, .box_w = 11, .box_h = 10, .ofs_x = 0, .ofs_y = 2},
    {.bitmap_index = 44, .adv_w = 165, .box_w = 11, .box_h = 18, .ofs_x = 0, .ofs_y = -2},
    {.bitmap_index = 94, .adv_w = 186, .box_w = 12, .box_h = 14, .ofs_x = 0, .ofs_y = 0},
    {.bitmap_index = 136, .adv_w = 185, .box_w = 12, .box_h = 14, .ofs_x = 0, .ofs_y = 0},
    {.bitmap_index = 178, .adv_w = 44, .box_w = 2, .box_h = 4, .ofs_x = 1, .ofs_y = 10},
    {.bitmap_index = 180, .adv_w = 70, .box_w = 6, .box_h = 18, .ofs_x = 0, .ofs_y = -2},
    {.bitmap_index = 207, .adv_w = 70, .box_w = 5, .box_h = 18, .ofs_x = -1, .ofs_y = -2},
    {.bitmap_index = 230, .adv_w = 76, .box_w = 5, .box_h = 4, .ofs_x = 0, .ofs_y = 10},
    {.bitmap_index = 235, .adv_w = 166, .box_w = 10, .box_h = 10, .ofs_x = 0, .ofs_y = 2},
    {.bitmap_index = 260, .adv_w = 69, .box_w = 3, .box_h = 4, .ofs_x = 1, .ofs_y = -2},
    {.bitmap_index = 263, .adv_w = 153, .box_w = 9, .box_h = 2, .ofs_x = 0, .ofs_y = 4},
    {.bitmap_index = 268, .adv_w = 70, .box_w = 3, .box_h = 2, .ofs_x = 1, .ofs_y = 0},
    {.bitmap_index = 270, .adv_w = 123, .box_w = 12, .box_h = 16, .ofs_x = -2, .ofs_y = -1},
    {.bitmap_index = 318, .adv_w = 171, .box_w = 11, .box_h = 14, .ofs_x = 0, .ofs_y = 0},
    {.bitmap_index = 357, .adv_w = 87, .box_w = 5, .box_h = 14, .ofs_x = 0, .ofs_y = 0},
    {.bitmap_index = 375, .adv_w = 154, .box_w = 10, .box_h = 14, .ofs_x = 0, .ofs_y = 0},
    {.bitmap_index = 410, .adv_w = 153, .box_w = 10, .box_h = 14, .ofs_x = 0, .ofs_y = 0},
    {.bitmap_index = 445, .adv_w = 155, .box_w = 10, .box_h = 14, .ofs_x = 0, .ofs_y = 0},
    {.bitmap_index = 480, .adv_w = 155, .box_w = 10, .box_h = 14, .ofs_x = 0, .ofs_y = 0},
    {.bitmap_index = 515, .adv_w = 157, .box_w = 10, .box_h = 14, .ofs_x = 0, .ofs_y = 0},
    {.bitmap_index = 550, .adv_w = 129, .box_w = 8, .box_h = 14, .ofs_x = 0, .ofs_y = 0},
    {.bitmap_index = 578, .adv_w = 159, .box_w = 10, .box_h = 14, .ofs_x = 0, .ofs_y = 0},
    {.bitmap_index = 613, .adv_w = 159, .box_w = 10, .box_h = 14, .ofs_x = 0, .ofs_y = 0},
    {.bitmap_index = 648, .adv_w = 69, .box_w = 3, .box_h = 9, .ofs_x = 1, .ofs_y = 0},
    {.bitmap_index = 655, .adv_w = 69, .box_w = 3, .box_h = 11, .ofs_x = 1, .ofs_y = -2},
    {.bitmap_index = 664, .adv_w = 135, .box_w = 8, .box_h = 10, .ofs_x = 0, .ofs_y = 2},
    {.bitmap_index = 684, .adv_w = 160, .box_w = 10, .box_h = 5, .ofs_x = 0, .ofs_y = 4},
    {.bitmap_index = 697, .adv_w = 135, .box_w = 8, .box_h = 10, .ofs_x = 0, .ofs_y = 2},
    {.bitmap_index = 717, .adv_w = 138, .box_w = 9, .box_h = 14, .ofs_x = 0, .ofs_y = 0},
    {.bitmap_index = 749, .adv_w = 292, .box_w = 18, .box_h = 16, .ofs_x = 0, .ofs_y = -4},
    {.bitmap_index = 821, .adv_w = 183, .box_w = 12, .box_h = 14, .ofs_x = 0, .ofs_y = 0},
    {.bitmap_index = 863, .adv_w = 167, .box_w = 11, .box_h = 14, .ofs_x = 0, .ofs_y = 0},
    {.bitmap_index = 902, .adv_w = 162, .box_w = 10, .box_h = 16, .ofs_x = 0, .ofs_y = -2},
    {.bitmap_index = 942, .adv_w = 168, .box_w = 11, .box_h = 14, .ofs_x = 0, .ofs_y = 0},
    {.bitmap_index = 981, .adv_w = 153, .box_w = 11, .box_h = 14, .ofs_x = -1, .ofs_y = 0},
    {.bitmap_index = 1020, .adv_w = 130, .box_w = 9, .box_h = 14, .ofs_x = 0, .ofs_y = 0},
    {.bitmap_index = 1052, .adv_w = 172, .box_w = 11, .box_h = 14, .ofs_x = 0, .ofs_y = 0},
    {.bitmap_index = 1091, .adv_w = 176, .box_w = 11, .box_h = 14, .ofs_x = 0, .ofs_y = 0},
    {.bitmap_index = 1130, .adv_w = 78, .box_w = 5, .box_h = 14, .ofs_x = 0, .ofs_y = 0},
    {.bitmap_index = 1148, .adv_w = 79, .box_w = 6, .box_h = 17, .ofs_x = -1, .ofs_y = -3},
    {.bitmap_index = 1174, .adv_w = 158, .box_w = 11, .box_h = 14, .ofs_x = 0, .ofs_y = 0},
    {.bitmap_index = 1213, .adv_w = 143, .box_w = 9, .box_h = 14, .ofs_x = 0, .ofs_y = 0},
    {.bitmap_index = 1245, .adv_w = 222, .box_w = 14, .box_h = 14, .ofs_x = 0, .ofs_y = 0},
    {.bitmap_index = 1294, .adv_w = 170, .box_w = 11, .box_h = 14, .ofs_x = 0, .ofs_y = 0},
    {.bitmap_index = 1333, .adv_w = 180, .box_w = 11, .box_h = 14, .ofs_x = 0, .ofs_y = 0},
    {.bitmap_index = 1372, .adv_w = 158, .box_w = 11, .box_h = 14, .ofs_x = 0, .ofs_y = 0},
    {.bitmap_index = 1411, .adv_w = 180, .box_w = 11, .box_h = 15, .ofs_x = 0, .ofs_y = -1},
    {.bitmap_index = 1453, .adv_w = 169, .box_w = 11, .box_h = 14, .ofs_x = 0, .ofs_y = 0},
    {.bitmap_index = 1492, .adv_w = 163, .box_w = 10, .box_h = 14, .ofs_x = 0, .ofs_y = 0},
    {.bitmap_index = 1527, .adv_w = 128, .box_w = 10, .box_h = 14, .ofs_x = -1, .ofs_y = 0},
    {.bitmap_index = 1562, .adv_w = 175, .box_w = 11, .box_h = 14, .ofs_x = 0, .ofs_y = 0},
    {.bitmap_index = 1601, .adv_w = 167, .box_w = 12, .box_h = 14, .ofs_x = -1, .ofs_y = 0},
    {.bitmap_index = 1643, .adv_w = 267, .box_w = 18, .box_h = 14, .ofs_x = -1, .ofs_y = 0},
    {.bitmap_index = 1706, .adv_w = 189, .box_w = 13, .box_h = 14, .ofs_x = -1, .ofs_y = 0},
    {.bitmap_index = 1752, .adv_w = 169, .box_w = 13, .box_h = 14, .ofs_x = -1, .ofs_y = 0},
    {.bitmap_index = 1798, .adv_w = 173, .box_w = 12, .box_h = 14, .ofs_x = -1, .ofs_y = 0},
    {.bitmap_index = 1840, .adv_w = 60, .box_w = 3, .box_h = 18, .ofs_x = 1, .ofs_y = -2},
    {.bitmap_index = 1854, .adv_w = 187, .box_w = 12, .box_h = 16, .ofs_x = -1, .ofs_y = -1},
    {.bitmap_index = 1902, .adv_w = 59, .box_w = 4, .box_h = 18, .ofs_x = -1, .ofs_y = -2},
    {.bitmap_index = 1920, .adv_w = 96, .box_w = 6, .box_h = 3, .ofs_x = 0, .ofs_y = 4},
    {.bitmap_index = 1925, .adv_w = 153, .box_w = 9, .box_h = 2, .ofs_x = 0, .ofs_y = -2},
    {.bitmap_index = 1930, .adv_w = 126, .box_w = 8, .box_h = 9, .ofs_x = 0, .ofs_y = 0},
    {.bitmap_index = 1948, .adv_w = 134, .box_w = 9, .box_h = 14, .ofs_x = 0, .ofs_y = 0},
    {.bitmap_index = 1980, .adv_w = 122, .box_w = 8, .box_h = 9, .ofs_x = 0, .ofs_y = 0},
    {.bitmap_index = 1998, .adv_w = 132, .box_w = 8, .box_h = 14, .ofs_x = 0, .ofs_y = 0},
    {.bitmap_index = 2026, .adv_w = 118, .box_w = 8, .box_h = 9, .ofs_x = 0, .ofs_y = 0},
    {.bitmap_index = 2044, .adv_w = 71, .box_w = 6, .box_h = 18, .ofs_x = -1, .ofs_y = -4},
    {.bitmap_index = 2071, .adv_w = 128, .box_w = 8, .box_h = 15, .ofs_x = 0, .ofs_y = -6},
    {.bitmap_index = 2101, .adv_w = 132, .box_w = 9, .box_h = 14, .ofs_x = 0, .ofs_y = 0},
    {.bitmap_index = 2133, .adv_w = 67, .box_w = 4, .box_h = 13, .ofs_x = 0, .ofs_y = 0},
    {.bitmap_index = 2146, .adv_w = 67, .box_w = 6, .box_h = 19, .ofs_x = -2, .ofs_y = -6},
    {.bitmap_index = 2175, .adv_w = 126, .box_w = 9, .box_h = 14, .ofs_x = 0, .ofs_y = 0},
    {.bitmap_index = 2207, .adv_w = 65, .box_w = 4, .box_h = 14, .ofs_x = 0, .ofs_y = 0},
    {.bitmap_index = 2221, .adv_w = 197, .box_w = 13, .box_h = 9, .ofs_x = 0, .ofs_y = 0},
    {.bitmap_index = 2251, .adv_w = 128, .box_w = 8, .box_h = 9, .ofs_x = 0, .ofs_y = 0},
    {.bitmap_index = 2269, .adv_w = 134, .box_w = 9, .box_h = 9, .ofs_x = 0, .ofs_y = 0},
    {.bitmap_index = 2290, .adv_w = 131, .box_w = 8, .box_h = 15, .ofs_x = 0, .ofs_y = -6},
    {.bitmap_index = 2320, .adv_w = 137, .box_w = 9, .box_h = 15, .ofs_x = 0, .ofs_y = -6},
    {.bitmap_index = 2354, .adv_w = 114, .box_w = 7, .box_h = 9, .ofs_x = 0, .ofs_y = 0},
    {.bitmap_index = 2370, .adv_w = 110, .box_w = 7, .box_h = 9, .ofs_x = 0, .ofs_y = 0},
    {.bitmap_index = 2386, .adv_w = 72, .box_w = 5, .box_h = 12, .ofs_x = 0, .ofs_y = 0},
    {.bitmap_index = 2401, .adv_w = 129, .box_w = 8, .box_h = 9, .ofs_x = 0, .ofs_y = 0},
    {.bitmap_index = 2419, .adv_w = 124, .box_w = 9, .box_h = 9, .ofs_x = -1, .ofs_y = 0},
    {.bitmap_index = 2440, .adv_w = 196, .box_w = 14, .box_h = 9, .ofs_x = -1, .ofs_y = 0},
    {.bitmap_index = 2472, .adv_w = 132, .box_w = 9, .box_h = 9, .ofs_x = 0, .ofs_y = 0},
    {.bitmap_index = 2493, .adv_w = 124, .box_w = 10, .box_h = 15, .ofs_x = -1, .ofs_y = -6},
    {.bitmap_index = 2531, .adv_w = 122, .box_w = 8, .box_h = 9, .ofs_x = 0, .ofs_y = 0},
    {.bitmap_index = 2549, .adv_w = 62, .box_w = 5, .box_h = 18, .ofs_x = 0, .ofs_y = -3},
    {.bitmap_index = 2572, .adv_w = 57, .box_w = 2, .box_h = 16, .ofs_x = 1, .ofs_y = -1},
    {.bitmap_index = 2580, .adv_w = 62, .box_w = 5, .box_h = 18, .ofs_x = -1, .ofs_y = -2},
    {.bitmap_index = 2603, .adv_w = 102, .box_w = 5, .box_h = 2, .ofs_x = 1, .ofs_y = 4},
    {.bitmap_index = 2606, .adv_w = 183, .box_w = 12, .box_h = 19, .ofs_x = 0, .ofs_y = 0},
    {.bitmap_index = 2663, .adv_w = 183, .box_w = 12, .box_h = 18, .ofs_x = 0, .ofs_y = 0},
    {.bitmap_index = 2717, .adv_w = 183, .box_w = 12, .box_h = 18, .ofs_x = 0, .ofs_y = 0},
    {.bitmap_index = 2771, .adv_w = 275, .box_w = 16, .box_h = 14, .ofs_x = 1, .ofs_y = 0},
    {.bitmap_index = 2827, .adv_w = 162, .box_w = 10, .box_h = 17, .ofs_x = 0, .ofs_y = -3},
    {.bitmap_index = 2870, .adv_w = 153, .box_w = 11, .box_h = 18, .ofs_x = -1, .ofs_y = 0},
    {.bitmap_index = 2920, .adv_w = 153, .box_w = 11, .box_h = 18, .ofs_x = -1, .ofs_y = 0},
    {.bitmap_index = 2970, .adv_w = 153, .box_w = 11, .box_h = 18, .ofs_x = -1, .ofs_y = 0},
    {.bitmap_index = 3020, .adv_w = 153, .box_w = 11, .box_h = 17, .ofs_x = -1, .ofs_y = 0},
    {.bitmap_index = 3067, .adv_w = 78, .box_w = 5, .box_h = 18, .ofs_x = 0, .ofs_y = 0},
    {.bitmap_index = 3090, .adv_w = 78, .box_w = 7, .box_h = 17, .ofs_x = -1, .ofs_y = 0},
    {.bitmap_index = 3120, .adv_w = 180, .box_w = 11, .box_h = 18, .ofs_x = 0, .ofs_y = 0},
    {.bitmap_index = 3170, .adv_w = 180, .box_w = 11, .box_h = 17, .ofs_x = 0, .ofs_y = 0},
    {.bitmap_index = 3217, .adv_w = 175, .box_w = 11, .box_h = 18, .ofs_x = 0, .ofs_y = 0},
    {.bitmap_index = 3267, .adv_w = 175, .box_w = 11, .box_h = 17, .ofs_x = 0, .ofs_y = 0},
    {.bitmap_index = 3314, .adv_w = 126, .box_w = 8, .box_h = 13, .ofs_x = 0, .ofs_y = 0},
    {.bitmap_index = 3340, .adv_w = 126, .box_w = 8, .box_h = 13, .ofs_x = 0, .ofs_y = 0},
    {.bitmap_index = 3366, .adv_w = 126, .box_w = 8, .box_h = 13, .ofs_x = 0, .ofs_y = 0},
    {.bitmap_index = 3392, .adv_w = 196, .box_w = 12, .box_h = 9, .ofs_x = 0, .ofs_y = 0},
    {.bitmap_index = 3419, .adv_w = 122, .box_w = 8, .box_h = 11, .ofs_x = 0, .ofs_y = -2},
    {.bitmap_index = 3441, .adv_w = 119, .box_w = 8, .box_h = 13, .ofs_x = 0, .ofs_y = 0},
    {.bitmap_index = 3467, .adv_w = 118, .box_w = 8, .box_h = 13, .ofs_x = 0, .ofs_y = 0},
    {.bitmap_index = 3493, .adv_w = 118, .box_w = 8, .box_h = 13, .ofs_x = 0, .ofs_y = 0},
    {.bitmap_index = 3519, .adv_w = 118, .box_w = 8, .box_h = 13, .ofs_x = 0, .ofs_y = 0},
    {.bitmap_index = 3545, .adv_w = 67, .box_w = 6, .box_h = 13, .ofs_x = -1, .ofs_y = 0},
    {.bitmap_index = 3565, .adv_w = 67, .box_w = 6, .box_h = 13, .ofs_x = -1, .ofs_y = 0},
    {.bitmap_index = 3585, .adv_w = 134, .box_w = 9, .box_h = 13, .ofs_x = 0, .ofs_y = 0},
    {.bitmap_index = 3615, .adv_w = 134, .box_w = 9, .box_h = 13, .ofs_x = 0, .ofs_y = 0},
    {.bitmap_index = 3645, .adv_w = 129, .box_w = 8, .box_h = 13, .ofs_x = 0, .ofs_y = 0},
    {.bitmap_index = 3671, .adv_w = 129, .box_w = 8, .box_h = 13, .ofs_x = 0, .ofs_y = 0},
    {.bitmap_index = 3697, .adv_w = 124, .box_w = 10, .box_h = 18, .ofs_x = -1, .ofs_y = -6},
    {.bitmap_index = 3742, .adv_w = 270, .box_w = 17, .box_h = 14, .ofs_x = 0, .ofs_y = 0},
    {.bitmap_index = 3802, .adv_w = 211, .box_w = 13, .box_h = 9, .ofs_x = 0, .ofs_y = 0},
    {.bitmap_index = 3832, .adv_w = 169, .box_w = 13, .box_h = 18, .ofs_x = -1, .ofs_y = 0}
};
/*---------------------
 *  CHARACTER MAPPING
 *--------------------*/
static const uint16_t aladin_20_unicode_list_2[] = {
    0x0, 0x2, 0x4, 0x6, 0x7, 0x8, 0x9, 0xa,
    0xb, 0xe, 0xf, 0x14, 0x16, 0x1b, 0x1c, 0x20,
    0x22, 0x24, 0x26, 0x27, 0x28, 0x29, 0x2a, 0x2b,
    0x2e, 0x2f, 0x34, 0x36, 0x3b, 0x3c, 0x3f, 0x92,
    0x93, 0xb8
};
/*Collect the unicode lists and glyph_id offsets*/
static const lv_font_fmt_txt_cmap_t aladin_20_cmaps[] =
{
    {
        .range_start = 32, .range_length = 64, .glyph_id_start = 1,
        .unicode_list = NULL, .glyph_id_ofs_list = NULL, .list_length = 0, .type = LV_FONT_FMT_TXT_CMAP_FORMAT0_TINY
    },
    {
        .range_start = 97, .range_length = 30, .glyph_id_start = 65,
        .unicode_list = NULL, .glyph_id_ofs_list = NULL, .list_length = 0, .type = LV_FONT_FMT_TXT_CMAP_FORMAT0_TINY
    },
    {
        .range_start = 192, .range_length = 185, .glyph_id_start = 95,
        .unicode_list = aladin_20_unicode_list_2, .glyph_id_ofs_list = NULL, .list_length = 34, .type = LV_FONT_FMT_TXT_CMAP_SPARSE_TINY
    }
};
/*-----------------
 *    KERNING
 *----------------*/
/*Pair left and right glyphs for kerning*/
static const uint8_t aladin_20_kern_pair_glyph_ids[] =
{
    8, 21,
    8, 83,
    16, 35,
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    89, 83
};
/* Kerning between the respective left and right glyphs
 * 4.4 format which needs to scaled with `kern_scale`*/
static const int8_t aladin_20_kern_pair_values[] =
{
    -11, -10, 17, 24, 21, 14, 17, 10,
    24, 14, 28, 24, 28, -7, -10, -10,
    -3, -3, -10, -3, -16, -10, -3, -6,
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    -6, -3
};
/*Collect the kern pair's data in one place*/
static const lv_font_fmt_txt_kern_pair_t aladin_20_kern_pairs =
{
    .glyph_ids = aladin_20_kern_pair_glyph_ids,
    .values = aladin_20_kern_pair_values,
    .pair_cnt = 338,
    .glyph_ids_size = 0
};
/*--------------------
 *  ALL CUSTOM DATA
 *--------------------*/
/*Store all the custom data of the font*/
static lv_font_fmt_txt_glyph_cache_t aladin_20_cache;
static const lv_font_fmt_txt_dsc_t aladin_20_font_dsc = {
    .glyph_bitmap = aladin_20_glyph_bitmap,
    .glyph_dsc = aladin_20_glyph_dsc,
    .cmaps = aladin_20_cmaps,
    .kern_dsc = &aladin_20_kern_pairs,
    .kern_scale = 16,
    .cmap_num = 3,
    .bpp = 2,
    .kern_classes = 0,
    .bitmap_format = 0,
    .cache = &aladin_20_cache
};
/*-----------------
 *  PUBLIC FONT
 *----------------*/
/*Initialize a public general font descriptor*/
const lv_font_t aladin_20 = {
    .get_glyph_dsc = lv_font_get_glyph_dsc_fmt_txt,    /*Function pointer to get glyph's data*/
    .get_glyph_bitmap = lv_font_get_bitmap_fmt_txt,    /*Function pointer to get glyph's bitmap*/
    .line_height = 25,          /*The maximum line height required by the font*/
    .base_line = 6,             /*Baseline measured from the bottom of the line*/

    .subpx = LV_FONT_SUBPX_NONE,
    .underline_position = -1,
    .underline_thickness = 1,
    .dsc = &aladin_20_font_dsc,          /*The custom font data. Will be accessed by `get_glyph_bitmap/dsc` */
};
#endif

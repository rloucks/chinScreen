/*******************************************************************************
 * Size: 20 px
 * Bpp: 2
 ******************************************************************************/


#ifdef __has_include

    #if __has_include("lvgl.h")
         #ifndef LV_LVGL_H_INCLUDE_SIMPLE
             #define LV_LVGL_H_INCLUDE_SIMPLE
         #endif
     #endif
 #endif

 #ifdef LV_LVGL_H_INCLUDE_SIMPLE
     #include "lvgl.h"
 #else
     #include "../lvgl-8.3.11/lvgl.h"
 #endif

 #ifndef MODERN_20
 #define MODERN_20 1
 #endif

 #if MODERN_20

/*-----------------
 *    BITMAPS
 *----------------*/
/*Store the image of the glyphs*/
static LV_ATTRIBUTE_LARGE_CONST const uint8_t modern_20_glyph_bitmap[] = {
    /* U+0020 " " */
    /* U+0021 "!" */
    0x20, 0x82, 0x8, 0x20, 0x82, 0x8, 0x20, 0x82,
    0x0, 0x1, 0xc0,
    /* U+0022 "\"" */
    0x51, 0x51, 0x51, 0x1,
    /* U+0023 "#" */
    0x0, 0x0, 0x0, 0x10, 0x10, 0x2, 0x2, 0x0,
    0x20, 0x20, 0x2, 0x2, 0x6, 0xba, 0xb9, 0x5,
    0x5, 0x0, 0x40, 0x80, 0x8, 0x8, 0xa, 0xea,
    0xe8, 0x8, 0x8, 0x0, 0x40, 0x40, 0x14, 0x10,
    0x2, 0x2, 0x0, 0x10, 0x10, 0x0,
    /* U+0024 "$" */
    0x1, 0x40, 0x2, 0xa9, 0x2, 0x14, 0x42, 0x5,
    0x0, 0x81, 0x40, 0x8, 0x50, 0x0, 0xa8, 0x0,
    0x6, 0xa0, 0x1, 0x42, 0x0, 0x50, 0x50, 0x14,
    0x15, 0x5, 0x18, 0x1a, 0xa4, 0x0, 0x50, 0x0,
    /* U+0025 "%" */
    0x29, 0x0, 0x8, 0x20, 0x10, 0x82, 0x5, 0x2,
    0x91, 0x40, 0x0, 0x50, 0x0, 0x14, 0x64, 0x5,
    0x14, 0x81, 0x42, 0x1, 0x0, 0x14, 0x80, 0x0,
    0x64,
    /* U+0026 "&" */
    0x2a, 0xaa, 0x80, 0x80, 0x0, 0x4, 0x0, 0x0,
    0x20, 0x0, 0x1, 0x40, 0x0, 0x1c, 0x0, 0x28,
    0x50, 0x5, 0x2, 0x1, 0x80, 0x14, 0x58, 0x0,
    0x84, 0x80, 0x1, 0x88, 0x0, 0x24, 0x20, 0x6,
    0x80, 0xaa, 0x48,
    /* U+0027 "'" */
    0x55, 0x50,
    /* U+0028 "(" */
    0x0, 0x22, 0x8, 0x11, 0x44, 0x10, 0x41, 0x4,
    0x10, 0x50, 0x42, 0x8, 0x8, 0x0,
    /* U+0029 ")" */
    0x0, 0x20, 0x8, 0x8, 0x4, 0x4, 0x5, 0x5,
    0x5, 0x5, 0x5, 0x5, 0x4, 0x4, 0x8, 0x8,
    0x20, 0x0,
    /* U+002A "*" */
    0x1, 0x0, 0x4, 0x6, 0x66, 0x1, 0xc0, 0x8,
    0x40, 0x41, 0x0, 0x0, 0x0,
    /* U+002B "+" */
    0x0, 0x0, 0x40, 0x4, 0x6, 0xe9, 0x4, 0x0,
    0x40,
    /* U+002C "," */
    0x7, 0x22, 0x50,
    /* U+002D "-" */
    0x2a, 0x40,
    /* U+002E "." */
    0x7,
    /* U+002F "/" */
    0x0, 0x5, 0x0, 0x8, 0x0, 0x8, 0x0, 0x10,
    0x0, 0x20, 0x0, 0x10, 0x0, 0x80, 0x0, 0x80,
    0x1, 0x0, 0x2, 0x0, 0x1, 0x0, 0x8, 0x0,
    0x8, 0x0, 0x10, 0x0, 0x20, 0x0, 0x10, 0x0,
    /* U+0030 "0" */
    0x6, 0xa4, 0x2, 0x1, 0x82, 0x0, 0x20, 0x80,
    0x1, 0x50, 0x0, 0x90, 0x0, 0x28, 0x0, 0xa,
    0x0, 0x2, 0x40, 0x0, 0x94, 0x0, 0x22, 0x0,
    0x4, 0x80, 0x8, 0x8, 0x6, 0x1, 0xa9, 0x0,
    /* U+0031 "1" */
    0x8, 0xc, 0xc, 0x18, 0x24, 0x24, 0x4, 0x4,
    0x4, 0x4, 0x4, 0x4, 0x4, 0x4,
    /* U+0032 "2" */
    0xa, 0xa8, 0x8, 0x0, 0x84, 0x0, 0x11, 0x80,
    0x5, 0x4, 0x2, 0x0, 0x0, 0x80, 0x1, 0x80,
    0x2, 0x40, 0x2, 0x0, 0x2, 0x0, 0x2, 0x0,
    0x1, 0x0, 0x0, 0x80, 0x0, 0x2a, 0xaa, 0x80,
    /* U+0033 "3" */
    0xa, 0xaa, 0xc0, 0x0, 0x14, 0x0, 0x2, 0x0,
    0x0, 0x80, 0x0, 0x20, 0x0, 0x6, 0x40, 0x0,
    0x2, 0x40, 0x0, 0x5, 0x0, 0x0, 0x20, 0x0,
    0x2, 0x0, 0x0, 0x21, 0x0, 0x2, 0x14, 0x0,
    0x80, 0x6a, 0xa0,
    /* U+0034 "4" */
    0x0, 0x8, 0x0, 0xa, 0x0, 0x5, 0x80, 0x2,
    0x20, 0x2, 0x8, 0x0, 0x82, 0x0, 0x80, 0x80,
    0x50, 0x20, 0x20, 0x8, 0x1a, 0xab, 0x80, 0x0,
    0x80, 0x0, 0x20, 0x0, 0x8, 0x0, 0x2, 0x0,
    /* U+0035 "5" */
    0xa, 0xaa, 0x0, 0x80, 0x0, 0x8, 0x0, 0x0,
    0x80, 0x0, 0xa, 0xa4, 0x0, 0x0, 0x20, 0x0,
    0x0, 0x80, 0x0, 0x5, 0x0, 0x0, 0x20, 0x0,
    0x2, 0x0, 0x0, 0x11, 0x0, 0x8, 0x24, 0x1,
    0x40, 0x6a, 0x90,
    /* U+0036 "6" */
    0x0, 0x9, 0x0, 0x24, 0x0, 0x20, 0x0, 0x20,
    0x0, 0x14, 0x0, 0x8, 0x0, 0x1, 0x0, 0x2,
    0x1a, 0x90, 0x84, 0x5, 0x20, 0x0, 0x88, 0x0,
    0x6, 0x0, 0x1, 0x50, 0x1, 0x48, 0x0, 0x80,
    0x6a, 0x80,
    /* U+0037 "7" */
    0x6a, 0xab, 0x0, 0x1, 0x0, 0x0, 0x80, 0x0,
    0x80, 0x0, 0x20, 0x0, 0x14, 0x0, 0x8, 0x0,
    0x1, 0x0, 0x2, 0x0, 0x0, 0x80, 0x0, 0x20,
    0x0, 0x14, 0x0, 0x4, 0x0, 0x1, 0x0, 0x0,
    /* U+0038 "8" */
    0x6, 0xa8, 0x1, 0x80, 0x20, 0x20, 0x0, 0x42,
    0x0, 0x8, 0x20, 0x0, 0x82, 0x0, 0x20, 0x9,
    0x9, 0x2, 0x40, 0x24, 0x40, 0x0, 0x88, 0x0,
    0x1, 0x80, 0x0, 0x14, 0x0, 0x4, 0x20, 0x1,
    0x80, 0xaa, 0x90,
    /* U+0039 "9" */
    0x1a, 0xa0, 0x14, 0x2, 0x48, 0x0, 0x22, 0x0,
    0x4, 0x80, 0x0, 0x60, 0x0, 0x12, 0x0, 0x14,
    0x1a, 0x48, 0x0, 0x2, 0x0, 0x1, 0x40, 0x0,
    0x80, 0x0, 0x80, 0x0, 0x50, 0x0, 0x90, 0x2,
    0x40, 0x0,
    /* U+003A ":" */
    0x30, 0x0, 0x0, 0x30, 0x0,
    /* U+003B ";" */
    0x34, 0x0, 0x0, 0x34, 0x92, 0x8, 0x10,
    /* U+003C "<" */
    0x0, 0x0, 0x0, 0x8, 0x0, 0x20, 0x0, 0x80,
    0x2, 0x0, 0x8, 0x0, 0x20, 0x0, 0x24, 0x0,
    0x9, 0x0, 0x2, 0x40, 0x0, 0x90, 0x0, 0x24,
    0x0, 0x8, 0x0, 0x0,
    /* U+003D "=" */
    0x2a, 0xa0, 0x0, 0x2a, 0xa0,
    /* U+003E ">" */
    0x0, 0x0, 0x80, 0x1, 0x80, 0x1, 0x80, 0x1,
    0x80, 0x1, 0x80, 0x1, 0x80, 0x9, 0x0, 0x90,
    0x5, 0x0, 0x50, 0x5, 0x0, 0x50, 0x0, 0x0,
    0x0,
    /* U+003F "?" */
    0x6, 0xa9, 0x6, 0x0, 0x52, 0x0, 0x8, 0x90,
    0x2, 0x4, 0x0, 0x80, 0x0, 0x50, 0x0, 0x60,
    0x0, 0x50, 0x0, 0x60, 0x0, 0x20, 0x0, 0x8,
    0x0, 0x0, 0x0, 0x0, 0x0, 0x0, 0x70, 0x0,
    /* U+0040 "@" */
    0x1, 0xa8, 0x0, 0x24, 0x8, 0x2, 0x0, 0x8,
    0x8, 0x0, 0x20, 0x40, 0x0, 0x12, 0x0, 0x2a,
    0x48, 0x2, 0x1, 0x20, 0x4, 0x0, 0x80, 0xa,
    0xa1, 0x40, 0x0, 0x2, 0x0, 0x0, 0x8, 0x0,
    0x5, 0x8, 0x0, 0x90, 0xa, 0xa8, 0x0,
    /* U+0041 "A" */
    0x0, 0x0, 0x0, 0x0, 0x80, 0x0, 0x3, 0x0,
    0x0, 0x25, 0x0, 0x0, 0x88, 0x0, 0x5, 0x10,
    0x0, 0x20, 0x20, 0x0, 0x80, 0x80, 0x5, 0x1,
    0x0, 0x20, 0x2, 0x0, 0x80, 0x8, 0x4, 0x0,
    0x14, 0x20, 0x0, 0x20, 0x80, 0x0, 0x84, 0x6a,
    0xab, 0x40,
    /* U+0042 "B" */
    0x3a, 0xa4, 0x2, 0x0, 0x20, 0x20, 0x0, 0x82,
    0x0, 0x8, 0x20, 0x0, 0x82, 0x0, 0x20, 0x20,
    0x9, 0x2, 0x0, 0x24, 0x20, 0x0, 0x82, 0x0,
    0x1, 0x20, 0x0, 0x12, 0x0, 0x4, 0x20, 0x1,
    0x83, 0xaa, 0x90,
    /* U+0043 "C" */
    0x6, 0xaa, 0x1, 0x40, 0x8, 0x20, 0x0, 0x11,
    0x0, 0x0, 0x40, 0x0, 0x4, 0x0, 0x0, 0x40,
    0x0, 0x4, 0x0, 0x0, 0x40, 0x0, 0x4, 0x0,
    0x0, 0x10, 0x0, 0x2, 0x0, 0x1, 0x14, 0x0,
    0x80, 0x6a, 0xa0,
    /* U+0044 "D" */
    0x3a, 0x90, 0x2, 0x0, 0x80, 0x20, 0x2, 0x2,
    0x0, 0x8, 0x20, 0x0, 0x52, 0x0, 0x2, 0x20,
    0x0, 0x22, 0x0, 0x2, 0x20, 0x0, 0x22, 0x0,
    0x5, 0x20, 0x0, 0x82, 0x0, 0x20, 0x20, 0x8,
    0x3, 0xa9, 0x0,
    /* U+0045 "E" */
    0x3a, 0xaa, 0xd2, 0x0, 0x24, 0x20, 0x9, 0x2,
    0x2, 0x40, 0x20, 0x50, 0x2, 0x14, 0x0, 0x27,
    0xaa, 0x2, 0x0, 0x0, 0x20, 0x0, 0x2, 0x0,
    0x0, 0x20, 0x0, 0x2, 0x0, 0x0, 0x20, 0x0,
    0x3, 0xaa, 0xa8,
    /* U+0046 "F" */
    0x3a, 0xaa, 0xd2, 0x0, 0x24, 0x20, 0x9, 0x2,
    0x2, 0x40, 0x20, 0x50, 0x2, 0x14, 0x0, 0x27,
    0xaa, 0x2, 0x0, 0x0, 0x20, 0x0, 0x2, 0x0,
    0x0, 0x20, 0x0, 0x2, 0x0, 0x0, 0x20, 0x0,
    0x2, 0x0, 0x0,
    /* U+0047 "G" */
    0x6, 0xaa, 0x1, 0x40, 0x8, 0x20, 0x0, 0x11,
    0x0, 0x0, 0x40, 0x0, 0x4, 0x0, 0x0, 0x40,
    0x0, 0x4, 0x0, 0x2a, 0x40, 0x0, 0x24, 0x0,
    0x2, 0x10, 0x0, 0x22, 0x0, 0x2, 0x14, 0x0,
    0x80, 0x6a, 0xa0,
    /* U+0048 "H" */
    0x20, 0x0, 0x12, 0x0, 0x1, 0x20, 0x0, 0x12,
    0x0, 0x1, 0x20, 0x0, 0x12, 0x0, 0x1, 0x3a,
    0xaa, 0x92, 0x0, 0x1, 0x20, 0x0, 0x12, 0x0,
    0x1, 0x20, 0x0, 0x12, 0x0, 0x1, 0x20, 0x0,
    0x12, 0x0, 0x1,
    /* U+0049 "I" */
    0x22, 0x22, 0x22, 0x22, 0x22, 0x22, 0x22,
    /* U+004A "J" */
    0x0, 0x1, 0x0, 0x0, 0x40, 0x0, 0x10, 0x0,
    0x4, 0x0, 0x1, 0x0, 0x0, 0x40, 0x0, 0x10,
    0x0, 0x4, 0x0, 0x1, 0x0, 0x0, 0x40, 0x0,
    0x21, 0x40, 0x8, 0x24, 0x2, 0x2, 0xaa, 0x0,
    /* U+004B "K" */
    0x20, 0x0, 0x90, 0x80, 0x9, 0x2, 0x0, 0x90,
    0x8, 0x9, 0x0, 0x20, 0x90, 0x0, 0x89, 0x0,
    0x2, 0x50, 0x0, 0x8, 0x80, 0x0, 0x20, 0x80,
    0x0, 0x80, 0x80, 0x2, 0x0, 0x80, 0x8, 0x0,
    0x80, 0x20, 0x0, 0x80, 0x80, 0x0, 0x80,
    /* U+004C "L" */
    0x20, 0x0, 0x2, 0x0, 0x0, 0x20, 0x0, 0x2,
    0x0, 0x0, 0x20, 0x0, 0x2, 0x0, 0x0, 0x20,
    0x0, 0x2, 0x0, 0x0, 0x20, 0x0, 0x2, 0x0,
    0x0, 0x20, 0x0, 0x2, 0x0, 0x0, 0x20, 0x0,
    0x3, 0xaa, 0xa8,
    /* U+004D "M" */
    0x30, 0x0, 0x8, 0x34, 0x0, 0xc, 0x28, 0x0,
    0x28, 0x24, 0x0, 0x24, 0x22, 0x0, 0x84, 0x22,
    0x0, 0x84, 0x20, 0x81, 0x4, 0x20, 0x82, 0x4,
    0x20, 0x25, 0x4, 0x20, 0x28, 0x4, 0x20, 0x4,
    0x4, 0x20, 0x0, 0x4, 0x20, 0x0, 0x4, 0x22,
    0xaa, 0xac,
    /* U+004E "N" */
    0x30, 0x0, 0x22, 0x80, 0x2, 0x28, 0x0, 0x22,
    0x20, 0x2, 0x21, 0x40, 0x22, 0x8, 0x2, 0x20,
    0x50, 0x22, 0x2, 0x2, 0x20, 0x8, 0x22, 0x0,
    0x82, 0x20, 0x2, 0x22, 0x0, 0x16, 0x20, 0x0,
    0xa2, 0x6a, 0xaf,
    /* U+004F "O" */
    0x6, 0xaa, 0x1, 0x40, 0x8, 0x20, 0x0, 0x51,
    0x0, 0x2, 0x40, 0x0, 0x24, 0x0, 0x2, 0x40,
    0x0, 0x24, 0x0, 0x2, 0x40, 0x0, 0x24, 0x0,
    0x2, 0x10, 0x0, 0x22, 0x0, 0x5, 0x14, 0x0,
    0x80, 0x6a, 0xa0,
    /* U+0050 "P" */
    0x3a, 0xa4, 0x8, 0x0, 0x82, 0x0, 0x8, 0x80,
    0x2, 0x20, 0x0, 0x88, 0x0, 0x82, 0x0, 0x90,
    0x80, 0x0, 0x20, 0x0, 0x8, 0x0, 0x2, 0x0,
    0x0, 0x80, 0x0, 0x20, 0x0, 0x8, 0x0, 0x0,
    /* U+0051 "Q" */
    0x6, 0xa9, 0x1, 0x40, 0x8, 0x20, 0x0, 0x51,
    0x0, 0x2, 0x40, 0x0, 0x24, 0x0, 0x2, 0x40,
    0x0, 0x24, 0x0, 0x2, 0x40, 0x0, 0x24, 0x0,
    0x2, 0x10, 0x0, 0x22, 0x0, 0x5, 0x14, 0x0,
    0x80, 0x64, 0x0, 0x0, 0x40, 0x0, 0x1, 0x0,
    0x0, 0x20, 0x0, 0x0, 0xa0,
    /* U+0052 "R" */
    0x3a, 0xa4, 0x8, 0x0, 0x82, 0x0, 0x8, 0x80,
    0x2, 0x20, 0x0, 0x88, 0x0, 0x82, 0x0, 0x90,
    0x80, 0x20, 0x20, 0x8, 0x8, 0x1, 0x42, 0x0,
    0x20, 0x80, 0x8, 0x20, 0x1, 0x49, 0xaa, 0xa0,
    /* U+0053 "S" */
    0xa, 0xa8, 0x2, 0x0, 0x20, 0x50, 0x1, 0x44,
    0x0, 0x20, 0x10, 0x4, 0x1, 0x80, 0x0, 0x2,
    0x80, 0x0, 0x1, 0x80, 0x0, 0x2, 0x40, 0x0,
    0x8, 0x0, 0x0, 0x88, 0x0, 0x8, 0x20, 0x1,
    0x40, 0xaa, 0x90,
    /* U+0054 "T" */
    0x6a, 0xba, 0xa0, 0x0, 0x80, 0x0, 0x2, 0x0,
    0x0, 0x8, 0x0, 0x0, 0x20, 0x0, 0x0, 0x80,
    0x0, 0x2, 0x0, 0x0, 0x8, 0x0, 0x0, 0x20,
    0x0, 0x0, 0x80, 0x0, 0x2, 0x0, 0x0, 0x8,
    0x0, 0x0, 0x20, 0x0, 0x0, 0x80, 0x0,
    /* U+0055 "U" */
    0x16, 0xaa, 0xb0, 0x40, 0x0, 0x41, 0x0, 0x1,
    0x4, 0x0, 0x4, 0x10, 0x0, 0x10, 0x40, 0x0,
    0x41, 0x0, 0x1, 0x4, 0x0, 0x4, 0x10, 0x0,
    0x20, 0x80, 0x0, 0x82, 0x0, 0x2, 0x8, 0x0,
    0x8, 0x8, 0x0, 0x80, 0xa, 0xa8, 0x0,
    /* U+0056 "V" */
    0x46, 0xaa, 0xb4, 0x80, 0x0, 0x82, 0x0, 0x2,
    0x4, 0x0, 0x14, 0x8, 0x0, 0x80, 0x20, 0x2,
    0x0, 0x50, 0x10, 0x0, 0x80, 0x80, 0x2, 0x1,
    0x0, 0x5, 0x10, 0x0, 0x8, 0x80, 0x0, 0x25,
    0x0, 0x0, 0x30, 0x0, 0x0, 0x80, 0x0, 0x0,
    0x0, 0x0,
    /* U+0057 "W" */
    0x46, 0xaa, 0xaa, 0xaa, 0x20, 0x0, 0x0, 0x4,
    0x20, 0x0, 0x0, 0x8, 0x10, 0x0, 0x0, 0x4,
    0x8, 0x0, 0x0, 0x20, 0x8, 0x0, 0x0, 0x20,
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    0x0, 0x0, 0x0, 0x0,
    /* U+0058 "X" */
    0x20, 0x0, 0x40, 0x40, 0x20, 0x8, 0x5, 0x0,
    0x20, 0x80, 0x2, 0x14, 0x0, 0xa, 0x0, 0x0,
    0x90, 0x0, 0xa, 0x0, 0x1, 0x10, 0x0, 0x20,
    0x80, 0x8, 0x4, 0x0, 0x80, 0x20, 0x20, 0x1,
    0x42, 0x0, 0x8,
    /* U+0059 "Y" */
    0x82, 0xaa, 0xb4, 0x80, 0x0, 0x81, 0x40, 0x4,
    0x2, 0x0, 0x20, 0x2, 0x2, 0x0, 0x5, 0x14,
    0x0, 0x8, 0x80, 0x0, 0xc, 0x0, 0x0, 0x20,
    0x0, 0x0, 0x80, 0x0, 0x2, 0x0, 0x0, 0x8,
    0x0, 0x0, 0x20, 0x0, 0x0, 0x80, 0x0,
    /* U+005A "Z" */
    0x2a, 0xab, 0x40, 0x0, 0x80, 0x0, 0x50, 0x0,
    0x20, 0x0, 0x14, 0x0, 0x8, 0x0, 0x5, 0x0,
    0x2, 0x0, 0x1, 0x0, 0x0, 0x80, 0x0, 0x80,
    0x0, 0x20, 0x0, 0x20, 0x0, 0xe, 0xaa, 0x90,
    /* U+005B "[" */
    0xe2, 0x8, 0x20, 0x82, 0x8, 0x20, 0x82, 0x8,
    0x20, 0x83, 0x80,
    /* U+005C "\\" */
    0x10, 0x0, 0x20, 0x0, 0x14, 0x0, 0x8, 0x0,
    0x8, 0x0, 0x1, 0x0, 0x2, 0x0, 0x1, 0x40,
    0x0, 0x80, 0x0, 0x80, 0x0, 0x10, 0x0, 0x20,
    0x0, 0x10, 0x0, 0x8, 0x0, 0x8, 0x0, 0x0,
    /* U+005D "]" */
    0xb0, 0x41, 0x4, 0x10, 0x41, 0x4, 0x10, 0x41,
    0x4, 0x12, 0xc0,
    /* U+005E "^" */
    0x2, 0x0, 0x94, 0x20, 0x90, 0x0,
    /* U+005F "_" */
    0xaa, 0xaa, 0x0,
    /* U+0061 "a" */
    0x0, 0x10, 0x0, 0x1, 0xc0, 0x0, 0x9, 0x40,
    0x0, 0x22, 0x0, 0x1, 0x4, 0x0, 0x8, 0x8,
    0x0, 0x50, 0x20, 0x2, 0x0, 0x10, 0x4, 0x0,
    0x80, 0x80, 0x1, 0x42, 0x0, 0x2, 0x10, 0xaa,
    0xac,
    /* U+0062 "b" */
    0x3a, 0xa0, 0x8, 0x2, 0x42, 0x0, 0x20, 0x80,
    0x8, 0x20, 0x2, 0x8, 0x6, 0x2, 0x0, 0x60,
    0x80, 0x5, 0x20, 0x0, 0x88, 0x0, 0x12, 0x0,
    0x20, 0xea, 0xa0,
    /* U+0063 "c" */
    0x6, 0xa9, 0x9, 0x0, 0x12, 0x0, 0x1, 0x0,
    0x0, 0x80, 0x0, 0x20, 0x0, 0x8, 0x0, 0x2,
    0x0, 0x0, 0x40, 0x0, 0x8, 0x0, 0x2, 0x40,
    0x4, 0x1a, 0xa4,
    /* U+0064 "d" */
    0x3a, 0x90, 0x8, 0x6, 0x2, 0x0, 0x20, 0x80,
    0x1, 0x20, 0x0, 0x88, 0x0, 0x22, 0x0, 0x8,
    0x80, 0x2, 0x20, 0x0, 0x48, 0x0, 0x82, 0x1,
    0x80, 0xea, 0x40,
    /* U+0065 "e" */
    0x6, 0xa9, 0x9, 0x0, 0x22, 0x0, 0x25, 0x0,
    0x20, 0x80, 0x20, 0x20, 0x60, 0x8, 0x0, 0x2,
    0x0, 0x0, 0x40, 0x0, 0x8, 0x0, 0x2, 0x40,
    0x4, 0x1a, 0xa4,
    /* U+0066 "f" */
    0x2, 0xaa, 0x0, 0x80, 0x8, 0x20, 0x1, 0x42,
    0x0, 0x90, 0x10, 0x20, 0x5, 0xa, 0xa8, 0x50,
    0x0, 0x5, 0x0, 0x0, 0x50, 0x0, 0x5, 0x0,
    0x0, 0x50, 0x0, 0x5, 0x0, 0x0,
    /* U+0067 "g" */
    0x6, 0xa9, 0x9, 0x0, 0x22, 0x0, 0x25, 0x0,
    0x20, 0x80, 0x0, 0x20, 0x0, 0x8, 0x0, 0x2,
    0x0, 0x2, 0x40, 0x0, 0x88, 0x0, 0x22, 0x40,
    0x8, 0x1a, 0xa6, 0x0, 0x0, 0x80, 0x0, 0x20,
    0x0, 0x20, 0xa, 0xa4,
    /* U+0068 "h" */
    0x20, 0x2, 0x8, 0x0, 0x82, 0x0, 0x20, 0x80,
    0x8, 0x20, 0x2, 0xe, 0xaa, 0xc2, 0x0, 0x20,
    0x80, 0x8, 0x20, 0x2, 0x8, 0x0, 0x82, 0x0,
    0x20, 0x80, 0x8,
    /* U+0069 "i" */
    0x22, 0x22, 0x22, 0x22, 0x22, 0x22,
    /* U+006A "j" */
    0x0, 0x2, 0x0, 0x2, 0x0, 0x2, 0x0, 0x2,
    0x0, 0x2, 0x0, 0x2, 0x0, 0x2, 0x0, 0x2,
    0x0, 0x2, 0x0, 0x2, 0x0, 0x2, 0x0, 0x2,
    0x0, 0x2, 0x20, 0x2, 0x20, 0x9, 0xa, 0xa4,
    /* U+006B "k" */
    0x20, 0x2, 0x2, 0x0, 0x80, 0x20, 0x20, 0x2,
    0x8, 0x0, 0x22, 0x0, 0x2, 0x90, 0x0, 0x22,
    0x0, 0x2, 0x8, 0x0, 0x20, 0x20, 0x2, 0x0,
    0x80, 0x20, 0x2, 0x2, 0x0, 0x8,
    /* U+006C "l" */
    0x20, 0x0, 0x20, 0x0, 0x20, 0x0, 0x20, 0x0,
    0x20, 0x0, 0x20, 0x0, 0x20, 0x0, 0x20, 0x0,
    0x20, 0x0, 0x20, 0x0, 0x20, 0x0, 0x3a, 0xa9,
    /* U+006D "m" */
    0x30, 0x0, 0xc, 0x28, 0x0, 0x28, 0x22, 0x0,
    0x88, 0x20, 0x82, 0x8, 0x20, 0x28, 0x8, 0x20,
    0x0, 0x8, 0x20, 0x0, 0x8, 0x20, 0x0, 0x8,
    0x20, 0x0, 0x8, 0x20, 0x0, 0x8, 0x20, 0x0,
    0x8, 0x22, 0xaa, 0xac,
    /* U+006E "n" */
    0x30, 0x0, 0x8d, 0x0, 0x22, 0x80, 0x8, 0x88,
    0x2, 0x21, 0x0, 0x88, 0x20, 0x22, 0x5, 0x8,
    0x80, 0x82, 0x20, 0x8, 0x88, 0x1, 0x22, 0x0,
    0x28, 0x80, 0x6,
    /* U+006F "o" */
    0x6, 0xa9, 0x2, 0x40, 0x8, 0x20, 0x0, 0x44,
    0x0, 0x1, 0x80, 0x0, 0x28, 0x0, 0x2, 0x80,
    0x0, 0x28, 0x0, 0x2, 0x40, 0x0, 0x12, 0x0,
    0x4, 0x24, 0x0, 0x80, 0x6a, 0x90,
    /* U+0070 "p" */
    0x3a, 0xa4, 0x8, 0x0, 0x82, 0x0, 0x4, 0x80,
    0x2, 0x20, 0x0, 0x88, 0x0, 0x42, 0x0, 0x90,
    0x80, 0x0, 0x20, 0x0, 0x8, 0x0, 0x2, 0x0,
    0x0, 0x80, 0x0, 0x20, 0x0, 0x8, 0x0, 0x2,
    0x0, 0x0, 0x80, 0x0,
    /* U+0071 "q" */
    0x6, 0xa9, 0x1, 0x40, 0x8, 0x20, 0x0, 0x45,
    0x0, 0x1, 0x40, 0x0, 0x28, 0x0, 0x2, 0x80,
    0x0, 0x28, 0x0, 0x2, 0x40, 0x0, 0x12, 0x0,
    0x4, 0x24, 0x0, 0x80, 0xa8, 0x0, 0x0, 0x40,
    0x0, 0x5, 0x0, 0x0, 0x20, 0x0, 0x0, 0xa0,
    /* U+0072 "r" */
    0x3a, 0xa0, 0x8, 0x2, 0x42, 0x0, 0x20, 0x80,
    0x8, 0x20, 0x1, 0x8, 0x5, 0x2, 0x2, 0x0,
    0x80, 0x10, 0x20, 0x8, 0x8, 0x1, 0x42, 0x0,
    0x20, 0x80, 0x5,
    /* U+0073 "s" */
    0x1a, 0xa8, 0x18, 0x0, 0x8, 0x0, 0x2, 0x0,
    0x0, 0x20, 0x0, 0x2, 0x90, 0x0, 0x6, 0x80,
    0x0, 0x8, 0x0, 0x1, 0x0, 0x0, 0x44, 0x0,
    0x20, 0xaa, 0xa0,
    /* U+0074 "t" */
    0x6a, 0xea, 0x80, 0x4, 0x0, 0x0, 0x40, 0x0,
    0x4, 0x0, 0x0, 0x40, 0x0, 0x4, 0x0, 0x0,
    0x40, 0x0, 0x4, 0x0, 0x0, 0x40, 0x0, 0x4,
    0x0, 0x0, 0x40, 0x0, 0x4, 0x0,
    /* U+0075 "u" */
    0x50, 0x0, 0x85, 0x0, 0x8, 0x50, 0x0, 0x85,
    0x0, 0x8, 0x50, 0x0, 0x85, 0x0, 0x8, 0x50,
    0x0, 0x81, 0x0, 0x8, 0x20, 0x0, 0x82, 0x0,
    0x4, 0x8, 0x2, 0x0, 0x6a, 0x80,
    /* U+0076 "v" */
    0x40, 0x0, 0x10, 0x80, 0x0, 0x82, 0x0, 0x5,
    0x1, 0x0, 0x20, 0x8, 0x0, 0x40, 0x14, 0x8,
    0x0, 0x20, 0x20, 0x0, 0x81, 0x0, 0x0, 0x88,
    0x0, 0x2, 0x50, 0x0, 0x7, 0x0, 0x0, 0x4,
    0x0,
    /* U+0077 "w" */
    0x46, 0xaa, 0xaa, 0xab, 0x8, 0x0, 0x0, 0x0,
    0x82, 0x0, 0x0, 0x0, 0x50, 0x10, 0x1, 0x0,
    0x20, 0x8, 0x0, 0xc0, 0x4, 0x1, 0x40, 0x94,
    0x8, 0x0, 0x20, 0x22, 0x2, 0x0, 0x8, 0x10,
    0x41, 0x0, 0x0, 0x88, 0x8, 0x80, 0x0, 0x25,
    0x2, 0x50, 0x0, 0x7, 0x0, 0x70, 0x0, 0x0,
    0x40, 0x4, 0x0,
    /* U+0078 "x" */
    0x20, 0x2, 0x2, 0x2, 0x0, 0x40, 0x80, 0x8,
    0x80, 0x1, 0x90, 0x0, 0x30, 0x0, 0x19, 0x0,
    0x8, 0x80, 0x5, 0x8, 0x2, 0x2, 0x2, 0x0,
    0x20, 0x80, 0x5,
    /* U+0079 "y" */
    0x42, 0xaa, 0xb0, 0x80, 0x0, 0x82, 0x0, 0x5,
    0x1, 0x0, 0x20, 0x8, 0x0, 0x40, 0x14, 0x8,
    0x0, 0x20, 0x20, 0x0, 0x81, 0x0, 0x0, 0x88,
    0x0, 0x2, 0x50, 0x0, 0x7, 0x0, 0x0, 0x8,
    0x0, 0x0, 0x20, 0x0, 0x0, 0x80, 0x0, 0x2,
    0x0, 0x0, 0x8, 0x0,
    /* U+007A "z" */
    0x2a, 0xab, 0x0, 0x1, 0x40, 0x0, 0x80, 0x0,
    0x50, 0x0, 0x20, 0x0, 0x20, 0x0, 0x8, 0x0,
    0x8, 0x0, 0x2, 0x0, 0x2, 0x0, 0x1, 0x40,
    0x0, 0xea, 0xa8,
    /* U+007B "{" */
    0x0, 0x0, 0x80, 0x50, 0x20, 0x8, 0x2, 0x0,
    0x80, 0x10, 0x20, 0x8, 0x0, 0x80, 0x20, 0x8,
    0x2, 0x0, 0x80, 0x4, 0x1, 0x40, 0x0,
    /* U+007C "|" */
    0x12, 0x22, 0x22, 0x22, 0x22, 0x22, 0x22, 0x22,
    0x20,
    /* U+007D "}" */
    0x0, 0x8, 0x0, 0x80, 0x20, 0x4, 0x1, 0x0,
    0x50, 0x8, 0x1, 0x40, 0x80, 0x20, 0x14, 0x4,
    0x2, 0x0, 0x80, 0x20, 0x20, 0x0, 0x0,
    /* U+007E "~" */
    0x24, 0x44, 0x24,
    /* U+00C0 "À" */
    0x0, 0x40, 0x0, 0x2, 0x0, 0x0, 0x2, 0x0,
    0x0, 0x0, 0x0, 0x0, 0x20, 0x0, 0x0, 0xc0,
    0x0, 0x9, 0x40, 0x0, 0x22, 0x0, 0x1, 0x44,
    0x0, 0x8, 0x8, 0x0, 0x20, 0x20, 0x1, 0x40,
    0x40, 0x8, 0x0, 0x80, 0x20, 0x2, 0x1, 0x0,
    0x5, 0x8, 0x0, 0x8, 0x20, 0x0, 0x21, 0x1a,
    0xaa, 0xd0,
    /* U+00C2 "Â" */
    0x0, 0x10, 0x0, 0x1, 0x90, 0x0, 0x18, 0x80,
    0x0, 0x40, 0x40, 0x0, 0x20, 0x0, 0x0, 0xc0,
    0x0, 0x9, 0x40, 0x0, 0x22, 0x0, 0x1, 0x44,
    0x0, 0x8, 0x8, 0x0, 0x20, 0x20, 0x1, 0x40,
    0x40, 0x8, 0x0, 0x80, 0x20, 0x2, 0x1, 0x0,
    0x5, 0x8, 0x0, 0x8, 0x20, 0x0, 0x21, 0x1a,
    0xaa, 0xd0,
    /* U+00C4 "Ä" */
    0x3, 0x47, 0x0, 0x0, 0x0, 0x0, 0x0, 0x0,
    0x0, 0xc, 0x0, 0x0, 0x60, 0x0, 0x2, 0x20,
    0x0, 0x8, 0x80, 0x0, 0x51, 0x40, 0x2, 0x2,
    0x0, 0x8, 0x8, 0x0, 0x40, 0x14, 0x2, 0x0,
    0x20, 0x8, 0x0, 0x80, 0x40, 0x1, 0x42, 0x0,
    0x2, 0x8, 0x0, 0x8, 0x46, 0xaa, 0xb4,
    /* U+00C6 "Æ" */
    0x0, 0xa, 0xaa, 0xac, 0x0, 0xc, 0x0, 0x20,
    0x0, 0x28, 0x0, 0x80, 0x0, 0x24, 0x2, 0x0,
    0x0, 0x84, 0x8, 0x0, 0x0, 0x84, 0x20, 0x0,
    0x1, 0x4, 0xaa, 0x90, 0x2, 0x4, 0x0, 0x0,
    0x5, 0x4, 0x0, 0x0, 0x8, 0x4, 0x0, 0x0,
    0x14, 0x4, 0x0, 0x0, 0x20, 0x4, 0x0, 0x0,
    0x50, 0x4, 0x0, 0x0, 0xaa, 0x46, 0xaa, 0xa8,
    /* U+00C7 "Ç" */
    0x6, 0xaa, 0x1, 0x40, 0x8, 0x20, 0x0, 0x11,
    0x0, 0x0, 0x40, 0x0, 0x4, 0x0, 0x0, 0x40,
    0x0, 0x4, 0x0, 0x0, 0x40, 0x0, 0x4, 0x0,
    0x0, 0x10, 0x0, 0x2, 0x0, 0x1, 0x14, 0x0,
    0x80, 0x6a, 0xa0, 0x0, 0x0, 0x0, 0x7, 0x0,
    0x0, 0x20, 0x0, 0x5, 0x0, 0x0, 0x0, 0x0,
    /* U+00C8 "È" */
    0x1, 0x0, 0x0, 0x8, 0x0, 0x0, 0x20, 0x0,
    0x1, 0x0, 0x3a, 0xaa, 0xd2, 0x0, 0x24, 0x20,
    0x9, 0x2, 0x2, 0x40, 0x20, 0x50, 0x2, 0x14,
    0x0, 0x27, 0xaa, 0x2, 0x0, 0x0, 0x20, 0x0,
    0x2, 0x0, 0x0, 0x20, 0x0, 0x2, 0x0, 0x0,
    0x20, 0x0, 0x3, 0xaa, 0xa8,
    /* U+00C9 "É" */
    0x0, 0x4, 0x0, 0x1, 0x40, 0x0, 0x20, 0x0,
    0x4, 0x0, 0x3a, 0xaa, 0xd2, 0x0, 0x24, 0x20,
    0x9, 0x2, 0x2, 0x40, 0x20, 0x50, 0x2, 0x14,
    0x0, 0x27, 0xaa, 0x2, 0x0, 0x0, 0x20, 0x0,
    0x2, 0x0, 0x0, 0x20, 0x0, 0x2, 0x0, 0x0,
    0x20, 0x0, 0x3, 0xaa, 0xa8,
    /* U+00CA "Ê" */
    0x0, 0x0, 0x0, 0x6, 0x0, 0x1, 0x48, 0x0,
    0x20, 0x50, 0x3a, 0xaa, 0xd2, 0x0, 0x24, 0x20,
    0x9, 0x2, 0x2, 0x40, 0x20, 0x50, 0x2, 0x14,
    0x0, 0x27, 0xaa, 0x2, 0x0, 0x0, 0x20, 0x0,
    0x2, 0x0, 0x0, 0x20, 0x0, 0x2, 0x0, 0x0,
    0x20, 0x0, 0x3, 0xaa, 0xa8,
    /* U+00CB "Ë" */
    0x7, 0xa, 0x0, 0x0, 0x0, 0x0, 0x0, 0x3,
    0xaa, 0xad, 0x20, 0x2, 0x42, 0x0, 0x90, 0x20,
    0x24, 0x2, 0x5, 0x0, 0x21, 0x40, 0x2, 0x7a,
    0xa0, 0x20, 0x0, 0x2, 0x0, 0x0, 0x20, 0x0,
    0x2, 0x0, 0x0, 0x20, 0x0, 0x2, 0x0, 0x0,
    0x3a, 0xaa, 0x80,
    /* U+00CE "Î" */
    0x0, 0x0, 0x70, 0x18, 0x82, 0x1, 0x2, 0x0,
    0x20, 0x2, 0x0, 0x20, 0x2, 0x0, 0x20, 0x2,
    0x0, 0x20, 0x2, 0x0, 0x20, 0x2, 0x0, 0x20,
    0x2, 0x0, 0x20,
    /* U+00CF "Ï" */
    0x30, 0xa0, 0x0, 0x0, 0x0, 0x20, 0x2, 0x0,
    0x20, 0x2, 0x0, 0x20, 0x2, 0x0, 0x20, 0x2,
    0x0, 0x20, 0x2, 0x0, 0x20, 0x2, 0x0, 0x20,
    0x2, 0x0,
    /* U+00D4 "Ô" */
    0x0, 0x0, 0x0, 0x6, 0x0, 0x0, 0x98, 0x0,
    0x20, 0x50, 0x6, 0xaa, 0x1, 0x40, 0x8, 0x20,
    0x0, 0x51, 0x0, 0x2, 0x40, 0x0, 0x24, 0x0,
    0x2, 0x40, 0x0, 0x24, 0x0, 0x2, 0x40, 0x0,
    0x24, 0x0, 0x2, 0x10, 0x0, 0x22, 0x0, 0x5,
    0x14, 0x0, 0x80, 0x6a, 0xa0,
    /* U+00D6 "Ö" */
    0x3, 0xa, 0x0, 0x0, 0x0, 0x0, 0x0, 0x0,
    0x6a, 0xa0, 0x14, 0x0, 0x82, 0x0, 0x5, 0x10,
    0x0, 0x24, 0x0, 0x2, 0x40, 0x0, 0x24, 0x0,
    0x2, 0x40, 0x0, 0x24, 0x0, 0x2, 0x40, 0x0,
    0x21, 0x0, 0x2, 0x20, 0x0, 0x51, 0x40, 0x8,
    0x6, 0xaa, 0x0,
    /* U+00DB "Û" */
    0x0, 0x0, 0x0, 0x1, 0xc0, 0x0, 0x8, 0x80,
    0x0, 0x40, 0x40, 0x10, 0x0, 0x10, 0x40, 0x0,
    0x41, 0x0, 0x1, 0x4, 0x0, 0x4, 0x10, 0x0,
    0x10, 0x40, 0x0, 0x41, 0x0, 0x1, 0x4, 0x0,
    0x4, 0x10, 0x0, 0x20, 0x80, 0x0, 0x82, 0x0,
    0x2, 0x8, 0x0, 0x8, 0x8, 0x0, 0x80, 0xa,
    0xa8, 0x0,
    /* U+00DC "Ü" */
    0x3, 0x47, 0x0, 0x0, 0x0, 0x0, 0x0, 0x0,
    0x4, 0x0, 0x4, 0x10, 0x0, 0x10, 0x40, 0x0,
    0x41, 0x0, 0x1, 0x4, 0x0, 0x4, 0x10, 0x0,
    0x10, 0x40, 0x0, 0x41, 0x0, 0x1, 0x4, 0x0,
    0x8, 0x20, 0x0, 0x20, 0x80, 0x0, 0x82, 0x0,
    0x2, 0x2, 0x0, 0x20, 0x2, 0xaa, 0x0,
    /* U+00E0 "à" */
    0x0, 0x40, 0x0, 0x2, 0x0, 0x0, 0x2, 0x0,
    0x0, 0x0, 0x0, 0x0, 0x10, 0x0, 0x1, 0xc0,
    0x0, 0x9, 0x40, 0x0, 0x22, 0x0, 0x1, 0x4,
    0x0, 0x8, 0x8, 0x0, 0x50, 0x20, 0x2, 0x0,
    0x10, 0x4, 0x0, 0x80, 0x80, 0x1, 0x42, 0x0,
    0x2, 0x10, 0xaa, 0xac,
    /* U+00E2 "â" */
    0x0, 0x20, 0x0, 0x2, 0x60, 0x0, 0x20, 0x50,
    0x0, 0x0, 0x0, 0x0, 0x10, 0x0, 0x1, 0xc0,
    0x0, 0x9, 0x40, 0x0, 0x22, 0x0, 0x1, 0x4,
    0x0, 0x8, 0x8, 0x0, 0x50, 0x20, 0x2, 0x0,
    0x10, 0x4, 0x0, 0x80, 0x80, 0x1, 0x42, 0x0,
    0x2, 0x10, 0xaa, 0xac,
    /* U+00E4 "ä" */
    0x3, 0x4b, 0x0, 0x0, 0x0, 0x0, 0x0, 0x0,
    0x0, 0xc, 0x0, 0x0, 0xa4, 0x0, 0x2, 0x20,
    0x0, 0x14, 0x80, 0x0, 0x80, 0x80, 0x5, 0x2,
    0x0, 0x20, 0x1, 0x0, 0x80, 0x8, 0x8, 0x0,
    0x14, 0x20, 0x0, 0x21, 0xa, 0xaa, 0xc0,
    /* U+00E6 "æ" */
    0x0, 0x21, 0xaa, 0x80, 0x0, 0xe4, 0x0, 0x80,
    0xa, 0x80, 0x6, 0x0, 0x25, 0x0, 0x90, 0x1,
    0x54, 0x8, 0x0, 0x8, 0x40, 0x80, 0x0, 0x51,
    0x0, 0x0, 0x2, 0x5, 0x0, 0x0, 0x4, 0x4,
    0x0, 0x0, 0x80, 0x20, 0x0, 0x2, 0x0, 0x50,
    0x1, 0x2a, 0x90, 0x6a, 0xa0,
    /* U+00E7 "ç" */
    0x6, 0xa9, 0x9, 0x0, 0x12, 0x0, 0x1, 0x0,
    0x0, 0x80, 0x0, 0x20, 0x0, 0x8, 0x0, 0x2,
    0x0, 0x0, 0x40, 0x0, 0x8, 0x0, 0x2, 0x40,
    0x4, 0x1a, 0xa4, 0x0, 0x0, 0x0, 0x28, 0x0,
    0x2, 0x0, 0x2, 0x0, 0x0, 0x0, 0x0,
    /* U+00E8 "è" */
    0x2, 0x0, 0x0, 0x20, 0x0, 0x5, 0x0, 0x0,
    0x0, 0x6, 0xa9, 0x9, 0x0, 0x22, 0x0, 0x25,
    0x0, 0x20, 0x80, 0x20, 0x20, 0x60, 0x8, 0x0,
    0x2, 0x0, 0x0, 0x40, 0x0, 0x8, 0x0, 0x2,
    0x40, 0x4, 0x1a, 0xa4,
    /* U+00E9 "é" */
    0x0, 0x4, 0x0, 0x8, 0x0, 0x8, 0x0, 0x0,
    0x0, 0x6, 0xa9, 0x9, 0x0, 0x22, 0x0, 0x25,
    0x0, 0x20, 0x80, 0x20, 0x20, 0x60, 0x8, 0x0,
    0x2, 0x0, 0x0, 0x40, 0x0, 0x8, 0x0, 0x2,
    0x40, 0x4, 0x1a, 0xa4,
    /* U+00EA "ê" */
    0x0, 0x80, 0x0, 0x58, 0x0, 0x20, 0x80, 0x0,
    0x0, 0x6, 0xa9, 0x9, 0x0, 0x22, 0x0, 0x25,
    0x0, 0x20, 0x80, 0x20, 0x20, 0x60, 0x8, 0x0,
    0x2, 0x0, 0x0, 0x40, 0x0, 0x8, 0x0, 0x2,
    0x40, 0x4, 0x1a, 0xa4,
    /* U+00EB "ë" */
    0xa, 0xd, 0x0, 0x0, 0x0, 0x6a, 0x90, 0x90,
    0x2, 0x20, 0x2, 0x50, 0x2, 0x8, 0x2, 0x2,
    0x6, 0x0, 0x80, 0x0, 0x20, 0x0, 0x4, 0x0,
    0x0, 0x80, 0x0, 0x24, 0x0, 0x41, 0xaa, 0x40,
    /* U+00EE "î" */
    0x0, 0x0, 0x60, 0x8, 0x82, 0x5, 0x0, 0x0,
    0x20, 0x2, 0x0, 0x20, 0x2, 0x0, 0x20, 0x2,
    0x0, 0x20, 0x2, 0x0, 0x20, 0x2, 0x0, 0x20,
    0x2, 0x0,
    /* U+00EF "ï" */
    0x30, 0xa0, 0x0, 0x2, 0x0, 0x20, 0x2, 0x0,
    0x20, 0x2, 0x0, 0x20, 0x2, 0x0, 0x20, 0x2,
    0x0, 0x20, 0x2, 0x0, 0x20,
    /* U+00F4 "ô" */
    0x0, 0x50, 0x0, 0xa, 0x40, 0x2, 0x8, 0x0,
    0x0, 0x0, 0x6, 0xa9, 0x2, 0x40, 0x8, 0x20,
    0x0, 0x44, 0x0, 0x1, 0x80, 0x0, 0x28, 0x0,
    0x2, 0x80, 0x0, 0x28, 0x0, 0x2, 0x40, 0x0,
    0x12, 0x0, 0x4, 0x24, 0x0, 0x80, 0x6a, 0x90,
    /* U+00F6 "ö" */
    0x7, 0xe, 0x0, 0x0, 0x0, 0x6, 0xa9, 0x2,
    0x40, 0x8, 0x20, 0x0, 0x44, 0x0, 0x1, 0x80,
    0x0, 0x28, 0x0, 0x2, 0x80, 0x0, 0x28, 0x0,
    0x2, 0x40, 0x0, 0x12, 0x0, 0x4, 0x24, 0x0,
    0x80, 0x6a, 0x90,
    /* U+00FB "û" */
    0x0, 0x0, 0x0, 0x9, 0x0, 0x1, 0x60, 0x0,
    0x10, 0x80, 0x0, 0x0, 0x5, 0x0, 0x8, 0x50,
    0x0, 0x85, 0x0, 0x8, 0x50, 0x0, 0x85, 0x0,
    0x8, 0x50, 0x0, 0x85, 0x0, 0x8, 0x10, 0x0,
    0x82, 0x0, 0x8, 0x20, 0x0, 0x40, 0x80, 0x20,
    0x6, 0xa8, 0x0,
    /* U+00FC "ü" */
    0xa, 0xd, 0x0, 0x0, 0x0, 0x50, 0x0, 0x85,
    0x0, 0x8, 0x50, 0x0, 0x85, 0x0, 0x8, 0x50,
    0x0, 0x85, 0x0, 0x8, 0x50, 0x0, 0x81, 0x0,
    0x8, 0x20, 0x0, 0x82, 0x0, 0x4, 0x8, 0x2,
    0x0, 0x6a, 0x80,
    /* U+00FF "ÿ" */
    0x3, 0xb, 0x0, 0x0, 0x0, 0x4, 0x0, 0x2,
    0x8, 0x0, 0x8, 0x20, 0x0, 0x50, 0x10, 0x2,
    0x0, 0x80, 0x4, 0x1, 0x40, 0x80, 0x2, 0x2,
    0x0, 0x8, 0x10, 0x0, 0x8, 0x80, 0x0, 0x25,
    0x0, 0x0, 0x70, 0x0, 0x0, 0x80, 0x0, 0x2,
    0x0, 0x0, 0x8, 0x0, 0x0, 0x20, 0x0, 0x0,
    0x80, 0x0,
    /* U+0152 "Œ" */
    0x6, 0xaa, 0xea, 0xab, 0x45, 0x0, 0x20, 0x1,
    0x42, 0x0, 0x8, 0x1, 0x80, 0x40, 0x2, 0x1,
    0x80, 0x40, 0x0, 0x81, 0x80, 0x10, 0x0, 0x21,
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    0xaa, 0xba, 0xaa, 0x90,
    /* U+0153 "œ" */
    0x6, 0xa9, 0x2, 0xaa, 0x42, 0x40, 0x8, 0x80,
    0x5, 0x20, 0x0, 0x54, 0x0, 0x84, 0x0, 0x3,
    0x0, 0x20, 0x80, 0x0, 0x30, 0x18, 0x8, 0x0,
    0x2, 0x9, 0x0, 0x80, 0x0, 0x20, 0x0, 0x8,
    0x0, 0x3, 0x0, 0x0, 0x40, 0x0, 0x30, 0x0,
    0x2, 0x0, 0x5, 0x40, 0x0, 0x24, 0x0, 0x88,
    0x0, 0x40, 0x6a, 0x90, 0x2a, 0xa4,
    /* U+0178 "Ÿ" */
    0x3, 0x47, 0x0, 0x0, 0x0, 0x0, 0x0, 0x0,
    0x20, 0x0, 0x5, 0x20, 0x0, 0x20, 0x50, 0x2,
    0x0, 0x80, 0x8, 0x0, 0x80, 0x80, 0x1, 0x45,
    0x0, 0x2, 0x20, 0x0, 0x3, 0x0, 0x0, 0x8,
    0x0, 0x0, 0x20, 0x0, 0x0, 0x80, 0x0, 0x2,
    0x0, 0x0, 0x8, 0x0, 0x0, 0x20, 0x0
};
/*---------------------
 *  GLYPH DESCRIPTION
 *--------------------*/
static const lv_font_fmt_txt_glyph_dsc_t modern_20_glyph_dsc[] = {
    {.bitmap_index = 0, .adv_w = 0, .box_w = 0, .box_h = 0, .ofs_x = 0, .ofs_y = 0} /* id = 0 reserved */,
    {.bitmap_index = 0, .adv_w = 94, .box_w = 0, .box_h = 0, .ofs_x = 0, .ofs_y = 0},
    {.bitmap_index = 0, .adv_w = 77, .box_w = 3, .box_h = 14, .ofs_x = 1, .ofs_y = 0},
    {.bitmap_index = 11, .adv_w = 98, .box_w = 4, .box_h = 4, .ofs_x = 1, .ofs_y = 10},
    {.bitmap_index = 15, .adv_w = 186, .box_w = 10, .box_h = 15, .ofs_x = 1, .ofs_y = 0},
    {.bitmap_index = 53, .adv_w = 168, .box_w = 9, .box_h = 14, .ofs_x = 1, .ofs_y = 0},
    {.bitmap_index = 85, .adv_w = 186, .box_w = 10, .box_h = 10, .ofs_x = 1, .ofs_y = 2},
    {.bitmap_index = 110, .adv_w = 188, .box_w = 10, .box_h = 14, .ofs_x = 1, .ofs_y = 0},
    {.bitmap_index = 145, .adv_w = 63, .box_w = 2, .box_h = 4, .ofs_x = 1, .ofs_y = 10},
    {.bitmap_index = 147, .adv_w = 78, .box_w = 3, .box_h = 18, .ofs_x = 1, .ofs_y = -2},
    {.bitmap_index = 161, .adv_w = 78, .box_w = 4, .box_h = 18, .ofs_x = 0, .ofs_y = -2},
    {.bitmap_index = 179, .adv_w = 140, .box_w = 7, .box_h = 7, .ofs_x = 1, .ofs_y = 7},
    {.bitmap_index = 192, .adv_w = 125, .box_w = 6, .box_h = 6, .ofs_x = 1, .ofs_y = 2},
    {.bitmap_index = 201, .adv_w = 72, .box_w = 2, .box_h = 6, .ofs_x = 1, .ofs_y = -4},
    {.bitmap_index = 204, .adv_w = 116, .box_w = 5, .box_h = 1, .ofs_x = 1, .ofs_y = 5},
    {.bitmap_index = 206, .adv_w = 72, .box_w = 2, .box_h = 2, .ofs_x = 1, .ofs_y = 0},
    {.bitmap_index = 207, .adv_w = 132, .box_w = 8, .box_h = 16, .ofs_x = 0, .ofs_y = -1},
    {.bitmap_index = 239, .adv_w = 181, .box_w = 9, .box_h = 14, .ofs_x = 1, .ofs_y = 0},
    {.bitmap_index = 271, .adv_w = 84, .box_w = 4, .box_h = 14, .ofs_x = 0, .ofs_y = 0},
    {.bitmap_index = 285, .adv_w = 169, .box_w = 9, .box_h = 14, .ofs_x = 1, .ofs_y = 0},
    {.bitmap_index = 317, .adv_w = 178, .box_w = 10, .box_h = 14, .ofs_x = 0, .ofs_y = 0},
    {.bitmap_index = 352, .adv_w = 147, .box_w = 9, .box_h = 14, .ofs_x = 0, .ofs_y = 0},
    {.bitmap_index = 384, .adv_w = 170, .box_w = 10, .box_h = 14, .ofs_x = 0, .ofs_y = 0},
    {.bitmap_index = 419, .adv_w = 168, .box_w = 9, .box_h = 15, .ofs_x = 1, .ofs_y = 0},
    {.bitmap_index = 453, .adv_w = 132, .box_w = 9, .box_h = 14, .ofs_x = 0, .ofs_y = 0},
    {.bitmap_index = 485, .adv_w = 187, .box_w = 10, .box_h = 14, .ofs_x = 1, .ofs_y = 0},
    {.bitmap_index = 520, .adv_w = 169, .box_w = 9, .box_h = 15, .ofs_x = 1, .ofs_y = -1},
    {.bitmap_index = 554, .adv_w = 78, .box_w = 3, .box_h = 6, .ofs_x = 1, .ofs_y = 1},
    {.bitmap_index = 559, .adv_w = 84, .box_w = 3, .box_h = 9, .ofs_x = 1, .ofs_y = -2},
    {.bitmap_index = 566, .adv_w = 140, .box_w = 8, .box_h = 14, .ofs_x = 0, .ofs_y = 0},
    {.bitmap_index = 594, .adv_w = 140, .box_w = 6, .box_h = 3, .ofs_x = 1, .ofs_y = 6},
    {.bitmap_index = 599, .adv_w = 140, .box_w = 7, .box_h = 14, .ofs_x = 1, .ofs_y = 0},
    {.bitmap_index = 624, .adv_w = 162, .box_w = 9, .box_h = 14, .ofs_x = 0, .ofs_y = 0},
    {.bitmap_index = 656, .adv_w = 202, .box_w = 11, .box_h = 14, .ofs_x = 1, .ofs_y = 0},
    {.bitmap_index = 695, .adv_w = 175, .box_w = 11, .box_h = 15, .ofs_x = 0, .ofs_y = 0},
    {.bitmap_index = 737, .adv_w = 185, .box_w = 10, .box_h = 14, .ofs_x = 1, .ofs_y = 0},
    {.bitmap_index = 772, .adv_w = 188, .box_w = 10, .box_h = 14, .ofs_x = 1, .ofs_y = 0},
    {.bitmap_index = 807, .adv_w = 190, .box_w = 10, .box_h = 14, .ofs_x = 1, .ofs_y = 0},
    {.bitmap_index = 842, .adv_w = 184, .box_w = 10, .box_h = 14, .ofs_x = 1, .ofs_y = 0},
    {.bitmap_index = 877, .adv_w = 176, .box_w = 10, .box_h = 14, .ofs_x = 1, .ofs_y = 0},
    {.bitmap_index = 912, .adv_w = 197, .box_w = 10, .box_h = 14, .ofs_x = 1, .ofs_y = 0},
    {.bitmap_index = 947, .adv_w = 198, .box_w = 10, .box_h = 14, .ofs_x = 1, .ofs_y = 0},
    {.bitmap_index = 982, .adv_w = 73, .box_w = 2, .box_h = 14, .ofs_x = 1, .ofs_y = 0},
    {.bitmap_index = 989, .adv_w = 161, .box_w = 9, .box_h = 14, .ofs_x = 0, .ofs_y = 0},
    {.bitmap_index = 1021, .adv_w = 183, .box_w = 11, .box_h = 14, .ofs_x = 1, .ofs_y = 0},
    {.bitmap_index = 1060, .adv_w = 170, .box_w = 10, .box_h = 14, .ofs_x = 1, .ofs_y = 0},
    {.bitmap_index = 1095, .adv_w = 227, .box_w = 12, .box_h = 14, .ofs_x = 1, .ofs_y = 0},
    {.bitmap_index = 1137, .adv_w = 204, .box_w = 10, .box_h = 14, .ofs_x = 1, .ofs_y = 0},
    {.bitmap_index = 1172, .adv_w = 198, .box_w = 10, .box_h = 14, .ofs_x = 1, .ofs_y = 0},
    {.bitmap_index = 1207, .adv_w = 168, .box_w = 9, .box_h = 14, .ofs_x = 1, .ofs_y = 0},
    {.bitmap_index = 1239, .adv_w = 199, .box_w = 10, .box_h = 18, .ofs_x = 1, .ofs_y = -4},
    {.bitmap_index = 1284, .adv_w = 176, .box_w = 9, .box_h = 14, .ofs_x = 1, .ofs_y = 0},
    {.bitmap_index = 1316, .adv_w = 180, .box_w = 10, .box_h = 14, .ofs_x = 1, .ofs_y = 0},
    {.bitmap_index = 1351, .adv_w = 170, .box_w = 11, .box_h = 14, .ofs_x = 0, .ofs_y = 0},
    {.bitmap_index = 1390, .adv_w = 207, .box_w = 11, .box_h = 14, .ofs_x = 1, .ofs_y = 0},
    {.bitmap_index = 1429, .adv_w = 174, .box_w = 11, .box_h = 15, .ofs_x = 0, .ofs_y = -1},
    {.bitmap_index = 1471, .adv_w = 257, .box_w = 16, .box_h = 15, .ofs_x = 0, .ofs_y = -1},
    {.bitmap_index = 1531, .adv_w = 155, .box_w = 10, .box_h = 14, .ofs_x = 0, .ofs_y = 0},
    {.bitmap_index = 1566, .adv_w = 175, .box_w = 11, .box_h = 14, .ofs_x = 0, .ofs_y = 0},
    {.bitmap_index = 1605, .adv_w = 154, .box_w = 9, .box_h = 14, .ofs_x = 0, .ofs_y = 0},
    {.bitmap_index = 1637, .adv_w = 84, .box_w = 3, .box_h = 14, .ofs_x = 2, .ofs_y = 0},
    {.bitmap_index = 1648, .adv_w = 132, .box_w = 8, .box_h = 16, .ofs_x = 0, .ofs_y = -1},
    {.bitmap_index = 1680, .adv_w = 84, .box_w = 3, .box_h = 14, .ofs_x = 1, .ofs_y = 0},
    {.bitmap_index = 1691, .adv_w = 104, .box_w = 6, .box_h = 4, .ofs_x = 0, .ofs_y = 12},
    {.bitmap_index = 1697, .adv_w = 161, .box_w = 9, .box_h = 1, .ofs_x = 1, .ofs_y = -2},
    {.bitmap_index = 1700, .adv_w = 172, .box_w = 11, .box_h = 12, .ofs_x = 0, .ofs_y = 0},
    {.bitmap_index = 1733, .adv_w = 172, .box_w = 9, .box_h = 12, .ofs_x = 1, .ofs_y = 0},
    {.bitmap_index = 1760, .adv_w = 172, .box_w = 9, .box_h = 12, .ofs_x = 1, .ofs_y = 0},
    {.bitmap_index = 1787, .adv_w = 177, .box_w = 9, .box_h = 12, .ofs_x = 1, .ofs_y = 0},
    {.bitmap_index = 1814, .adv_w = 175, .box_w = 9, .box_h = 12, .ofs_x = 1, .ofs_y = 0},
    {.bitmap_index = 1841, .adv_w = 184, .box_w = 10, .box_h = 12, .ofs_x = 1, .ofs_y = 0},
    {.bitmap_index = 1871, .adv_w = 182, .box_w = 9, .box_h = 16, .ofs_x = 1, .ofs_y = -4},
    {.bitmap_index = 1907, .adv_w = 176, .box_w = 9, .box_h = 12, .ofs_x = 1, .ofs_y = 0},
    {.bitmap_index = 1934, .adv_w = 70, .box_w = 2, .box_h = 12, .ofs_x = 1, .ofs_y = 0},
    {.bitmap_index = 1940, .adv_w = 138, .box_w = 8, .box_h = 16, .ofs_x = -1, .ofs_y = -4},
    {.bitmap_index = 1972, .adv_w = 165, .box_w = 10, .box_h = 12, .ofs_x = 1, .ofs_y = 0},
    {.bitmap_index = 2002, .adv_w = 144, .box_w = 8, .box_h = 12, .ofs_x = 1, .ofs_y = 0},
    {.bitmap_index = 2026, .adv_w = 224, .box_w = 12, .box_h = 12, .ofs_x = 1, .ofs_y = 0},
    {.bitmap_index = 2062, .adv_w = 184, .box_w = 9, .box_h = 12, .ofs_x = 1, .ofs_y = 0},
    {.bitmap_index = 2089, .adv_w = 194, .box_w = 10, .box_h = 12, .ofs_x = 1, .ofs_y = 0},
    {.bitmap_index = 2119, .adv_w = 169, .box_w = 9, .box_h = 16, .ofs_x = 1, .ofs_y = -4},
    {.bitmap_index = 2155, .adv_w = 194, .box_w = 10, .box_h = 16, .ofs_x = 1, .ofs_y = -4},
    {.bitmap_index = 2195, .adv_w = 165, .box_w = 9, .box_h = 12, .ofs_x = 1, .ofs_y = 0},
    {.bitmap_index = 2222, .adv_w = 165, .box_w = 9, .box_h = 12, .ofs_x = 1, .ofs_y = 0},
    {.bitmap_index = 2249, .adv_w = 157, .box_w = 10, .box_h = 12, .ofs_x = 0, .ofs_y = 0},
    {.bitmap_index = 2279, .adv_w = 188, .box_w = 10, .box_h = 12, .ofs_x = 1, .ofs_y = 0},
    {.bitmap_index = 2309, .adv_w = 172, .box_w = 11, .box_h = 12, .ofs_x = 0, .ofs_y = 0},
    {.bitmap_index = 2342, .adv_w = 268, .box_w = 17, .box_h = 12, .ofs_x = 0, .ofs_y = 0},
    {.bitmap_index = 2393, .adv_w = 147, .box_w = 9, .box_h = 12, .ofs_x = 0, .ofs_y = 0},
    {.bitmap_index = 2420, .adv_w = 171, .box_w = 11, .box_h = 16, .ofs_x = 0, .ofs_y = -4},
    {.bitmap_index = 2464, .adv_w = 148, .box_w = 9, .box_h = 12, .ofs_x = 0, .ofs_y = 0},
    {.bitmap_index = 2491, .adv_w = 87, .box_w = 5, .box_h = 18, .ofs_x = 0, .ofs_y = -2},
    {.bitmap_index = 2514, .adv_w = 72, .box_w = 2, .box_h = 17, .ofs_x = 1, .ofs_y = -1},
    {.bitmap_index = 2523, .adv_w = 87, .box_w = 5, .box_h = 18, .ofs_x = 0, .ofs_y = -2},
    {.bitmap_index = 2546, .adv_w = 116, .box_w = 6, .box_h = 2, .ofs_x = 1, .ofs_y = 12},
    {.bitmap_index = 2549, .adv_w = 175, .box_w = 11, .box_h = 18, .ofs_x = 0, .ofs_y = 0},
    {.bitmap_index = 2599, .adv_w = 175, .box_w = 11, .box_h = 18, .ofs_x = 0, .ofs_y = 0},
    {.bitmap_index = 2649, .adv_w = 175, .box_w = 11, .box_h = 17, .ofs_x = 0, .ofs_y = 0},
    {.bitmap_index = 2696, .adv_w = 258, .box_w = 16, .box_h = 14, .ofs_x = 0, .ofs_y = 0},
    {.bitmap_index = 2752, .adv_w = 188, .box_w = 10, .box_h = 19, .ofs_x = 1, .ofs_y = -5},
    {.bitmap_index = 2800, .adv_w = 184, .box_w = 10, .box_h = 18, .ofs_x = 1, .ofs_y = 0},
    {.bitmap_index = 2845, .adv_w = 184, .box_w = 10, .box_h = 18, .ofs_x = 1, .ofs_y = 0},
    {.bitmap_index = 2890, .adv_w = 184, .box_w = 10, .box_h = 18, .ofs_x = 1, .ofs_y = 0},
    {.bitmap_index = 2935, .adv_w = 184, .box_w = 10, .box_h = 17, .ofs_x = 1, .ofs_y = 0},
    {.bitmap_index = 2978, .adv_w = 73, .box_w = 6, .box_h = 18, .ofs_x = -1, .ofs_y = 0},
    {.bitmap_index = 3005, .adv_w = 73, .box_w = 6, .box_h = 17, .ofs_x = -1, .ofs_y = 0},
    {.bitmap_index = 3031, .adv_w = 198, .box_w = 10, .box_h = 18, .ofs_x = 1, .ofs_y = 0},
    {.bitmap_index = 3076, .adv_w = 198, .box_w = 10, .box_h = 17, .ofs_x = 1, .ofs_y = 0},
    {.bitmap_index = 3119, .adv_w = 207, .box_w = 11, .box_h = 18, .ofs_x = 1, .ofs_y = 0},
    {.bitmap_index = 3169, .adv_w = 207, .box_w = 11, .box_h = 17, .ofs_x = 1, .ofs_y = 0},
    {.bitmap_index = 3216, .adv_w = 172, .box_w = 11, .box_h = 16, .ofs_x = 0, .ofs_y = 0},
    {.bitmap_index = 3260, .adv_w = 172, .box_w = 11, .box_h = 16, .ofs_x = 0, .ofs_y = 0},
    {.bitmap_index = 3304, .adv_w = 172, .box_w = 11, .box_h = 14, .ofs_x = 0, .ofs_y = 0},
    {.bitmap_index = 3343, .adv_w = 243, .box_w = 15, .box_h = 12, .ofs_x = 0, .ofs_y = 0},
    {.bitmap_index = 3388, .adv_w = 172, .box_w = 9, .box_h = 17, .ofs_x = 1, .ofs_y = -5},
    {.bitmap_index = 3427, .adv_w = 175, .box_w = 9, .box_h = 16, .ofs_x = 1, .ofs_y = 0},
    {.bitmap_index = 3463, .adv_w = 175, .box_w = 9, .box_h = 16, .ofs_x = 1, .ofs_y = 0},
    {.bitmap_index = 3499, .adv_w = 175, .box_w = 9, .box_h = 16, .ofs_x = 1, .ofs_y = 0},
    {.bitmap_index = 3535, .adv_w = 175, .box_w = 9, .box_h = 14, .ofs_x = 1, .ofs_y = 0},
    {.bitmap_index = 3567, .adv_w = 70, .box_w = 6, .box_h = 17, .ofs_x = -1, .ofs_y = 0},
    {.bitmap_index = 3593, .adv_w = 70, .box_w = 6, .box_h = 14, .ofs_x = -1, .ofs_y = 0},
    {.bitmap_index = 3614, .adv_w = 194, .box_w = 10, .box_h = 16, .ofs_x = 1, .ofs_y = 0},
    {.bitmap_index = 3654, .adv_w = 194, .box_w = 10, .box_h = 14, .ofs_x = 1, .ofs_y = 0},
    {.bitmap_index = 3689, .adv_w = 188, .box_w = 10, .box_h = 17, .ofs_x = 1, .ofs_y = 0},
    {.bitmap_index = 3732, .adv_w = 188, .box_w = 10, .box_h = 14, .ofs_x = 1, .ofs_y = 0},
    {.bitmap_index = 3767, .adv_w = 171, .box_w = 11, .box_h = 18, .ofs_x = 0, .ofs_y = -4},
    {.bitmap_index = 3817, .adv_w = 299, .box_w = 17, .box_h = 14, .ofs_x = 1, .ofs_y = 0},
    {.bitmap_index = 3877, .adv_w = 315, .box_w = 18, .box_h = 12, .ofs_x = 1, .ofs_y = 0},
    {.bitmap_index = 3931, .adv_w = 175, .box_w = 11, .box_h = 17, .ofs_x = 0, .ofs_y = 0}
};
/*---------------------
 *  CHARACTER MAPPING
 *--------------------*/
static const uint16_t modern_20_unicode_list_2[] = {
    0x0, 0x2, 0x4, 0x6, 0x7, 0x8, 0x9, 0xa,
    0xb, 0xe, 0xf, 0x14, 0x16, 0x1b, 0x1c, 0x20,
    0x22, 0x24, 0x26, 0x27, 0x28, 0x29, 0x2a, 0x2b,
    0x2e, 0x2f, 0x34, 0x36, 0x3b, 0x3c, 0x3f, 0x92,
    0x93, 0xb8
};
/*Collect the unicode lists and glyph_id offsets*/
static const lv_font_fmt_txt_cmap_t modern_20_cmaps[] =
{
    {
        .range_start = 32, .range_length = 64, .glyph_id_start = 1,
        .unicode_list = NULL, .glyph_id_ofs_list = NULL, .list_length = 0, .type = LV_FONT_FMT_TXT_CMAP_FORMAT0_TINY
    },
    {
        .range_start = 97, .range_length = 30, .glyph_id_start = 65,
        .unicode_list = NULL, .glyph_id_ofs_list = NULL, .list_length = 0, .type = LV_FONT_FMT_TXT_CMAP_FORMAT0_TINY
    },
    {
        .range_start = 192, .range_length = 185, .glyph_id_start = 95,
        .unicode_list = modern_20_unicode_list_2, .glyph_id_ofs_list = NULL, .list_length = 34, .type = LV_FONT_FMT_TXT_CMAP_SPARSE_TINY
    }
};
/*--------------------
 *  ALL CUSTOM DATA
 *--------------------*/
/*Store all the custom data of the font*/
static lv_font_fmt_txt_glyph_cache_t modern_20_cache;
static const lv_font_fmt_txt_dsc_t modern_20_font_dsc = {
    .glyph_bitmap = modern_20_glyph_bitmap,
    .glyph_dsc = modern_20_glyph_dsc,
    .cmaps = modern_20_cmaps,
    .kern_dsc = NULL,
    .kern_scale = 0,
    .cmap_num = 3,
    .bpp = 2,
    .kern_classes = 0,
    .bitmap_format = 0,
    .cache = &modern_20_cache
};
/*-----------------
 *  PUBLIC FONT
 *----------------*/
/*Initialize a public general font descriptor*/
const lv_font_t modern_20 = {
    .get_glyph_dsc = lv_font_get_glyph_dsc_fmt_txt,    /*Function pointer to get glyph's data*/
    .get_glyph_bitmap = lv_font_get_bitmap_fmt_txt,    /*Function pointer to get glyph's bitmap*/
    .line_height = 23,          /*The maximum line height required by the font*/
    .base_line = 5,             /*Baseline measured from the bottom of the line*/

    .subpx = LV_FONT_SUBPX_NONE,
    .underline_position = -1,
    .underline_thickness = 1,
    .dsc = &modern_20_font_dsc,          /*The custom font data. Will be accessed by `get_glyph_bitmap/dsc` */
};
#endif

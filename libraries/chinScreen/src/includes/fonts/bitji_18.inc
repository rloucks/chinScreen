/*******************************************************************************
 * Size: 18 px
 * Bpp: 2
 ******************************************************************************/


#ifdef __has_include

    #if __has_include("lvgl.h")
         #ifndef LV_LVGL_H_INCLUDE_SIMPLE
             #define LV_LVGL_H_INCLUDE_SIMPLE
         #endif
     #endif
 #endif

 #ifdef LV_LVGL_H_INCLUDE_SIMPLE
     #include "lvgl.h"
 #else
     #include "../lvgl-8.3.11/lvgl.h"
 #endif

 #ifndef BITJI_18
 #define BITJI_18 1
 #endif

 #if BITJI_18

/*-----------------
 *    BITMAPS
 *----------------*/
/*Store the image of the glyphs*/
static LV_ATTRIBUTE_LARGE_CONST const uint8_t bitji_18_glyph_bitmap[] = {
    /* U+0020 " " */
    /* U+0021 "!" */
    /* U+0022 "\"" */
    /* U+0023 "#" */
    /* U+0024 "$" */
    /* U+0025 "%" */
    /* U+0026 "&" */
    /* U+0027 "'" */
    /* U+0028 "(" */
    /* U+0029 ")" */
    /* U+002A "*" */
    /* U+002B "+" */
    /* U+002C "," */
    /* U+002D "-" */
    /* U+002E "." */
    /* U+002F "/" */
    /* U+0030 "0" */
    /* U+0031 "1" */
    /* U+0032 "2" */
    /* U+0033 "3" */
    /* U+0034 "4" */
    /* U+0035 "5" */
    /* U+0036 "6" */
    /* U+0037 "7" */
    /* U+0038 "8" */
    /* U+0039 "9" */
    /* U+003A ":" */
    /* U+003B ";" */
    /* U+003C "<" */
    /* U+003D "=" */
    /* U+003E ">" */
    /* U+003F "?" */
    /* U+0040 "@" */
    /* U+0041 "A" */
    0x3f, 0xe0, 0x2, 0xfe, 0x3d, 0x2f, 0xff, 0xd1,
    0xfd, 0x1, 0xf3, 0xd0, 0x1f, 0xb, 0xf4, 0x7f,
    0x47, 0xc0, 0x1c, 0xd, 0x1, 0xf0, 0x7, 0xcf,
    0x40, 0x7f, 0x7, 0xff, 0xf4, 0x7c, 0xff, 0x80,
    0xf, 0xfc, 0x0, 0x0, 0x0, 0x0, 0x0,
    /* U+0042 "B" */
    0x3f, 0xe3, 0xfc, 0xd, 0x29, 0xc3, 0x4d, 0x2,
    0xd0, 0x77, 0x0, 0x70, 0xd, 0xc0, 0x1c, 0x3,
    0x70, 0x1, 0x0, 0xdf, 0x40, 0x0, 0xf6, 0xd0,
    0x0, 0x38, 0x1d, 0x0, 0x34, 0x2, 0xf9, 0xfc,
    0x0, 0xb, 0xf0, 0x0,
    /* U+0043 "C" */
    0x15, 0x0, 0x54, 0xf, 0xe0, 0x3f, 0x4f, 0xfe,
    0x7f, 0xf7, 0xff, 0x9f, 0x3d, 0xff, 0xff, 0x3,
    0x7f, 0xff, 0xf3, 0xd7, 0xff, 0xfe, 0xd0, 0xff,
    0xfd, 0xf4, 0x1f, 0xff, 0x38, 0x3, 0xff, 0xfc,
    0x0, 0xb, 0xf0, 0x0,
    /* U+0044 "D" */
    0x0, 0x0, 0x0, 0x2, 0x80, 0x0, 0x2, 0x80,
    0x0, 0x9, 0x60, 0x0, 0xf4, 0x1f, 0x0, 0x9,
    0x60, 0x0, 0x2, 0x80, 0x0, 0x2, 0x80, 0x30,
    0x0, 0x0, 0x0, 0x0, 0x0, 0xc8, 0x0, 0x0,
    0x30,
    /* U+0045 "E" */
    0x3d, 0x0, 0x3c, 0x10, 0x40, 0x10, 0x4c, 0x28,
    0xc, 0x37, 0xb, 0xff, 0xd, 0x3d, 0x0, 0x3d,
    0xd, 0x0, 0x3, 0x43, 0x68, 0xc, 0xd0, 0xda,
    0x63, 0x34, 0x34, 0x0, 0xd, 0xd, 0x0, 0x3,
    0x40, 0x90, 0x3, 0x0, 0xb, 0xff, 0x0,
    /* U+0046 "F" */
    0x0, 0x7f, 0x0, 0x0, 0x29, 0xc0, 0x0, 0x28,
    0x1c, 0x3, 0xfe, 0x3, 0xfd, 0xd0, 0x0, 0x3,
    0x7c, 0x0, 0x3, 0xd3, 0xd0, 0x3, 0xd0, 0xd0,
    0x0, 0x34, 0x34, 0x0, 0xd, 0xd, 0x0, 0x3,
    0x43, 0x4b, 0xf0, 0xd0, 0xff, 0x9f, 0xf4,
    /* U+0047 "G" */
    0x0, 0x68, 0x0, 0x0, 0xbc, 0x0, 0x2, 0xff,
    0x0, 0xff, 0xff, 0xfd, 0xf6, 0xff, 0xfd, 0x3f,
    0x9f, 0xf0, 0x2f, 0x5f, 0xe0, 0x1e, 0x4b, 0xe0,
    0x3f, 0x9f, 0xf0, 0x3f, 0xff, 0xf0, 0x3f, 0x87,
    0xf0,
    /* U+0048 "H" */
    0x0, 0xbf, 0xc0, 0x0, 0xb, 0xfe, 0x80, 0x0,
    0xbf, 0xff, 0x40, 0x6, 0xff, 0xf9, 0x0, 0x1e,
    0xbf, 0xe0, 0x1, 0xc3, 0xfe, 0x3d, 0xbc, 0xf,
    0xef, 0xff, 0xe0, 0xf4, 0xff, 0xff, 0x3d, 0xf,
    0xff, 0xf0, 0x0, 0xbf, 0xfe, 0x0, 0x2, 0xff,
    0x80, 0x0, 0xf, 0xe0, 0x0, 0x0,
    /* U+0049 "I" */
    0x0, 0xbf, 0xf0, 0x0, 0xa, 0x0, 0x34, 0x0,
    0xd0, 0x0, 0x34, 0x3, 0x40, 0x0, 0xd0, 0x14,
    0x10, 0x3, 0x40, 0xd2, 0xf0, 0xd, 0xf, 0x4b,
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    0x0, 0x0, 0x0, 0x0,
    /* U+004A "J" */
    0x0, 0x2f, 0xf0, 0x0, 0x0, 0xd, 0x1, 0xff,
    0xe0, 0x3, 0x40, 0x3, 0x42, 0x80, 0x34, 0x1f,
    0xf0, 0x6, 0x3, 0x46, 0x0, 0xc0, 0x70, 0x3f,
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    0x0, 0x0, 0x0, 0x0, 0x0, 0x0,
    /* U+004B "K" */
    0x0, 0x2f, 0xf0, 0x0, 0x0, 0x1f, 0xff, 0xcf,
    0xe0, 0x3, 0xff, 0xfc, 0xff, 0x80, 0x3f, 0xe5,
    0x4f, 0xfe, 0x3, 0xfe, 0xff, 0xbf, 0xf0, 0x0,
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    0x0, 0x15, 0x50, 0x0, 0x0, 0x0,
    /* U+004C "L" */
    0xff, 0xff, 0xff, 0xf8, 0xd2, 0x80, 0xd, 0x28,
    0xc5, 0x50, 0x15, 0x28, 0xcd, 0xa0, 0x33, 0x68,
    0xff, 0xff, 0xff, 0xf8, 0x34, 0xa0, 0x34, 0xa0,
    0x9, 0x18, 0xc2, 0x40, 0x2, 0x5c, 0xcd, 0x18,
    0x0, 0xa7, 0x30, 0xbe, 0x0, 0x7, 0x0, 0x28,
    0x0, 0x1f, 0xc0, 0x18, 0x0, 0x7, 0x3, 0x40,
    /* U+004D "M" */
    0x0, 0x0, 0x32, 0x40, 0x0, 0x3, 0x40, 0x24,
    0x3, 0x24, 0x0, 0x0, 0x0, 0x2, 0x40, 0x0,
    0x32, 0x68, 0xc0, 0x0, 0x0, 0x0, 0x0, 0x9,
    0x0, 0x0, 0x0, 0x0, 0x0, 0x0, 0x90, 0x0,
    0x0, 0x0, 0x0, 0x0,
    /* U+004E "N" */
    0xc9, 0x0, 0x0, 0x9, 0x0, 0x0, 0xd, 0x90,
    0xc, 0x0, 0x0, 0x0, 0x0, 0x0, 0x0, 0xc0,
    0x0, 0x18, 0xcc, 0x90, 0x0, 0x0, 0x0, 0x0,
    0x3, 0x0, 0x0, 0x0, 0x0, 0x0, 0x0, 0x30,
    0x0, 0x0, 0x0, 0x0,
    /* U+004F "O" */
    0xb, 0xe0, 0x3f, 0x40, 0xf4, 0x63, 0xf, 0x44,
    0x10, 0x10, 0x41, 0x30, 0xa1, 0xc3, 0x4a, 0xc2,
    0x87, 0xd, 0x2b, 0x1, 0xff, 0xc0, 0xaf, 0xfe,
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    0x0,
    /* U+0050 "P" */
    0x3d, 0x3, 0xc0, 0xb8, 0x41, 0x4, 0x11, 0x1,
    0xc2, 0x9c, 0x33, 0x47, 0xc2, 0x9c, 0x33, 0x47,
    0x3d, 0x3, 0xc0, 0xb8, 0x0, 0x0, 0x0, 0x0,
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    0x0, 0x0, 0x0, 0x0,
    /* U+0051 "Q" */
    0xd, 0x0, 0x0, 0xf, 0xfe, 0x0, 0x0, 0x3f,
    0x80, 0x0, 0x3, 0xb8, 0x0, 0x0, 0x36, 0x80,
    0x0, 0x0, 0x0, 0xf, 0xc0, 0x0, 0x1f, 0xcf,
    0xd0, 0x1, 0xc0, 0xa, 0x0, 0x1f, 0x3, 0xd0,
    0x0, 0x73, 0x34, 0x0, 0x7, 0xff, 0x40, 0x0,
    0x0, 0x0,
    /* U+0052 "R" */
    0x0, 0x1, 0x0, 0xa7, 0x0, 0xbf, 0x0, 0x1c,
    0x0, 0x0, 0x36, 0x80, 0xbf, 0xd0, 0xff, 0xe0,
    0xbf, 0xd0, 0x2f, 0x40, 0xd, 0x0,
    /* U+0053 "S" */
    0x0, 0x7, 0xff, 0x43, 0x34, 0x70, 0x2, 0x8b,
    0xda, 0x1a, 0x92, 0x8d, 0x29, 0xc0, 0xda, 0x0,
    0xa7, 0x3f, 0x68, 0x26, 0x9c, 0xcd, 0xa0, 0xa,
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    0xf4, 0x0, 0x0, 0x1, 0x40, 0x0, 0x0, 0x0,
    /* U+0054 "T" */
    0x1, 0xa4, 0xa8, 0x0, 0xb, 0xf7, 0xf4, 0x0,
    0xff, 0xff, 0xf4, 0xf, 0xff, 0xff, 0xf8, 0xfd,
    0x0, 0x0, 0xb8, 0xb, 0xff, 0xf0, 0x3, 0xff,
    0xff, 0xfe, 0x3, 0xff, 0xff, 0xd0, 0x5, 0xbf,
    0xf5, 0x0, 0x1, 0xaa, 0x80, 0x0,
    /* U+0055 "U" */
    0x0, 0x7, 0xff, 0xff, 0x0, 0x7c, 0x0, 0x7,
    0x2, 0x80, 0x32, 0x47, 0x2, 0x80, 0x3d, 0x7,
    0x9, 0x18, 0x34, 0x7, 0xd, 0x1c, 0x30, 0x7,
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    0x0, 0x0, 0x0, 0x0,
    /* U+0056 "V" */
    0x2e, 0x73, 0xd3, 0xff, 0xff, 0xdf, 0xff, 0xff,
    0x7f, 0xff, 0xfd, 0xff, 0xff, 0xf5, 0xff, 0xff,
    0x81, 0xff, 0xfc, 0x1, 0xff, 0xc0, 0x0, 0x70,
    0x0, 0xb9, 0xcf, 0x0, 0x7, 0x41, 0x34, 0x7f,
    0xd, 0x90, 0x60, 0x24, 0xbf, 0x3f, 0x40,
    /* U+0057 "W" */
    0x0, 0xa0, 0x30, 0x0, 0x0, 0x73, 0x0, 0x2,
    0xa5, 0xcc, 0xa9, 0x2f, 0xfb, 0x3b, 0xfd, 0xfe,
    0xbd, 0xea, 0xfb, 0xd0, 0x2e, 0x2, 0xef, 0x40,
    0x70, 0xb, 0x8f, 0x41, 0xc0, 0xf8, 0xf, 0xff,
    0xff, 0x40, 0xf4, 0x1c, 0xf, 0x83, 0xd0, 0xb8,
    0x3e, 0x7, 0x9b, 0x75, 0xe0, 0xb, 0xfc, 0xff,
    0x40, 0xb, 0xf3, 0xf4, 0x0,
    /* U+0058 "X" */
    0x0, 0x1f, 0x0, 0x0, 0xfe, 0x1f, 0xd0, 0x24,
    0xa0, 0xc2, 0x43, 0x4b, 0x5c, 0x34, 0x34, 0xbf,
    0xc3, 0x43, 0xff, 0xff, 0xf4, 0xc2, 0xff, 0xf0,
    0xac, 0x2f, 0xff, 0xa, 0x3f, 0xff, 0xff, 0x43,
    0x4b, 0xfc, 0x34, 0x34, 0xba, 0xc3, 0x43, 0x4a,
    0xc, 0x34, 0xb, 0xe1, 0xfc, 0x0, 0x1, 0xf0,
    0x0,
    /* U+0059 "Y" */
    0x0, 0xbf, 0xf0, 0x0, 0xf8, 0x0, 0xd0, 0x34,
    0x0, 0x3, 0x43, 0x40, 0x3f, 0x9, 0x0, 0x0,
    0x0, 0xac, 0x1, 0x80, 0xca, 0xc0, 0xa0, 0x3,
    0xec, 0xa, 0x0, 0x0, 0xc0, 0xa0, 0x0, 0xc,
    0x1, 0x80, 0xf4, 0x10, 0x1, 0x53, 0x43, 0x40,
    0x3f, 0x34, 0x24, 0x0, 0x2, 0x40, 0xf8, 0x0,
    0xd0, 0x0, 0x7f, 0xf0, 0x0, 0x0, 0x0, 0x0,
    /* U+005A "Z" */
    0x0, 0x1c, 0x0, 0x8, 0x7, 0x2, 0x1, 0xd0,
    0x3, 0x40, 0x0, 0x0, 0x0, 0x0, 0xbf, 0x0,
    0x0, 0xbf, 0xf0, 0xf, 0x2f, 0xfc, 0xf4, 0xb,
    0xff, 0x0, 0x1, 0xff, 0x80, 0x2, 0x40, 0xc,
    0x1, 0x0, 0x0, 0x40, 0x80, 0x70, 0x20, 0x0,
    0x1c, 0x0, 0x0,
    /* U+005B "[" */
    /* U+005C "\\" */
    /* U+005D "]" */
    /* U+005E "^" */
    /* U+005F "_" */
    /* U+0061 "a" */
    0x0, 0x0, 0x3f, 0x40, 0x0, 0x3, 0x2, 0x80,
    0x0, 0x70, 0xa, 0x0, 0x1, 0xff, 0xe0, 0x0,
    0x7, 0x0, 0x0, 0x1, 0x55, 0x50, 0x0, 0x2f,
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    0x6, 0xff, 0xd4, 0x0, 0x6, 0xaa, 0x0, 0x0,
    /* U+0062 "b" */
    0x0, 0x1c, 0x0, 0x28, 0x0, 0x1c, 0x0, 0x28,
    0x0, 0x7f, 0xc0, 0xaa, 0x2, 0x80, 0x30, 0xa7,
    0x5, 0x0, 0x8, 0x14, 0xd, 0x0, 0x4d, 0x14,
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    0x30, 0x1f, 0xc0, 0x0, 0x0, 0x0, 0x0, 0x0,
    /* U+0063 "c" */
    0x0, 0x7, 0x0, 0x0, 0x2, 0xff, 0xc0, 0x0,
    0xb8, 0x0, 0xf4, 0xd, 0x0, 0x0, 0x28, 0x34,
    0x0, 0x0, 0xa2, 0x40, 0x0, 0x0, 0x5c, 0x0,
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    0x0, 0x2f, 0x0, 0x0,
    /* U+0064 "d" */
    0x0, 0x7, 0x0, 0x0, 0x34, 0x1c, 0xd, 0x0,
    0x24, 0x10, 0xd0, 0x0, 0x7, 0xf0, 0x0, 0x0,
    0x0, 0x0, 0x3, 0x1, 0x80, 0xc2, 0xe3, 0x28,
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    0x0, 0x0, 0x0, 0x0,
    /* U+0065 "e" */
    0x0, 0x7, 0xc0, 0x0, 0x2, 0xfc, 0x3f, 0x40,
    0xd, 0x1c, 0x34, 0xa0, 0x3d, 0x0, 0x10, 0xb8,
    0x41, 0x0, 0x0, 0x0, 0xc2, 0x40, 0x2, 0x47,
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    0x0, 0x3, 0xc0, 0x0, 0x0, 0x0, 0x0, 0x0,
    /* U+0066 "f" */
    0x34, 0x0, 0x0, 0x0, 0xdd, 0x1f, 0xf0, 0x0,
    0x34, 0x60, 0xc, 0x0, 0x2, 0x80, 0x2, 0x58,
    0x42, 0x80, 0x13, 0x40, 0xc2, 0x9c, 0x33, 0x40,
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    0x0, 0x0, 0x0, 0x0,
    /* U+0067 "g" */
    0xd, 0x0, 0x3, 0x40, 0xcd, 0xa0, 0xd, 0xa0,
    0x3f, 0x80, 0x3, 0x40, 0xcd, 0xa0, 0x0, 0x6,
    0xd, 0x0, 0x0, 0x0, 0x9, 0x0, 0x32, 0x40,
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    0x0, 0x7, 0xd, 0x28, 0x0, 0x0, 0x37, 0x40,
    /* U+0068 "h" */
    0x30, 0x1f, 0xc0, 0x93, 0x36, 0xf3, 0xcd, 0xac,
    0x1f, 0xef, 0x92, 0x8c, 0xa7, 0xf3, 0x68, 0x42,
    0xaf, 0xdd, 0x13, 0xb, 0xff, 0xf4, 0xac, 0x9b,
    0xcf, 0x26, 0x8d, 0x7, 0xf0, 0x28, 0x0, 0x0,
    0x0, 0x0,
    /* U+0069 "i" */
    0x0, 0x0, 0x3d, 0xb8, 0x0, 0x0, 0x81, 0x45,
    0x0, 0x0, 0xc3, 0x47, 0x0, 0x0, 0xc2, 0x47,
    0x0, 0x0, 0xc0, 0x7, 0x0, 0x0, 0x30, 0x18,
    0x3d, 0x78, 0xf, 0xe0, 0xc2, 0x87, 0x0, 0x0,
    0xc2, 0x87, 0x0, 0x0, 0xc0, 0x7, 0x0, 0x0,
    0x80, 0x1, 0x0, 0x0, 0x24, 0x18, 0x0, 0x0,
    0xf, 0xe0, 0x0, 0x0,
    /* U+006A "j" */
    0x2d, 0x0, 0xb, 0x44, 0x10, 0x1, 0x4, 0xd2,
    0x80, 0x34, 0xad, 0x28, 0x3, 0x4a, 0x0, 0x0,
    0x0, 0x0, 0x0, 0x0, 0x0, 0xa, 0x0, 0xd,
    0x0, 0xa0, 0x0, 0xd0, 0x0, 0x0, 0x4, 0x0,
    0x18, 0x2, 0x0, 0x0, 0x7f, 0xc0, 0x0,
    /* U+006B "k" */
    0x30, 0x0, 0x0, 0x90, 0x10, 0x0, 0x5, 0x0,
    0xd0, 0x0, 0x34, 0x3f, 0xd0, 0x3, 0xfe, 0xd,
    0x0, 0x3, 0x40, 0xc0, 0x0, 0x2, 0x40, 0x2f,
    0xff, 0xc0, 0x0, 0xa0, 0x3, 0x40, 0x0, 0x0,
    0x4, 0x0, 0x1, 0x80, 0xc0, 0x0, 0x1, 0xfc,
    0x0, 0x0,
    /* U+006C "l" */
    0x30, 0x0, 0x0, 0x90, 0x34, 0x0, 0xd, 0xf,
    0xf4, 0x0, 0xff, 0x83, 0x40, 0x0, 0xd0, 0x34,
    0x0, 0x0, 0x90, 0x1, 0xff, 0xc0, 0x0, 0x4,
    0x0, 0x40, 0x0, 0xa0, 0x3, 0x40, 0x2, 0x80,
    0xd, 0x0,
    /* U+006D "m" */
    0x0, 0x0, 0x3, 0x40, 0xb, 0xf0, 0x3f, 0x80,
    0x90, 0x73, 0xff, 0x83, 0x41, 0xc3, 0xf8, 0xd,
    0x7, 0x7, 0x90, 0x28, 0x1c, 0x9, 0x0, 0x28,
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    0x2, 0xfc, 0x0, 0x0, 0x0, 0x0, 0x0, 0x0,
    /* U+006E "n" */
    0x0, 0xa0, 0x0, 0x2, 0x80, 0x0, 0x2a, 0x80,
    0x0, 0x0, 0x0, 0x9, 0x3, 0x0, 0xd0, 0x3,
    0x3, 0x40, 0xc, 0x30, 0x0, 0xc, 0xc0, 0x0,
    0x33, 0x0, 0x0, 0xc8, 0x0, 0x2, 0x9, 0x0,
    0x70, 0xd, 0x7, 0x0, 0xb, 0xe0, 0x0, 0x0,
    0x0, 0x0,
    /* U+006F "o" */
    0x0, 0x0, 0x3, 0x40, 0x0, 0x0, 0x3, 0x40,
    0x0, 0x0, 0xd, 0x90, 0x0, 0x0, 0x30, 0x28,
    0x0, 0x0, 0x30, 0x28, 0x0, 0x0, 0x90, 0x5,
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    0x0, 0x0, 0x0, 0x0,
    /* U+0070 "p" */
    0x0, 0x1f, 0xc0, 0x0, 0x0, 0xa0, 0x34, 0x0,
    0x2, 0x80, 0xd, 0x0, 0x2, 0x80, 0xf, 0xd0,
    0x2, 0x80, 0x30, 0x28, 0x2, 0xd0, 0x0, 0x5,
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    0x0, 0x7, 0xf0, 0x0,
    /* U+0071 "q" */
    0x3d, 0x0, 0x3, 0xe3, 0x4b, 0xff, 0xf4, 0xac,
    0x28, 0x0, 0xd2, 0xb2, 0x80, 0x1, 0xda, 0x10,
    0x0, 0x10, 0x50, 0xd2, 0x80, 0xc2, 0x83, 0x4a,
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    0x0, 0x0, 0x0, 0x0,
    /* U+0072 "r" */
    0x0, 0x0, 0x3f, 0x40, 0x0, 0x7f, 0x74, 0x0,
    0x7d, 0xcf, 0xd0, 0x2e, 0x73, 0xda, 0x7, 0x9b,
    0x3d, 0xa1, 0xe6, 0xdb, 0xda, 0x3d, 0xbc, 0xfd,
    0xa3, 0x4b, 0xcf, 0xda, 0xf6, 0xe7, 0xf0, 0xac,
    0x29, 0xff, 0x2e, 0xc7, 0x9f, 0xd3, 0xec, 0xe6,
    0xf8, 0x79, 0xce, 0xfd, 0x2f, 0x4c, 0xff, 0xc3,
    0xf4, 0x2f, 0x81, 0xfc, 0x0, 0xff, 0xfc, 0x0,
    /* U+0073 "s" */
    0x0, 0x0, 0x3, 0xe0, 0x0, 0x3, 0xfe, 0x0,
    0x7, 0xff, 0xe0, 0xb, 0xff, 0xfe, 0x0, 0xbf,
    0xfa, 0xe0, 0xb, 0xfa, 0xa, 0x0, 0xb9, 0x0,
    0xa0, 0xa, 0x0, 0xa, 0x0, 0xa0, 0x0, 0xa0,
    0xa, 0x3, 0xfe, 0x1a, 0xe0, 0xbf, 0xeb, 0xfe,
    0xf, 0xfe, 0xff, 0xe0, 0xff, 0xef, 0xfe, 0xf,
    0xfe, 0xff, 0xe0, 0x3f, 0x43, 0xf8, 0x0, 0x0,
    /* U+0074 "t" */
    0x0, 0x7f, 0xfd, 0x0, 0x0, 0x3d, 0x0, 0x0,
    0xf4, 0x0, 0x3, 0xd0, 0x0, 0x7, 0x40, 0x0,
    0x1f, 0x0, 0x0, 0x7f, 0xfd, 0x0, 0x0, 0x0,
    0x0, 0x0, 0x0, 0xff, 0x80, 0x0, 0xa, 0x0,
    0x0, 0x4, 0x0, 0x0, 0x34, 0x0, 0x0, 0xff,
    0x80, 0x0, 0x0, 0x0, 0x0,
    /* U+0075 "u" */
    0x0, 0x0, 0xff, 0xe0, 0x0, 0x7, 0x0, 0x2f,
    0x0, 0x1d, 0xfc, 0x7, 0x0, 0x1f, 0xc0, 0x7,
    0x0, 0x1c, 0x0, 0x18, 0x0, 0x7c, 0x2, 0xe0,
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    0x0, 0x0, 0x15, 0x40,
    /* U+0076 "v" */
    0x2, 0x80, 0x0, 0x0, 0xd, 0xa0, 0xfd, 0x0,
    0xd, 0xa3, 0x3, 0x40, 0x2, 0x98, 0x3, 0x40,
    0x7, 0x80, 0x2b, 0x90, 0x34, 0x0, 0xf, 0xf8,
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    0x0, 0x1f, 0xff, 0xe0,
    /* U+0077 "w" */
    0x0, 0x0, 0xf, 0xe0, 0x0, 0x0, 0x34, 0x28,
    0x0, 0x0, 0xc0, 0x28, 0x0, 0x0, 0xc0, 0x28,
    0x1a, 0x92, 0xc4, 0x19, 0x6a, 0xa6, 0x98, 0x7,
    0xc0, 0x1c, 0x30, 0x7, 0xc0, 0x1c, 0x30, 0x7,
    0xc0, 0x7c, 0x3f, 0xf8, 0x30, 0x7, 0xc0, 0x0,
    0x34, 0x7, 0x0, 0x0, 0x34, 0x1, 0x0, 0x0,
    0x24, 0x18, 0x0, 0x0, 0xf, 0xe0, 0x0, 0x0,
    /* U+0078 "x" */
    0x3f, 0xe0, 0xf, 0xf8, 0xff, 0xfc, 0x3f, 0xff,
    0xff, 0xfc, 0x3f, 0xff, 0xff, 0xfc, 0x3f, 0xff,
    0xff, 0xfc, 0x3f, 0xff, 0xff, 0xfc, 0x3f, 0xff,
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    0x15, 0x40, 0x5, 0x50,
    /* U+0079 "y" */
    0x3f, 0xe0, 0x3f, 0xe0, 0xff, 0xfc, 0xff, 0xf8,
    0xff, 0xfc, 0xff, 0xff, 0xff, 0xfc, 0xff, 0xff,
    0xff, 0xfc, 0xaa, 0xff, 0xff, 0xfc, 0xa, 0xff,
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    0x1a, 0x90, 0x2a, 0x90,
    /* U+007A "z" */
    0x0, 0xc, 0x0, 0xc2, 0x40, 0x0, 0x9, 0x0,
    0x0, 0x2, 0xe0, 0x0,
    /* U+007B "{" */
    /* U+007C "|" */
    /* U+007D "}" */
    /* U+007E "~" */
    /* U+00C0 "À" */
    /* U+00C2 "Â" */
    /* U+00C4 "Ä" */
    /* U+00C6 "Æ" */
    /* U+00C7 "Ç" */
    /* U+00C8 "È" */
    /* U+00C9 "É" */
    /* U+00CA "Ê" */
    /* U+00CB "Ë" */
    /* U+00CE "Î" */
    /* U+00CF "Ï" */
    /* U+00D4 "Ô" */
    /* U+00D6 "Ö" */
    /* U+00DB "Û" */
    /* U+00DC "Ü" */
    /* U+00E0 "à" */
    /* U+00E2 "â" */
    /* U+00E4 "ä" */
    /* U+00E6 "æ" */
    /* U+00E7 "ç" */
    /* U+00E8 "è" */
    /* U+00E9 "é" */
    /* U+00EA "ê" */
    /* U+00EB "ë" */
    /* U+00EE "î" */
    /* U+00EF "ï" */
    /* U+00F4 "ô" */
    /* U+00F6 "ö" */
    /* U+00FB "û" */
    /* U+00FC "ü" */
    /* U+00FF "ÿ" */
    /* U+0152 "Œ" */
    /* U+0153 "œ" */
    /* U+0178 "Ÿ" */
};
/*---------------------
 *  GLYPH DESCRIPTION
 *--------------------*/
static const lv_font_fmt_txt_glyph_dsc_t bitji_18_glyph_dsc[] = {
    {.bitmap_index = 0, .adv_w = 0, .box_w = 0, .box_h = 0, .ofs_x = 0, .ofs_y = 0} /* id = 0 reserved */,
    {.bitmap_index = 0, .adv_w = 90, .box_w = 0, .box_h = 0, .ofs_x = 0, .ofs_y = 0},
    {.bitmap_index = 0, .adv_w = 144, .box_w = 0, .box_h = 0, .ofs_x = 0, .ofs_y = 0},
    {.bitmap_index = 0, .adv_w = 144, .box_w = 0, .box_h = 0, .ofs_x = 0, .ofs_y = 0},
    {.bitmap_index = 0, .adv_w = 144, .box_w = 0, .box_h = 0, .ofs_x = 0, .ofs_y = 0},
    {.bitmap_index = 0, .adv_w = 144, .box_w = 0, .box_h = 0, .ofs_x = 0, .ofs_y = 0},
    {.bitmap_index = 0, .adv_w = 144, .box_w = 0, .box_h = 0, .ofs_x = 0, .ofs_y = 0},
    {.bitmap_index = 0, .adv_w = 144, .box_w = 0, .box_h = 0, .ofs_x = 0, .ofs_y = 0},
    {.bitmap_index = 0, .adv_w = 144, .box_w = 0, .box_h = 0, .ofs_x = 0, .ofs_y = 0},
    {.bitmap_index = 0, .adv_w = 144, .box_w = 0, .box_h = 0, .ofs_x = 0, .ofs_y = 0},
    {.bitmap_index = 0, .adv_w = 144, .box_w = 0, .box_h = 0, .ofs_x = 0, .ofs_y = 0},
    {.bitmap_index = 0, .adv_w = 144, .box_w = 0, .box_h = 0, .ofs_x = 0, .ofs_y = 0},
    {.bitmap_index = 0, .adv_w = 144, .box_w = 0, .box_h = 0, .ofs_x = 0, .ofs_y = 0},
    {.bitmap_index = 0, .adv_w = 144, .box_w = 0, .box_h = 0, .ofs_x = 0, .ofs_y = 0},
    {.bitmap_index = 0, .adv_w = 144, .box_w = 0, .box_h = 0, .ofs_x = 0, .ofs_y = 0},
    {.bitmap_index = 0, .adv_w = 144, .box_w = 0, .box_h = 0, .ofs_x = 0, .ofs_y = 0},
    {.bitmap_index = 0, .adv_w = 144, .box_w = 0, .box_h = 0, .ofs_x = 0, .ofs_y = 0},
    {.bitmap_index = 0, .adv_w = 144, .box_w = 0, .box_h = 0, .ofs_x = 0, .ofs_y = 0},
    {.bitmap_index = 0, .adv_w = 144, .box_w = 0, .box_h = 0, .ofs_x = 0, .ofs_y = 0},
    {.bitmap_index = 0, .adv_w = 144, .box_w = 0, .box_h = 0, .ofs_x = 0, .ofs_y = 0},
    {.bitmap_index = 0, .adv_w = 144, .box_w = 0, .box_h = 0, .ofs_x = 0, .ofs_y = 0},
    {.bitmap_index = 0, .adv_w = 144, .box_w = 0, .box_h = 0, .ofs_x = 0, .ofs_y = 0},
    {.bitmap_index = 0, .adv_w = 144, .box_w = 0, .box_h = 0, .ofs_x = 0, .ofs_y = 0},
    {.bitmap_index = 0, .adv_w = 144, .box_w = 0, .box_h = 0, .ofs_x = 0, .ofs_y = 0},
    {.bitmap_index = 0, .adv_w = 144, .box_w = 0, .box_h = 0, .ofs_x = 0, .ofs_y = 0},
    {.bitmap_index = 0, .adv_w = 144, .box_w = 0, .box_h = 0, .ofs_x = 0, .ofs_y = 0},
    {.bitmap_index = 0, .adv_w = 144, .box_w = 0, .box_h = 0, .ofs_x = 0, .ofs_y = 0},
    {.bitmap_index = 0, .adv_w = 144, .box_w = 0, .box_h = 0, .ofs_x = 0, .ofs_y = 0},
    {.bitmap_index = 0, .adv_w = 144, .box_w = 0, .box_h = 0, .ofs_x = 0, .ofs_y = 0},
    {.bitmap_index = 0, .adv_w = 144, .box_w = 0, .box_h = 0, .ofs_x = 0, .ofs_y = 0},
    {.bitmap_index = 0, .adv_w = 144, .box_w = 0, .box_h = 0, .ofs_x = 0, .ofs_y = 0},
    {.bitmap_index = 0, .adv_w = 144, .box_w = 0, .box_h = 0, .ofs_x = 0, .ofs_y = 0},
    {.bitmap_index = 0, .adv_w = 144, .box_w = 0, .box_h = 0, .ofs_x = 0, .ofs_y = 0},
    {.bitmap_index = 0, .adv_w = 144, .box_w = 0, .box_h = 0, .ofs_x = 0, .ofs_y = 0},
    {.bitmap_index = 0, .adv_w = 288, .box_w = 17, .box_h = 9, .ofs_x = 0, .ofs_y = 0},
    {.bitmap_index = 39, .adv_w = 216, .box_w = 13, .box_h = 11, .ofs_x = 0, .ofs_y = 0},
    {.bitmap_index = 75, .adv_w = 216, .box_w = 13, .box_h = 11, .ofs_x = 0, .ofs_y = 0},
    {.bitmap_index = 111, .adv_w = 198, .box_w = 12, .box_h = 11, .ofs_x = 0, .ofs_y = 0},
    {.bitmap_index = 144, .adv_w = 216, .box_w = 13, .box_h = 12, .ofs_x = 0, .ofs_y = 0},
    {.bitmap_index = 183, .adv_w = 216, .box_w = 13, .box_h = 12, .ofs_x = 0, .ofs_y = 0},
    {.bitmap_index = 222, .adv_w = 198, .box_w = 12, .box_h = 11, .ofs_x = 0, .ofs_y = 1},
    {.bitmap_index = 255, .adv_w = 234, .box_w = 14, .box_h = 13, .ofs_x = 0, .ofs_y = 0},
    {.bitmap_index = 301, .adv_w = 252, .box_w = 15, .box_h = 16, .ofs_x = 0, .ofs_y = -2},
    {.bitmap_index = 361, .adv_w = 270, .box_w = 18, .box_h = 19, .ofs_x = -2, .ofs_y = -5},
    {.bitmap_index = 447, .adv_w = 270, .box_w = 18, .box_h = 19, .ofs_x = -2, .ofs_y = -5},
    {.bitmap_index = 533, .adv_w = 270, .box_w = 16, .box_h = 12, .ofs_x = 0, .ofs_y = 0},
    {.bitmap_index = 581, .adv_w = 216, .box_w = 13, .box_h = 11, .ofs_x = 0, .ofs_y = 0},
    {.bitmap_index = 617, .adv_w = 234, .box_w = 13, .box_h = 11, .ofs_x = 1, .ofs_y = 0},
    {.bitmap_index = 653, .adv_w = 252, .box_w = 15, .box_h = 15, .ofs_x = 0, .ofs_y = -3},
    {.bitmap_index = 710, .adv_w = 270, .box_w = 16, .box_h = 15, .ofs_x = 0, .ofs_y = -5},
    {.bitmap_index = 770, .adv_w = 234, .box_w = 14, .box_h = 12, .ofs_x = 0, .ofs_y = 1},
    {.bitmap_index = 812, .adv_w = 144, .box_w = 8, .box_h = 11, .ofs_x = 0, .ofs_y = 0},
    {.bitmap_index = 834, .adv_w = 252, .box_w = 15, .box_h = 19, .ofs_x = 0, .ofs_y = -5},
    {.bitmap_index = 906, .adv_w = 252, .box_w = 15, .box_h = 10, .ofs_x = 0, .ofs_y = 1},
    {.bitmap_index = 944, .adv_w = 270, .box_w = 16, .box_h = 17, .ofs_x = 0, .ofs_y = -4},
    {.bitmap_index = 1012, .adv_w = 216, .box_w = 11, .box_h = 14, .ofs_x = 2, .ofs_y = 0},
    {.bitmap_index = 1051, .adv_w = 252, .box_w = 15, .box_h = 14, .ofs_x = 0, .ofs_y = 0},
    {.bitmap_index = 1104, .adv_w = 234, .box_w = 14, .box_h = 14, .ofs_x = 0, .ofs_y = 0},
    {.bitmap_index = 1153, .adv_w = 234, .box_w = 14, .box_h = 16, .ofs_x = 0, .ofs_y = -2},
    {.bitmap_index = 1209, .adv_w = 216, .box_w = 13, .box_h = 13, .ofs_x = 0, .ofs_y = 0},
    {.bitmap_index = 1252, .adv_w = 144, .box_w = 0, .box_h = 0, .ofs_x = 0, .ofs_y = 0},
    {.bitmap_index = 1252, .adv_w = 144, .box_w = 0, .box_h = 0, .ofs_x = 0, .ofs_y = 0},
    {.bitmap_index = 1252, .adv_w = 144, .box_w = 0, .box_h = 0, .ofs_x = 0, .ofs_y = 0},
    {.bitmap_index = 1252, .adv_w = 144, .box_w = 0, .box_h = 0, .ofs_x = 0, .ofs_y = 0},
    {.bitmap_index = 1252, .adv_w = 144, .box_w = 0, .box_h = 0, .ofs_x = 0, .ofs_y = 0},
    {.bitmap_index = 1252, .adv_w = 252, .box_w = 15, .box_h = 19, .ofs_x = 0, .ofs_y = -5},
    {.bitmap_index = 1324, .adv_w = 270, .box_w = 16, .box_h = 18, .ofs_x = 0, .ofs_y = -4},
    {.bitmap_index = 1396, .adv_w = 252, .box_w = 15, .box_h = 16, .ofs_x = 0, .ofs_y = -2},
    {.bitmap_index = 1456, .adv_w = 252, .box_w = 15, .box_h = 16, .ofs_x = 0, .ofs_y = -2},
    {.bitmap_index = 1516, .adv_w = 270, .box_w = 16, .box_h = 16, .ofs_x = 0, .ofs_y = -2},
    {.bitmap_index = 1580, .adv_w = 270, .box_w = 16, .box_h = 19, .ofs_x = 0, .ofs_y = -5},
    {.bitmap_index = 1656, .adv_w = 270, .box_w = 16, .box_h = 16, .ofs_x = 0, .ofs_y = -2},
    {.bitmap_index = 1720, .adv_w = 252, .box_w = 15, .box_h = 9, .ofs_x = 0, .ofs_y = 0},
    {.bitmap_index = 1754, .adv_w = 270, .box_w = 16, .box_h = 13, .ofs_x = 0, .ofs_y = 0},
    {.bitmap_index = 1806, .adv_w = 252, .box_w = 14, .box_h = 11, .ofs_x = 1, .ofs_y = 0},
    {.bitmap_index = 1845, .adv_w = 252, .box_w = 15, .box_h = 11, .ofs_x = 0, .ofs_y = 0},
    {.bitmap_index = 1887, .adv_w = 252, .box_w = 15, .box_h = 9, .ofs_x = 0, .ofs_y = 1},
    {.bitmap_index = 1921, .adv_w = 252, .box_w = 15, .box_h = 19, .ofs_x = 0, .ofs_y = -5},
    {.bitmap_index = 1993, .adv_w = 180, .box_w = 11, .box_h = 15, .ofs_x = 0, .ofs_y = -2},
    {.bitmap_index = 2035, .adv_w = 270, .box_w = 16, .box_h = 19, .ofs_x = 0, .ofs_y = -5},
    {.bitmap_index = 2111, .adv_w = 270, .box_w = 16, .box_h = 15, .ofs_x = 0, .ofs_y = -2},
    {.bitmap_index = 2171, .adv_w = 252, .box_w = 15, .box_h = 18, .ofs_x = 0, .ofs_y = -4},
    {.bitmap_index = 2239, .adv_w = 234, .box_w = 14, .box_h = 16, .ofs_x = 0, .ofs_y = -2},
    {.bitmap_index = 2295, .adv_w = 234, .box_w = 14, .box_h = 16, .ofs_x = 0, .ofs_y = -2},
    {.bitmap_index = 2351, .adv_w = 216, .box_w = 12, .box_h = 15, .ofs_x = 1, .ofs_y = -2},
    {.bitmap_index = 2396, .adv_w = 270, .box_w = 16, .box_h = 19, .ofs_x = 0, .ofs_y = -5},
    {.bitmap_index = 2472, .adv_w = 270, .box_w = 16, .box_h = 17, .ofs_x = 0, .ofs_y = -3},
    {.bitmap_index = 2540, .adv_w = 270, .box_w = 16, .box_h = 14, .ofs_x = 0, .ofs_y = 0},
    {.bitmap_index = 2596, .adv_w = 270, .box_w = 16, .box_h = 19, .ofs_x = 0, .ofs_y = -5},
    {.bitmap_index = 2672, .adv_w = 270, .box_w = 16, .box_h = 19, .ofs_x = 0, .ofs_y = -5},
    {.bitmap_index = 2748, .adv_w = 108, .box_w = 6, .box_h = 8, .ofs_x = 0, .ofs_y = 4},
    {.bitmap_index = 2760, .adv_w = 144, .box_w = 0, .box_h = 0, .ofs_x = 0, .ofs_y = 0},
    {.bitmap_index = 2760, .adv_w = 144, .box_w = 0, .box_h = 0, .ofs_x = 0, .ofs_y = 0},
    {.bitmap_index = 2760, .adv_w = 144, .box_w = 0, .box_h = 0, .ofs_x = 0, .ofs_y = 0},
    {.bitmap_index = 2760, .adv_w = 144, .box_w = 0, .box_h = 0, .ofs_x = 0, .ofs_y = 0},
    {.bitmap_index = 2760, .adv_w = 144, .box_w = 0, .box_h = 0, .ofs_x = 0, .ofs_y = 0},
    {.bitmap_index = 2760, .adv_w = 144, .box_w = 0, .box_h = 0, .ofs_x = 0, .ofs_y = 0},
    {.bitmap_index = 2760, .adv_w = 144, .box_w = 0, .box_h = 0, .ofs_x = 0, .ofs_y = 0},
    {.bitmap_index = 2760, .adv_w = 144, .box_w = 0, .box_h = 0, .ofs_x = 0, .ofs_y = 0},
    {.bitmap_index = 2760, .adv_w = 144, .box_w = 0, .box_h = 0, .ofs_x = 0, .ofs_y = 0},
    {.bitmap_index = 2760, .adv_w = 144, .box_w = 0, .box_h = 0, .ofs_x = 0, .ofs_y = 0},
    {.bitmap_index = 2760, .adv_w = 144, .box_w = 0, .box_h = 0, .ofs_x = 0, .ofs_y = 0},
    {.bitmap_index = 2760, .adv_w = 144, .box_w = 0, .box_h = 0, .ofs_x = 0, .ofs_y = 0},
    {.bitmap_index = 2760, .adv_w = 144, .box_w = 0, .box_h = 0, .ofs_x = 0, .ofs_y = 0},
    {.bitmap_index = 2760, .adv_w = 144, .box_w = 0, .box_h = 0, .ofs_x = 0, .ofs_y = 0},
    {.bitmap_index = 2760, .adv_w = 144, .box_w = 0, .box_h = 0, .ofs_x = 0, .ofs_y = 0},
    {.bitmap_index = 2760, .adv_w = 144, .box_w = 0, .box_h = 0, .ofs_x = 0, .ofs_y = 0},
    {.bitmap_index = 2760, .adv_w = 144, .box_w = 0, .box_h = 0, .ofs_x = 0, .ofs_y = 0},
    {.bitmap_index = 2760, .adv_w = 144, .box_w = 0, .box_h = 0, .ofs_x = 0, .ofs_y = 0},
    {.bitmap_index = 2760, .adv_w = 144, .box_w = 0, .box_h = 0, .ofs_x = 0, .ofs_y = 0},
    {.bitmap_index = 2760, .adv_w = 144, .box_w = 0, .box_h = 0, .ofs_x = 0, .ofs_y = 0},
    {.bitmap_index = 2760, .adv_w = 144, .box_w = 0, .box_h = 0, .ofs_x = 0, .ofs_y = 0},
    {.bitmap_index = 2760, .adv_w = 144, .box_w = 0, .box_h = 0, .ofs_x = 0, .ofs_y = 0},
    {.bitmap_index = 2760, .adv_w = 144, .box_w = 0, .box_h = 0, .ofs_x = 0, .ofs_y = 0},
    {.bitmap_index = 2760, .adv_w = 144, .box_w = 0, .box_h = 0, .ofs_x = 0, .ofs_y = 0},
    {.bitmap_index = 2760, .adv_w = 144, .box_w = 0, .box_h = 0, .ofs_x = 0, .ofs_y = 0},
    {.bitmap_index = 2760, .adv_w = 144, .box_w = 0, .box_h = 0, .ofs_x = 0, .ofs_y = 0},
    {.bitmap_index = 2760, .adv_w = 144, .box_w = 0, .box_h = 0, .ofs_x = 0, .ofs_y = 0},
    {.bitmap_index = 2760, .adv_w = 144, .box_w = 0, .box_h = 0, .ofs_x = 0, .ofs_y = 0},
    {.bitmap_index = 2760, .adv_w = 144, .box_w = 0, .box_h = 0, .ofs_x = 0, .ofs_y = 0},
    {.bitmap_index = 2760, .adv_w = 144, .box_w = 0, .box_h = 0, .ofs_x = 0, .ofs_y = 0},
    {.bitmap_index = 2760, .adv_w = 144, .box_w = 0, .box_h = 0, .ofs_x = 0, .ofs_y = 0},
    {.bitmap_index = 2760, .adv_w = 144, .box_w = 0, .box_h = 0, .ofs_x = 0, .ofs_y = 0},
    {.bitmap_index = 2760, .adv_w = 144, .box_w = 0, .box_h = 0, .ofs_x = 0, .ofs_y = 0},
    {.bitmap_index = 2760, .adv_w = 144, .box_w = 0, .box_h = 0, .ofs_x = 0, .ofs_y = 0},
    {.bitmap_index = 2760, .adv_w = 144, .box_w = 0, .box_h = 0, .ofs_x = 0, .ofs_y = 0},
    {.bitmap_index = 2760, .adv_w = 144, .box_w = 0, .box_h = 0, .ofs_x = 0, .ofs_y = 0},
    {.bitmap_index = 2760, .adv_w = 144, .box_w = 0, .box_h = 0, .ofs_x = 0, .ofs_y = 0},
    {.bitmap_index = 2760, .adv_w = 144, .box_w = 0, .box_h = 0, .ofs_x = 0, .ofs_y = 0}
};
/*---------------------
 *  CHARACTER MAPPING
 *--------------------*/
static const uint16_t bitji_18_unicode_list_2[] = {
    0x0, 0x2, 0x4, 0x6, 0x7, 0x8, 0x9, 0xa,
    0xb, 0xe, 0xf, 0x14, 0x16, 0x1b, 0x1c, 0x20,
    0x22, 0x24, 0x26, 0x27, 0x28, 0x29, 0x2a, 0x2b,
    0x2e, 0x2f, 0x34, 0x36, 0x3b, 0x3c, 0x3f, 0x92,
    0x93, 0xb8
};
/*Collect the unicode lists and glyph_id offsets*/
static const lv_font_fmt_txt_cmap_t bitji_18_cmaps[] =
{
    {
        .range_start = 32, .range_length = 64, .glyph_id_start = 1,
        .unicode_list = NULL, .glyph_id_ofs_list = NULL, .list_length = 0, .type = LV_FONT_FMT_TXT_CMAP_FORMAT0_TINY
    },
    {
        .range_start = 97, .range_length = 30, .glyph_id_start = 65,
        .unicode_list = NULL, .glyph_id_ofs_list = NULL, .list_length = 0, .type = LV_FONT_FMT_TXT_CMAP_FORMAT0_TINY
    },
    {
        .range_start = 192, .range_length = 185, .glyph_id_start = 95,
        .unicode_list = bitji_18_unicode_list_2, .glyph_id_ofs_list = NULL, .list_length = 34, .type = LV_FONT_FMT_TXT_CMAP_SPARSE_TINY
    }
};
/*--------------------
 *  ALL CUSTOM DATA
 *--------------------*/
/*Store all the custom data of the font*/
static lv_font_fmt_txt_glyph_cache_t bitji_18_cache;
static const lv_font_fmt_txt_dsc_t bitji_18_font_dsc = {
    .glyph_bitmap = bitji_18_glyph_bitmap,
    .glyph_dsc = bitji_18_glyph_dsc,
    .cmaps = bitji_18_cmaps,
    .kern_dsc = NULL,
    .kern_scale = 0,
    .cmap_num = 3,
    .bpp = 2,
    .kern_classes = 0,
    .bitmap_format = 0,
    .cache = &bitji_18_cache
};
/*-----------------
 *  PUBLIC FONT
 *----------------*/
/*Initialize a public general font descriptor*/
const lv_font_t bitji_18 = {
    .get_glyph_dsc = lv_font_get_glyph_dsc_fmt_txt,    /*Function pointer to get glyph's data*/
    .get_glyph_bitmap = lv_font_get_bitmap_fmt_txt,    /*Function pointer to get glyph's bitmap*/
    .line_height = 19,          /*The maximum line height required by the font*/
    .base_line = 5,             /*Baseline measured from the bottom of the line*/

    .subpx = LV_FONT_SUBPX_NONE,
    .underline_position = -1,
    .underline_thickness = 1,
    .dsc = &bitji_18_font_dsc,          /*The custom font data. Will be accessed by `get_glyph_bitmap/dsc` */
};
#endif

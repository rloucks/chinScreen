/*******************************************************************************
 * Size: 20 px
 * Bpp: 2
 ******************************************************************************/


#ifdef __has_include

    #if __has_include("lvgl.h")
         #ifndef LV_LVGL_H_INCLUDE_SIMPLE
             #define LV_LVGL_H_INCLUDE_SIMPLE
         #endif
     #endif
 #endif

 #ifdef LV_LVGL_H_INCLUDE_SIMPLE
     #include "lvgl.h"
 #else
     #include "../lvgl-8.3.11/lvgl.h"
 #endif

 #ifndef COMIC_20
 #define COMIC_20 1
 #endif

 #if COMIC_20

/*-----------------
 *    BITMAPS
 *----------------*/
/*Store the image of the glyphs*/
static LV_ATTRIBUTE_LARGE_CONST const uint8_t comic_20_glyph_bitmap[] = {
    /* U+0020 " " */
    /* U+0021 "!" */
    0x2, 0x7, 0xb, 0xe, 0xe, 0x1c, 0x1c, 0x0,
    0x0, 0x34,
    /* U+0022 "\"" */
    0x0, 0xc, 0xc6, 0x62, 0x14,
    /* U+0027 "'" */
    0x3, 0x68,
    /* U+0028 "(" */
    0x0, 0x10, 0x7, 0x80, 0xb4, 0x7, 0x0, 0x30,
    0x1, 0xc0, 0xb, 0x0, 0x1d, 0x0, 0x3d, 0x0,
    0x3f, 0x0,
    /* U+0029 ")" */
    0x10, 0x0, 0xf4, 0x0, 0x74, 0x0, 0x30, 0x0,
    0x70, 0x0, 0xc0, 0x3, 0x40, 0x2c, 0x2, 0xf0,
    0x7e, 0x0,
    /* U+002B "+" */
    0x8, 0x3, 0x4b, 0xfc, 0x74, 0xc, 0x0,
    /* U+002C "," */
    0x0, 0xd7, 0x24,
    /* U+002D "-" */
    0x0, 0xb, 0xfc, 0x0, 0x0,
    /* U+002E "." */
    0x26, 0xc0, 0x0,
    /* U+002F "/" */
    0x0, 0xb, 0x0, 0x1d, 0x0, 0x38, 0x0, 0xf0,
    0x2, 0xd0, 0x7, 0x40, 0xe, 0x0, 0x2c, 0x0,
    0x70, 0x0,
    /* U+0030 "0" */
    0x0, 0xbf, 0xd0, 0x1, 0xfa, 0xff, 0x0, 0xd0,
    0x3, 0xf0, 0xe0, 0x0, 0x3c, 0x74, 0x0, 0xf,
    0x2e, 0x0, 0xb, 0x87, 0xd0, 0xb, 0xc0, 0xff,
    0xaf, 0xc0, 0x7, 0xfe, 0x40, 0x0,
    /* U+0031 "1" */
    0x1f, 0xc0, 0x3f, 0xc0, 0x3, 0xc0, 0x3, 0xc0,
    0x3, 0xc0, 0x3, 0xc0, 0x3, 0xd0, 0x2f, 0xf4,
    0xbf, 0xfd,
    /* U+0032 "2" */
    0xb, 0xf8, 0x0, 0xaa, 0xf4, 0x0, 0x2, 0xc0,
    0xbf, 0xfd, 0x7f, 0xff, 0x8b, 0xc0, 0x0, 0x78,
    0x0, 0x7, 0xea, 0xa0, 0x3f, 0xff, 0x40,
    /* U+0033 "3" */
    0x7f, 0xff, 0x46, 0x0, 0xf4, 0x0, 0x7d, 0x1,
    0xff, 0xf8, 0x29, 0x1, 0xf0, 0x0, 0x1e, 0x0,
    0xb, 0xc3, 0xff, 0xd0, 0x3f, 0x90, 0x0,
    /* U+0034 "4" */
    0x20, 0x0, 0x34, 0x6, 0x34, 0x6, 0x38, 0xa,
    0x3f, 0xfe, 0x2f, 0xfe, 0x0, 0xa, 0x0, 0xa,
    0x0, 0xa,
    /* U+0035 "5" */
    0x3f, 0xff, 0x47, 0xea, 0xa0, 0xb8, 0x0, 0x7,
    0xff, 0xf4, 0x1b, 0xff, 0xc0, 0x0, 0x2d, 0x0,
    0x3, 0xc0, 0x6b, 0xf0, 0xb, 0xf4, 0x0,
    /* U+0036 "6" */
    0x0, 0x0, 0x0, 0x0, 0x1f, 0xe0, 0x0, 0xe0,
    0xb0, 0x7, 0x0, 0x0, 0x2c, 0x0, 0x0, 0x7f,
    0xff, 0xf8, 0xbe, 0x50, 0x7d, 0x7c, 0x0, 0x2d,
    0x2f, 0xaa, 0xbc, 0x6, 0xff, 0x90,
    /* U+0037 "7" */
    0x2b, 0xff, 0xc2, 0xea, 0x7e, 0x0, 0x2, 0xd0,
    0x0, 0x3c, 0x0, 0xf, 0x0, 0x3, 0xc0, 0x1,
    0xf0, 0x0, 0xf8, 0x0, 0x3d, 0x0, 0x0,
    /* U+0038 "8" */
    0x2, 0xff, 0xe4, 0x7e, 0x5b, 0xf3, 0xc0, 0x1f,
    0x4f, 0xe7, 0xf0, 0xb, 0xea, 0xf0, 0x78, 0x2,
    0xe7, 0xe0, 0xbf, 0xf, 0xff, 0xe0, 0x0, 0x50,
    0x0,
    /* U+0039 "9" */
    0x6, 0xff, 0x90, 0x2f, 0xaa, 0xfc, 0x7c, 0x0,
    0x2d, 0x3d, 0x45, 0xbe, 0x2f, 0xff, 0xfe, 0x0,
    0x0, 0x38, 0x0, 0x0, 0xe0, 0x5, 0x7, 0x40,
    0xb, 0xf8, 0x0, 0x0, 0x0, 0x0,
    /* U+003A ":" */
    0x1, 0xd6, 0x0, 0x0, 0x9b, 0x0,
    /* U+003B ";" */
    0x1, 0xd6, 0x0, 0x0, 0x3, 0x5c, 0x90,
    /* U+003C "<" */
    0xb, 0xc0, 0xf4, 0x7, 0x40, 0x2c, 0x0, 0x70,
    0x0, 0xc0, 0x1, 0xc0, 0x2, 0xd0, 0x1, 0xe0,
    0x0, 0x40,
    /* U+003D "=" */
    0x0, 0x7, 0xfd, 0x0, 0x6, 0xa4, 0xaa, 0x80,
    /* U+003E ">" */
    0x1f, 0x80, 0xb, 0xc0, 0xb, 0x0, 0xd, 0x0,
    0x30, 0x1, 0xc0, 0xc, 0x1, 0xd0, 0x3d, 0x0,
    0x40, 0x0,
    /* U+003F "?" */
    0x1, 0xaf, 0xff, 0x9f, 0xff, 0xaf, 0xd7, 0x80,
    0x7, 0xd0, 0x0, 0x1f, 0x80, 0x0, 0x7f, 0x0,
    0x0, 0xbf, 0x80, 0x0, 0x2f, 0xf0, 0x0, 0x0,
    0x0, 0x0, 0x0, 0xf8, 0x0, 0x0,
    /* U+0041 "A" */
    0x0, 0x3d, 0x0, 0x1f, 0xf0, 0x3, 0x87, 0x80,
    0xb0, 0x7c, 0xe, 0xb, 0xc2, 0xff, 0xfc, 0x3d,
    0x57, 0xc7, 0x0, 0x1c, 0x60, 0x0, 0x0, 0x0,
    0x0,
    /* U+0042 "B" */
    0x1a, 0xff, 0xe5, 0xfe, 0x5b, 0xf3, 0x80, 0x1f,
    0x4a, 0x7, 0xf0, 0x2f, 0xff, 0xf0, 0xb5, 0x56,
    0xe2, 0xc0, 0x2f, 0xb, 0xaf, 0xe0, 0x2f, 0xe4,
    0x0,
    /* U+0043 "C" */
    0x0, 0x2f, 0xc0, 0x1e, 0x6d, 0xb, 0x0, 0x1,
    0xc0, 0x0, 0x30, 0x0, 0x7, 0x0, 0x0, 0xb0,
    0x0, 0x7, 0x95, 0x50, 0x2f, 0xfe, 0x0,
    /* U+0044 "D" */
    0x0, 0x0, 0x7, 0xff, 0xf4, 0xbe, 0xab, 0xd7,
    0x80, 0xd, 0x78, 0x0, 0xc7, 0x80, 0x28, 0x3c,
    0xb, 0x3, 0xdb, 0xc0, 0x3f, 0xe0, 0x2, 0xe0,
    0x0,
    /* U+0045 "E" */
    0x1b, 0xff, 0x9e, 0x50, 0x7, 0x0, 0x1, 0xc0,
    0x0, 0x7f, 0xff, 0xde, 0x54, 0x7, 0x0, 0x1,
    0xea, 0xaa, 0x7f, 0xfe, 0x0,
    /* U+0046 "F" */
    0x3f, 0xff, 0xdf, 0x94, 0x7, 0x80, 0x1, 0xd0,
    0x0, 0x74, 0x0, 0xf, 0xfe, 0x3, 0xe9, 0x0,
    0xe0, 0x0, 0x38, 0x0, 0x5, 0x0, 0x0,
    /* U+0047 "G" */
    0x0, 0x6f, 0xd0, 0xf, 0xa4, 0x0, 0xe0, 0x0,
    0xa, 0x0, 0x0, 0x30, 0xbf, 0xf5, 0xc0, 0x1,
    0xe7, 0x80, 0x7, 0x4f, 0xea, 0xf8, 0x7, 0xf9,
    0x0,
    /* U+0048 "H" */
    0x0, 0x8, 0x50, 0xc, 0x50, 0x1c, 0x60, 0x2d,
    0x7f, 0xfd, 0x7f, 0xfd, 0x70, 0x1d, 0x60, 0xe,
    0x60, 0x6,
    /* U+0049 "I" */
    0x1f, 0xff, 0xf, 0xff, 0x0, 0x3d, 0x0, 0xf,
    0x0, 0x3, 0xc0, 0x0, 0xf0, 0x0, 0x3d, 0x0,
    0x7f, 0xd0, 0xbf, 0xfd, 0x0,
    /* U+004A "J" */
    0x0, 0x6b, 0xe0, 0x6f, 0xf8, 0x0, 0xb, 0x40,
    0x0, 0x28, 0x0, 0x2, 0x80, 0x0, 0x24, 0x0,
    0x7, 0xa, 0x2, 0xd0, 0x7f, 0xe4, 0x0,
    /* U+004B "K" */
    0x20, 0x0, 0xd3, 0x0, 0x38, 0x30, 0x1e, 0x7,
    0x47, 0x40, 0x3f, 0xd0, 0x3, 0xfe, 0x0, 0x3f,
    0xff, 0x3, 0xd5, 0xbc, 0x34, 0x0, 0x1, 0x0,
    0x0,
    /* U+004C "L" */
    0x24, 0x0, 0x34, 0x0, 0x74, 0x0, 0x70, 0x0,
    0xb0, 0x0, 0xb0, 0x0, 0xb8, 0x0, 0xbf, 0xfd,
    0x3f, 0x90,
    /* U+004D "M" */
    0x0, 0x0, 0x24, 0x3, 0x80, 0x3c, 0xb, 0xc0,
    0xbc, 0xf, 0xd0, 0xfd, 0xd, 0xd2, 0xdd, 0x29,
    0xe7, 0x4e, 0x30, 0xff, 0xe, 0x30, 0xbd, 0xa,
    0x60, 0x38, 0x2, 0x0, 0x0, 0x0,
    /* U+004E "N" */
    0x0, 0x0, 0x44, 0x0, 0xa7, 0xc0, 0x29, 0xf8,
    0xb, 0x7f, 0x82, 0xde, 0xb8, 0xb7, 0xb, 0xfd,
    0x80, 0xbf, 0x50, 0xb, 0x94, 0x0, 0x0, 0x0,
    0x0,
    /* U+004F "O" */
    0x0, 0x6f, 0xf8, 0x0, 0xfe, 0x6f, 0xc1, 0xe0,
    0x0, 0xb4, 0xe0, 0x0, 0x1d, 0x70, 0x0, 0x7,
    0x2c, 0x0, 0x3, 0x87, 0xd0, 0x7, 0xc0, 0xbf,
    0xff, 0xc0, 0x6, 0xfe, 0x40, 0x0,
    /* U+0050 "P" */
    0x3f, 0xff, 0x87, 0xd5, 0x7c, 0x74, 0x3, 0xc7,
    0x1, 0xf4, 0x7a, 0xf8, 0x7, 0xf8, 0x0, 0x74,
    0x0, 0x6, 0x0, 0x0, 0x60, 0x0, 0x1, 0x0,
    0x0,
    /* U+0051 "Q" */
    0x0, 0x6f, 0xf9, 0x0, 0xfe, 0x9b, 0xc1, 0xe0,
    0x0, 0x74, 0xd0, 0x0, 0x9, 0x70, 0x0, 0x2,
    0x2c, 0x1, 0xc3, 0x47, 0x80, 0x7f, 0x80, 0xfe,
    0xbf, 0xe0, 0xb, 0xf8, 0x7c, 0x0, 0x0, 0x2,
    0x40,
    /* U+0052 "R" */
    0x2f, 0xff, 0xe1, 0xfa, 0xab, 0xdb, 0x80, 0xf,
    0x5e, 0x1, 0xf8, 0x78, 0x7f, 0x41, 0xff, 0xc0,
    0x3, 0xff, 0x0, 0xf, 0xff, 0x80, 0x2c, 0xb,
    0x80,
    /* U+0053 "S" */
    0x0, 0xbf, 0x40, 0x3e, 0xf4, 0xe, 0x1, 0x3,
    0xd0, 0x0, 0x7f, 0xff, 0x87, 0xff, 0xfd, 0x0,
    0x3, 0xd0, 0x16, 0xf8, 0x7, 0xf9, 0x0,
    /* U+0054 "T" */
    0x1a, 0xff, 0xd6, 0xaf, 0xe4, 0x0, 0xe0, 0x0,
    0xe, 0x0, 0x0, 0xe0, 0x0, 0xa, 0x0, 0x0,
    0xa0, 0x0, 0x6, 0x0, 0x0, 0x20, 0x0,
    /* U+0055 "U" */
    0x0, 0xa, 0x20, 0xa, 0x30, 0xa, 0x70, 0xb,
    0x70, 0xb, 0x74, 0xb, 0x74, 0xf, 0x7d, 0xfd,
    0x3f, 0xe0,
    /* U+0056 "V" */
    0x0, 0x2, 0x50, 0xd, 0x70, 0x18, 0x34, 0x30,
    0x2c, 0x60, 0xe, 0xd0, 0xb, 0xc0, 0x3, 0xc0,
    0x2, 0x80,
    /* U+0057 "W" */
    0x0, 0x2c, 0x8, 0xb0, 0x3e, 0xc, 0x74, 0x7f,
    0x1c, 0x78, 0x97, 0x6c, 0x3c, 0xc3, 0xf8, 0x2f,
    0xc2, 0xf4, 0x1f, 0x80, 0xf4, 0xf, 0x40, 0x70,
    0x3, 0x0, 0x0,
    /* U+0058 "X" */
    0x0, 0x0, 0x1c, 0x3, 0x3, 0xd3, 0x40, 0x7f,
    0x80, 0xb, 0xe0, 0x1, 0xfd, 0x0, 0xfb, 0xd0,
    0x74, 0x2d, 0x3c, 0x0, 0x4c, 0x0, 0x0,
    /* U+0059 "Y" */
    0x90, 0xd, 0xd0, 0xf3, 0xef, 0x43, 0xf8, 0xb,
    0xc0, 0x2e, 0x0, 0xb0, 0x3, 0x80, 0xc, 0x0,
    /* U+005A "Z" */
    0xaf, 0xff, 0x80, 0x0, 0xfd, 0x0, 0x7, 0xd0,
    0x0, 0x7d, 0x0, 0x3, 0xd0, 0x0, 0x3f, 0x0,
    0x2, 0xf8, 0x0, 0xf, 0xff, 0xfc, 0x29, 0x55,
    0x40,
    /* U+005B "[" */
    0x0, 0x10, 0x7, 0x80, 0xb4, 0x7, 0x0, 0x30,
    0x1, 0xc0, 0xb, 0x0, 0x1d, 0x0, 0x3d, 0x0,
    0x3f, 0x0,
    /* U+005C "\\" */
    0x70, 0x0, 0x38, 0x0, 0x1d, 0x0, 0xb, 0x0,
    0x3, 0xc0, 0x0, 0xe0, 0x0, 0x74, 0x0, 0x2c,
    0x0, 0xa,
    /* U+005D "]" */
    0x10, 0x0, 0xf4, 0x0, 0x74, 0x0, 0x30, 0x0,
    0x70, 0x0, 0xc0, 0x3, 0x40, 0x2c, 0x2, 0xf0,
    0x7e, 0x0,
    /* U+005F "_" */
    0xff, 0xfd,
    /* U+0061 "a" */
    0x2, 0xd0, 0x1, 0xfc, 0x0, 0xfb, 0x80, 0x70,
    0xf0, 0x3c, 0x2d, 0xf, 0xff, 0xc7, 0x41, 0xf2,
    0x40, 0x1d, 0x80, 0x2, 0x80,
    /* U+0062 "b" */
    0x0, 0x0, 0x7, 0xff, 0xf4, 0xb8, 0xf, 0x4b,
    0x87, 0xd0, 0x7f, 0xff, 0x87, 0xe0, 0x2f, 0x74,
    0x2, 0xe3, 0x41, 0xbc, 0x3f, 0xfd, 0x3, 0xf9,
    0x0,
    /* U+0063 "c" */
    0x1, 0xfc, 0xb, 0xfc, 0x1d, 0x24, 0x38, 0x0,
    0x70, 0x0, 0x60, 0x0, 0xa0, 0x0, 0x7a, 0xbc,
    0x3f, 0xf0,
    /* U+0064 "d" */
    0x3f, 0xff, 0xf6, 0xf5, 0x57, 0xdb, 0x40, 0xb,
    0x6d, 0x0, 0x3c, 0xb4, 0x2, 0xc2, 0xd0, 0x1c,
    0x7, 0x82, 0xc0, 0xf, 0xb8, 0x0, 0x2f, 0x40,
    0x0,
    /* U+0065 "e" */
    0x1b, 0xfe, 0x1f, 0x80, 0x7, 0x0, 0x1, 0xc0,
    0x14, 0x7f, 0xe5, 0x1e, 0x40, 0x7, 0x0, 0x51,
    0xff, 0xf8, 0x7e, 0x90, 0x0,
    /* U+0066 "f" */
    0x7f, 0xfd, 0x7a, 0xa8, 0x70, 0x0, 0x70, 0x0,
    0x70, 0x0, 0x7f, 0xe0, 0x7d, 0x40, 0x70, 0x0,
    0x60, 0x0,
    /* U+0067 "g" */
    0x1, 0xbf, 0x40, 0x74, 0x0, 0x1c, 0x0, 0x3,
    0x42, 0xa8, 0x70, 0xff, 0xeb, 0x0, 0xe, 0x78,
    0x2, 0xd3, 0xff, 0xf8, 0xb, 0xf8, 0x0,
    /* U+0068 "h" */
    0x0, 0x0, 0x18, 0x0, 0xc6, 0x0, 0x71, 0xc0,
    0x1c, 0x70, 0xf, 0x5f, 0xff, 0xd7, 0x95, 0xf5,
    0xc0, 0x2d, 0x60, 0x7, 0x94, 0x0, 0xa0,
    /* U+0069 "i" */
    0x16, 0x6a, 0xaa, 0xaa, 0x60,
    /* U+006A "j" */
    0x1, 0xbf, 0xc0, 0x7f, 0xd0, 0x0, 0xc, 0x0,
    0x0, 0xc0, 0x0, 0xc, 0x0, 0x0, 0xc0, 0x0,
    0xc, 0xa, 0x43, 0x80, 0x3f, 0xf0, 0x0,
    /* U+006B "k" */
    0x20, 0x0, 0x71, 0xc0, 0xb, 0x43, 0x0, 0xe0,
    0xd, 0x2c, 0x0, 0x3f, 0xd0, 0x0, 0xff, 0x80,
    0x2, 0xef, 0xf4, 0x9, 0x2, 0xf0, 0x24, 0x0,
    0x0,
    /* U+006C "l" */
    0x18, 0x0, 0x60, 0x1, 0x80, 0xa, 0x0, 0x28,
    0x0, 0xe0, 0x3, 0x80, 0xf, 0xaa, 0x7f, 0xf8,
    0x0, 0x0,
    /* U+006D "m" */
    0x0, 0x0, 0x0, 0x0, 0x0, 0x20, 0xb, 0x0,
    0xf0, 0xf, 0x81, 0xf0, 0x2f, 0xc3, 0xf4, 0x3d,
    0xe7, 0xfc, 0x34, 0xff, 0x3c, 0x34, 0xfc, 0x2d,
    0x70, 0x78, 0xe, 0x60, 0x38, 0x6,
    /* U+006E "n" */
    0x0, 0x2, 0x50, 0x3, 0x74, 0x3, 0x7d, 0x3,
    0x7f, 0x43, 0x5b, 0xc3, 0x42, 0xfb, 0x40, 0x7f,
    0x40, 0xb,
    /* U+006F "o" */
    0x0, 0xbf, 0x80, 0x7, 0xff, 0xf0, 0x1e, 0x0,
    0xbc, 0x34, 0x0, 0x2c, 0x70, 0x0, 0x2c, 0xb0,
    0x0, 0x38, 0xb8, 0x2, 0xf0, 0x7f, 0xff, 0xd0,
    0x2f, 0xfe, 0x0,
    /* U+0070 "p" */
    0x2f, 0xff, 0x1f, 0x56, 0xe7, 0x40, 0x75, 0xd0,
    0xbc, 0x7a, 0xfc, 0x1f, 0xe0, 0x3, 0xc0, 0x0,
    0xd0, 0x0, 0x30, 0x0, 0x0,
    /* U+0071 "q" */
    0x0, 0xbf, 0xe0, 0x7, 0xe5, 0xbc, 0x1d, 0x0,
    0x2c, 0x34, 0x0, 0x1c, 0x70, 0x3, 0x7c, 0xb0,
    0x3, 0xf4, 0x79, 0x7, 0xf0, 0x3f, 0xff, 0xf4,
    0xf, 0xf8, 0x2c, 0x0, 0x0, 0x4,
    /* U+0072 "r" */
    0x2f, 0xff, 0xf2, 0xea, 0xab, 0xeb, 0x0, 0xb,
    0x6c, 0x0, 0xf8, 0xb4, 0x7e, 0x2, 0xff, 0xd0,
    0xb, 0xff, 0xc0, 0x1f, 0x1f, 0xd0, 0x38, 0x5,
    0x0,
    /* U+0073 "s" */
    0x0, 0x6f, 0xc0, 0x3a, 0x50, 0x1c, 0x0, 0x7,
    0xea, 0xa4, 0x7f, 0xff, 0xd0, 0x0, 0x3e, 0x0,
    0x3, 0xc0, 0x1, 0xf4, 0xf, 0xf4, 0x0,
    /* U+0074 "t" */
    0x6b, 0xfe, 0x1b, 0xfa, 0x80, 0xc, 0x0, 0x3,
    0x0, 0x0, 0xc0, 0x0, 0x30, 0x0, 0xc, 0x0,
    0x3, 0x0, 0x0, 0xc0, 0x0,
    /* U+0075 "u" */
    0x0, 0x0, 0x1, 0x0, 0x30, 0x30, 0x3, 0x43,
    0x0, 0x78, 0x70, 0x7, 0xc7, 0x0, 0x7c, 0xb0,
    0xb, 0xcb, 0x7, 0xf8, 0xbf, 0xfd, 0xb, 0xe4,
    0x0,
    /* U+0076 "v" */
    0x34, 0x0, 0xc3, 0xc0, 0x1c, 0x2e, 0x3, 0xc0,
    0xf0, 0x78, 0xb, 0x8f, 0x0, 0x3f, 0xe0, 0x0,
    0xfc, 0x0, 0x7, 0x40, 0x0, 0x10, 0x0,
    /* U+0077 "w" */
    0x0, 0x28, 0x0, 0xc9, 0x3, 0xd0, 0x28, 0xa0,
    0x6f, 0x3, 0x47, 0x9, 0x34, 0x70, 0x74, 0xc3,
    0xce, 0x3, 0xfc, 0x1f, 0xd0, 0x2f, 0x80, 0xfc,
    0x1, 0xf4, 0xb, 0xc0, 0xf, 0x0, 0x38, 0x0,
    0x0, 0x0, 0x0,
    /* U+0078 "x" */
    0x10, 0x8, 0x1e, 0xa, 0x2, 0xfb, 0x0, 0x2f,
    0x80, 0x7, 0xf0, 0x2, 0xef, 0x0, 0xe0, 0xf0,
    0xf0, 0x9, 0x30, 0x0, 0x0,
    /* U+0079 "y" */
    0x0, 0x0, 0x10, 0x0, 0xd7, 0x40, 0x70, 0xf4,
    0x34, 0xf, 0xfc, 0x0, 0xfd, 0x0, 0xf, 0x0,
    0x3, 0x80, 0x0, 0xd0, 0x0, 0x30, 0x0,
    /* U+007A "z" */
    0xaf, 0xff, 0x40, 0x0, 0xfd, 0x0, 0x7, 0xd0,
    0x0, 0x3d, 0x0, 0x3, 0xd0, 0x0, 0x3f, 0x0,
    0x2, 0xf8, 0x0, 0xf, 0xff, 0xfc, 0x2d, 0x55,
    0x40,
    /* U+007B "{" */
    0xb, 0xc0, 0xf4, 0x7, 0x40, 0x2c, 0x0, 0x70,
    0x0, 0xc0, 0x1, 0xc0, 0x2, 0xd0, 0x1, 0xe0,
    0x0, 0x40,
    /* U+007C "|" */
    0x4, 0x44, 0x44, 0x44, 0x44, 0x44, 0x0,
    /* U+007D "}" */
    0x1f, 0x80, 0xb, 0xc0, 0xb, 0x0, 0xd, 0x0,
    0x30, 0x1, 0xc0, 0xc, 0x1, 0xd0, 0x3d, 0x0,
    0x40, 0x0
};
/*---------------------
 *  GLYPH DESCRIPTION
 *--------------------*/
static const lv_font_fmt_txt_glyph_dsc_t comic_20_glyph_dsc[] = {
    {.bitmap_index = 0, .adv_w = 0, .box_w = 0, .box_h = 0, .ofs_x = 0, .ofs_y = 0} /* id = 0 reserved */,
    {.bitmap_index = 0, .adv_w = 134, .box_w = 0, .box_h = 0, .ofs_x = 0, .ofs_y = 0},
    {.bitmap_index = 0, .adv_w = 75, .box_w = 4, .box_h = 10, .ofs_x = 0, .ofs_y = 0},
    {.bitmap_index = 10, .adv_w = 77, .box_w = 5, .box_h = 4, .ofs_x = 0, .ofs_y = 6},
    {.bitmap_index = 15, .adv_w = 43, .box_w = 2, .box_h = 4, .ofs_x = 0, .ofs_y = 6},
    {.bitmap_index = 17, .adv_w = 114, .box_w = 7, .box_h = 10, .ofs_x = 0, .ofs_y = 0},
    {.bitmap_index = 35, .adv_w = 114, .box_w = 7, .box_h = 10, .ofs_x = 0, .ofs_y = 0},
    {.bitmap_index = 53, .adv_w = 90, .box_w = 5, .box_h = 5, .ofs_x = 0, .ofs_y = 2},
    {.bitmap_index = 60, .adv_w = 51, .box_w = 3, .box_h = 4, .ofs_x = 0, .ofs_y = -2},
    {.bitmap_index = 63, .adv_w = 94, .box_w = 6, .box_h = 3, .ofs_x = 0, .ofs_y = 2},
    {.bitmap_index = 68, .adv_w = 51, .box_w = 3, .box_h = 3, .ofs_x = 0, .ofs_y = -1},
    {.bitmap_index = 71, .adv_w = 139, .box_w = 8, .box_h = 9, .ofs_x = 0, .ofs_y = 0},
    {.bitmap_index = 89, .adv_w = 205, .box_w = 13, .box_h = 9, .ofs_x = 0, .ofs_y = 0},
    {.bitmap_index = 119, .adv_w = 133, .box_w = 8, .box_h = 9, .ofs_x = 0, .ofs_y = 0},
    {.bitmap_index = 137, .adv_w = 162, .box_w = 10, .box_h = 9, .ofs_x = 0, .ofs_y = 0},
    {.bitmap_index = 160, .adv_w = 173, .box_w = 10, .box_h = 9, .ofs_x = 0, .ofs_y = 0},
    {.bitmap_index = 183, .adv_w = 133, .box_w = 8, .box_h = 9, .ofs_x = 0, .ofs_y = 0},
    {.bitmap_index = 201, .adv_w = 162, .box_w = 10, .box_h = 9, .ofs_x = 0, .ofs_y = 0},
    {.bitmap_index = 224, .adv_w = 197, .box_w = 12, .box_h = 10, .ofs_x = 0, .ofs_y = 0},
    {.bitmap_index = 254, .adv_w = 165, .box_w = 10, .box_h = 9, .ofs_x = 0, .ofs_y = 0},
    {.bitmap_index = 277, .adv_w = 189, .box_w = 11, .box_h = 9, .ofs_x = 0, .ofs_y = 0},
    {.bitmap_index = 302, .adv_w = 197, .box_w = 12, .box_h = 10, .ofs_x = 0, .ofs_y = -1},
    {.bitmap_index = 332, .adv_w = 51, .box_w = 3, .box_h = 8, .ofs_x = 0, .ofs_y = -1},
    {.bitmap_index = 338, .adv_w = 53, .box_w = 3, .box_h = 9, .ofs_x = 0, .ofs_y = -2},
    {.bitmap_index = 345, .adv_w = 114, .box_w = 7, .box_h = 10, .ofs_x = 0, .ofs_y = -1},
    {.bitmap_index = 363, .adv_w = 96, .box_w = 6, .box_h = 5, .ofs_x = 0, .ofs_y = 2},
    {.bitmap_index = 371, .adv_w = 114, .box_w = 7, .box_h = 10, .ofs_x = 0, .ofs_y = -1},
    {.bitmap_index = 389, .adv_w = 216, .box_w = 13, .box_h = 9, .ofs_x = 0, .ofs_y = 0},
    {.bitmap_index = 419, .adv_w = 157, .box_w = 10, .box_h = 10, .ofs_x = 0, .ofs_y = -1},
    {.bitmap_index = 444, .adv_w = 187, .box_w = 11, .box_h = 9, .ofs_x = 0, .ofs_y = 0},
    {.bitmap_index = 469, .adv_w = 163, .box_w = 10, .box_h = 9, .ofs_x = 0, .ofs_y = 0},
    {.bitmap_index = 492, .adv_w = 165, .box_w = 10, .box_h = 10, .ofs_x = 0, .ofs_y = 0},
    {.bitmap_index = 517, .adv_w = 155, .box_w = 9, .box_h = 9, .ofs_x = 0, .ofs_y = 0},
    {.bitmap_index = 538, .adv_w = 155, .box_w = 9, .box_h = 10, .ofs_x = 0, .ofs_y = -1},
    {.bitmap_index = 561, .adv_w = 179, .box_w = 11, .box_h = 9, .ofs_x = 0, .ofs_y = 0},
    {.bitmap_index = 586, .adv_w = 133, .box_w = 8, .box_h = 9, .ofs_x = 0, .ofs_y = 0},
    {.bitmap_index = 604, .adv_w = 141, .box_w = 9, .box_h = 9, .ofs_x = 0, .ofs_y = 0},
    {.bitmap_index = 625, .adv_w = 166, .box_w = 10, .box_h = 9, .ofs_x = 0, .ofs_y = 0},
    {.bitmap_index = 648, .adv_w = 162, .box_w = 10, .box_h = 10, .ofs_x = 0, .ofs_y = -1},
    {.bitmap_index = 673, .adv_w = 133, .box_w = 8, .box_h = 9, .ofs_x = 0, .ofs_y = 0},
    {.bitmap_index = 691, .adv_w = 197, .box_w = 12, .box_h = 10, .ofs_x = 0, .ofs_y = -1},
    {.bitmap_index = 721, .adv_w = 155, .box_w = 9, .box_h = 11, .ofs_x = 0, .ofs_y = -1},
    {.bitmap_index = 746, .adv_w = 211, .box_w = 13, .box_h = 9, .ofs_x = 0, .ofs_y = 0},
    {.bitmap_index = 776, .adv_w = 157, .box_w = 10, .box_h = 10, .ofs_x = 0, .ofs_y = -1},
    {.bitmap_index = 801, .adv_w = 213, .box_w = 13, .box_h = 10, .ofs_x = 0, .ofs_y = -1},
    {.bitmap_index = 834, .adv_w = 181, .box_w = 11, .box_h = 9, .ofs_x = 0, .ofs_y = 0},
    {.bitmap_index = 859, .adv_w = 165, .box_w = 10, .box_h = 9, .ofs_x = 0, .ofs_y = 0},
    {.bitmap_index = 882, .adv_w = 165, .box_w = 10, .box_h = 9, .ofs_x = 0, .ofs_y = 0},
    {.bitmap_index = 905, .adv_w = 139, .box_w = 8, .box_h = 9, .ofs_x = 0, .ofs_y = 0},
    {.bitmap_index = 923, .adv_w = 136, .box_w = 8, .box_h = 9, .ofs_x = 0, .ofs_y = 0},
    {.bitmap_index = 941, .adv_w = 189, .box_w = 12, .box_h = 9, .ofs_x = 0, .ofs_y = 0},
    {.bitmap_index = 968, .adv_w = 149, .box_w = 9, .box_h = 10, .ofs_x = 0, .ofs_y = 0},
    {.bitmap_index = 991, .adv_w = 123, .box_w = 7, .box_h = 9, .ofs_x = 0, .ofs_y = 0},
    {.bitmap_index = 1007, .adv_w = 174, .box_w = 11, .box_h = 9, .ofs_x = 0, .ofs_y = 0},
    {.bitmap_index = 1032, .adv_w = 114, .box_w = 7, .box_h = 10, .ofs_x = 0, .ofs_y = 0},
    {.bitmap_index = 1050, .adv_w = 141, .box_w = 8, .box_h = 9, .ofs_x = 0, .ofs_y = 0},
    {.bitmap_index = 1068, .adv_w = 114, .box_w = 7, .box_h = 10, .ofs_x = 0, .ofs_y = 0},
    {.bitmap_index = 1086, .adv_w = 120, .box_w = 8, .box_h = 1, .ofs_x = 0, .ofs_y = -1},
    {.bitmap_index = 1088, .adv_w = 149, .box_w = 9, .box_h = 9, .ofs_x = 0, .ofs_y = 0},
    {.bitmap_index = 1109, .adv_w = 171, .box_w = 10, .box_h = 10, .ofs_x = 0, .ofs_y = 0},
    {.bitmap_index = 1134, .adv_w = 125, .box_w = 8, .box_h = 9, .ofs_x = 0, .ofs_y = 0},
    {.bitmap_index = 1152, .adv_w = 179, .box_w = 11, .box_h = 9, .ofs_x = 0, .ofs_y = 0},
    {.bitmap_index = 1177, .adv_w = 147, .box_w = 9, .box_h = 9, .ofs_x = 0, .ofs_y = 0},
    {.bitmap_index = 1198, .adv_w = 130, .box_w = 8, .box_h = 9, .ofs_x = 0, .ofs_y = 0},
    {.bitmap_index = 1216, .adv_w = 166, .box_w = 10, .box_h = 9, .ofs_x = 0, .ofs_y = 0},
    {.bitmap_index = 1239, .adv_w = 149, .box_w = 9, .box_h = 10, .ofs_x = 0, .ofs_y = 0},
    {.bitmap_index = 1262, .adv_w = 40, .box_w = 2, .box_h = 9, .ofs_x = 0, .ofs_y = 0},
    {.bitmap_index = 1267, .adv_w = 157, .box_w = 10, .box_h = 9, .ofs_x = 0, .ofs_y = 0},
    {.bitmap_index = 1290, .adv_w = 171, .box_w = 11, .box_h = 9, .ofs_x = 0, .ofs_y = 0},
    {.bitmap_index = 1315, .adv_w = 123, .box_w = 7, .box_h = 10, .ofs_x = 0, .ofs_y = -1},
    {.bitmap_index = 1333, .adv_w = 198, .box_w = 12, .box_h = 10, .ofs_x = 0, .ofs_y = 0},
    {.bitmap_index = 1363, .adv_w = 139, .box_w = 8, .box_h = 9, .ofs_x = 0, .ofs_y = 0},
    {.bitmap_index = 1381, .adv_w = 187, .box_w = 12, .box_h = 9, .ofs_x = 0, .ofs_y = 0},
    {.bitmap_index = 1408, .adv_w = 147, .box_w = 9, .box_h = 9, .ofs_x = 0, .ofs_y = 0},
    {.bitmap_index = 1429, .adv_w = 189, .box_w = 12, .box_h = 10, .ofs_x = 0, .ofs_y = -1},
    {.bitmap_index = 1459, .adv_w = 181, .box_w = 11, .box_h = 9, .ofs_x = 0, .ofs_y = 0},
    {.bitmap_index = 1484, .adv_w = 165, .box_w = 10, .box_h = 9, .ofs_x = 0, .ofs_y = 0},
    {.bitmap_index = 1507, .adv_w = 139, .box_w = 9, .box_h = 9, .ofs_x = 0, .ofs_y = 0},
    {.bitmap_index = 1528, .adv_w = 155, .box_w = 10, .box_h = 10, .ofs_x = 0, .ofs_y = 0},
    {.bitmap_index = 1553, .adv_w = 142, .box_w = 10, .box_h = 9, .ofs_x = -1, .ofs_y = 0},
    {.bitmap_index = 1576, .adv_w = 219, .box_w = 14, .box_h = 10, .ofs_x = 0, .ofs_y = -1},
    {.bitmap_index = 1611, .adv_w = 149, .box_w = 9, .box_h = 9, .ofs_x = 0, .ofs_y = 0},
    {.bitmap_index = 1632, .adv_w = 146, .box_w = 9, .box_h = 10, .ofs_x = 0, .ofs_y = 0},
    {.bitmap_index = 1655, .adv_w = 174, .box_w = 11, .box_h = 9, .ofs_x = 0, .ofs_y = 0},
    {.bitmap_index = 1680, .adv_w = 114, .box_w = 7, .box_h = 10, .ofs_x = 0, .ofs_y = -1},
    {.bitmap_index = 1698, .adv_w = 32, .box_w = 2, .box_h = 13, .ofs_x = 0, .ofs_y = -2},
    {.bitmap_index = 1705, .adv_w = 114, .box_w = 7, .box_h = 10, .ofs_x = 0, .ofs_y = -1}
};
/*---------------------
 *  CHARACTER MAPPING
 *--------------------*/
static const uint8_t glyph_id_ofs_list_0[] = {
    0, 1, 2, 0, 0, 0, 0, 3,
    4, 5
};
/*Collect the unicode lists and glyph_id offsets*/
static const lv_font_fmt_txt_cmap_t comic_20_cmaps[] =
{
    {
        .range_start = 32, .range_length = 10, .glyph_id_start = 1,
        .unicode_list = NULL, .glyph_id_ofs_list = glyph_id_ofs_list_0, .list_length = 10, .type = LV_FONT_FMT_TXT_CMAP_FORMAT0_FULL
    },
    {
        .range_start = 43, .range_length = 21, .glyph_id_start = 7,
        .unicode_list = NULL, .glyph_id_ofs_list = NULL, .list_length = 0, .type = LV_FONT_FMT_TXT_CMAP_FORMAT0_TINY
    },
    {
        .range_start = 65, .range_length = 29, .glyph_id_start = 28,
        .unicode_list = NULL, .glyph_id_ofs_list = NULL, .list_length = 0, .type = LV_FONT_FMT_TXT_CMAP_FORMAT0_TINY
    },
    {
        .range_start = 95, .range_length = 1, .glyph_id_start = 57,
        .unicode_list = NULL, .glyph_id_ofs_list = NULL, .list_length = 0, .type = LV_FONT_FMT_TXT_CMAP_FORMAT0_TINY
    },
    {
        .range_start = 97, .range_length = 29, .glyph_id_start = 58,
        .unicode_list = NULL, .glyph_id_ofs_list = NULL, .list_length = 0, .type = LV_FONT_FMT_TXT_CMAP_FORMAT0_TINY
    }
};
/*--------------------
 *  ALL CUSTOM DATA
 *--------------------*/
/*Store all the custom data of the font*/
static lv_font_fmt_txt_glyph_cache_t comic_20_cache;
static const lv_font_fmt_txt_dsc_t comic_20_font_dsc = {
    .glyph_bitmap = comic_20_glyph_bitmap,
    .glyph_dsc = comic_20_glyph_dsc,
    .cmaps = comic_20_cmaps,
    .kern_dsc = NULL,
    .kern_scale = 0,
    .cmap_num = 5,
    .bpp = 2,
    .kern_classes = 0,
    .bitmap_format = 0,
    .cache = &comic_20_cache
};
/*-----------------
 *  PUBLIC FONT
 *----------------*/
/*Initialize a public general font descriptor*/
const lv_font_t comic_20 = {
    .get_glyph_dsc = lv_font_get_glyph_dsc_fmt_txt,    /*Function pointer to get glyph's data*/
    .get_glyph_bitmap = lv_font_get_bitmap_fmt_txt,    /*Function pointer to get glyph's bitmap*/
    .line_height = 13,          /*The maximum line height required by the font*/
    .base_line = 2,             /*Baseline measured from the bottom of the line*/

    .subpx = LV_FONT_SUBPX_NONE,
    .underline_position = -1,
    .underline_thickness = 1,
    .dsc = &comic_20_font_dsc,          /*The custom font data. Will be accessed by `get_glyph_bitmap/dsc` */
};
#endif

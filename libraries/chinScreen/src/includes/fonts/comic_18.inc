/*******************************************************************************
 * Size: 18 px
 * Bpp: 2
 ******************************************************************************/


#ifdef __has_include

    #if __has_include("lvgl.h")
         #ifndef LV_LVGL_H_INCLUDE_SIMPLE
             #define LV_LVGL_H_INCLUDE_SIMPLE
         #endif
     #endif
 #endif

 #ifdef LV_LVGL_H_INCLUDE_SIMPLE
     #include "lvgl.h"
 #else
     #include "../lvgl-8.3.11/lvgl.h"
 #endif

 #ifndef COMIC_18
 #define COMIC_18 1
 #endif

 #if COMIC_18

/*-----------------
 *    BITMAPS
 *----------------*/
/*Store the image of the glyphs*/
static LV_ATTRIBUTE_LARGE_CONST const uint8_t comic_18_glyph_bitmap[] = {
    /* U+0020 " " */
    /* U+0021 "!" */
    0x1, 0xa, 0xd, 0xd, 0x1c, 0x1c, 0x18, 0x0,
    0x0, 0x30,
    /* U+0022 "\"" */
    0x0, 0x22, 0x99, 0x88,
    /* U+0027 "'" */
    0x2, 0x98,
    /* U+0028 "(" */
    0x0, 0x0, 0x2d, 0xe, 0x2, 0x80, 0x30, 0x6,
    0x0, 0xa0, 0x7, 0x0, 0x3d, 0x1, 0xf8,
    /* U+0029 ")" */
    0x10, 0x3, 0xc0, 0xb, 0x0, 0x18, 0x0, 0x80,
    0x6, 0x0, 0xa0, 0xe, 0x7, 0xd1, 0xf4,
    /* U+002B "+" */
    0x8, 0x7, 0xf, 0xf4, 0x74, 0x8, 0x0,
    /* U+002C "," */
    0x10, 0xc6, 0x24,
    /* U+002D "-" */
    0x0, 0x2f, 0xd0, 0x0,
    /* U+002E "." */
    0x22, 0xc0, 0x0,
    /* U+002F "/" */
    0x0, 0xc, 0x0, 0x38, 0x0, 0x70, 0x0, 0xd0,
    0x3, 0x80, 0xb, 0x0, 0x1c, 0x0, 0x38, 0x0,
    0x70, 0x0,
    /* U+0030 "0" */
    0x1, 0xbf, 0x80, 0x2e, 0xaf, 0xc1, 0xc0, 0xf,
    0x8d, 0x0, 0xf, 0x70, 0x0, 0x3e, 0xd0, 0x2,
    0xd7, 0xc0, 0x2f, 0xf, 0xfb, 0xf0, 0xb, 0xfd,
    0x0,
    /* U+0031 "1" */
    0x2f, 0x40, 0xfd, 0x0, 0x74, 0x1, 0xd0, 0x7,
    0x40, 0x1e, 0x0, 0x7c, 0xb, 0xf8, 0xbf, 0xf8,
    /* U+0032 "2" */
    0xb, 0xe0, 0x2, 0xaf, 0x40, 0x0, 0x70, 0x6f,
    0xfd, 0x7f, 0xfe, 0x2e, 0x0, 0x7, 0x40, 0x1,
    0xfa, 0xa0, 0x7f, 0xfe, 0x0,
    /* U+0033 "3" */
    0x7f, 0xfd, 0x18, 0xb, 0x80, 0xb, 0x80, 0xbf,
    0xf8, 0x29, 0x3, 0xc0, 0x0, 0xf0, 0x1, 0xf1,
    0xff, 0xe0, 0x3f, 0x80, 0x0,
    /* U+0034 "4" */
    0x10, 0x0, 0xc0, 0x33, 0x0, 0xdd, 0x7, 0x7f,
    0xfc, 0xbf, 0xf0, 0x1, 0xc0, 0x7, 0x0, 0x1c,
    /* U+0035 "5" */
    0x7f, 0xfe, 0x1f, 0xaa, 0xb, 0x40, 0x1, 0xff,
    0xf8, 0x1f, 0xff, 0x0, 0x1, 0xd0, 0x0, 0xf0,
    0x2a, 0xf0, 0xb, 0xe0, 0x0,
    /* U+0036 "6" */
    0x0, 0x0, 0x0, 0x0, 0xbe, 0x0, 0x2d, 0x1c,
    0x2, 0x80, 0x0, 0x28, 0x0, 0x1, 0xff, 0xff,
    0x8b, 0xe4, 0x1f, 0x1e, 0x0, 0x2d, 0x3f, 0xaa,
    0xf0, 0x1f, 0xf9, 0x0,
    /* U+0037 "7" */
    0x2f, 0xff, 0xb, 0xa6, 0xe0, 0x0, 0x74, 0x0,
    0x2c, 0x0, 0x2d, 0x0, 0x2d, 0x0, 0x3d, 0x0,
    0x7c, 0x0, 0x78, 0x0, 0x0,
    /* U+0038 "8" */
    0x2, 0xff, 0x81, 0xf9, 0x7f, 0x38, 0x3, 0xd3,
    0xe6, 0xf0, 0xf, 0xab, 0xc2, 0xd0, 0x2d, 0x7d,
    0x1b, 0xc7, 0xff, 0xe0, 0x1, 0x50, 0x0,
    /* U+0039 "9" */
    0x6, 0xff, 0x40, 0xfa, 0xaf, 0x87, 0x80, 0xb,
    0x5e, 0x41, 0xbe, 0x2f, 0xff, 0xf4, 0x0, 0x3,
    0x80, 0x0, 0x28, 0x1, 0x3, 0x80, 0xf, 0xf4,
    0x0, 0x0, 0x0, 0x0,
    /* U+003A ":" */
    0x1, 0xc9, 0x0, 0x0, 0x8b, 0x0,
    /* U+003B ";" */
    0x1, 0xc9, 0x0, 0x0, 0x43, 0x18, 0x90,
    /* U+003C "<" */
    0x1f, 0x83, 0xd0, 0x70, 0xa, 0x0, 0x60, 0x3,
    0x0, 0x28, 0x0, 0xe0, 0x2, 0xd0, 0x0,
    /* U+003D "=" */
    0x0, 0x2f, 0xf0, 0x1, 0xa8, 0xaa, 0x40,
    /* U+003E ">" */
    0x1f, 0x40, 0x7d, 0x0, 0xe0, 0xa, 0x0, 0x60,
    0x8, 0x1, 0x80, 0xb0, 0x3c, 0x1, 0x0,
    /* U+003F "?" */
    0x5, 0xaf, 0xfd, 0x7f, 0xfe, 0xfc, 0x74, 0x0,
    0xf4, 0x0, 0xb, 0x80, 0x0, 0xbc, 0x0, 0x3,
    0xfc, 0x0, 0x3, 0xfc, 0x0, 0x0, 0x0, 0x0,
    0x2, 0xf0, 0x0,
    /* U+0041 "A" */
    0x0, 0xb8, 0x0, 0xbf, 0x40, 0x74, 0xe0, 0x38,
    0x3c, 0x1d, 0x1f, 0xf, 0xff, 0xc7, 0x95, 0xb2,
    0xc0, 0xc, 0x90, 0x0, 0x0, 0x0, 0x0,
    /* U+0042 "B" */
    0x1b, 0xff, 0x97, 0xe9, 0xbf, 0x34, 0x3, 0xd3,
    0x46, 0xf0, 0x3f, 0xff, 0xc3, 0xd5, 0x6d, 0x3c,
    0x7, 0xc3, 0xeb, 0xf0, 0x2f, 0xe0, 0x0,
    /* U+0043 "C" */
    0x0, 0x7f, 0x0, 0xba, 0xd0, 0xe0, 0x0, 0xa0,
    0x0, 0x30, 0x0, 0x1c, 0x0, 0xb, 0x0, 0x1,
    0xe5, 0x50, 0x3f, 0xfc, 0x0,
    /* U+0044 "D" */
    0x0, 0x0, 0x1f, 0xff, 0x4b, 0xea, 0xf6, 0xd0,
    0xe, 0x74, 0x3, 0x1d, 0x1, 0x87, 0x81, 0xc0,
    0xf6, 0xc0, 0x3f, 0xc0, 0xb, 0x40, 0x0,
    /* U+0045 "E" */
    0x2b, 0xfe, 0x2e, 0x50, 0xb, 0x0, 0x2, 0xc0,
    0x0, 0xbf, 0xff, 0x2e, 0x50, 0xb, 0x0, 0x2,
    0xea, 0xa8, 0xbf, 0xfd, 0x0,
    /* U+0046 "F" */
    0x3f, 0xff, 0x2f, 0x90, 0x7, 0x40, 0x1, 0xc0,
    0x0, 0x70, 0x0, 0x1f, 0xfc, 0x3, 0xe8, 0x0,
    0xd0, 0x0, 0x34, 0x0, 0x5, 0x0, 0x0,
    /* U+0047 "G" */
    0x0, 0xbf, 0x40, 0x7e, 0x40, 0xd, 0x0, 0x3,
    0x40, 0x0, 0x71, 0xff, 0xd7, 0x0, 0xd, 0x74,
    0x1, 0xd3, 0xea, 0xf8, 0xb, 0xf8, 0x0,
    /* U+0048 "H" */
    0x0, 0x15, 0x40, 0x99, 0x3, 0xa8, 0xe, 0xbf,
    0xfa, 0xff, 0xea, 0x3, 0xe8, 0xb, 0xa0, 0x8,
    /* U+0049 "I" */
    0x1f, 0xfc, 0x3f, 0xf4, 0x7, 0xc0, 0x7, 0x40,
    0x7, 0x40, 0x7, 0x80, 0x7, 0x80, 0x2f, 0xd0,
    0xbf, 0xf8,
    /* U+004A "J" */
    0x1, 0x6f, 0x82, 0xff, 0xc0, 0x1, 0xe0, 0x0,
    0x18, 0x0, 0x6, 0x0, 0x1, 0x80, 0x0, 0xd2,
    0x81, 0xe0, 0x7f, 0xe0, 0x0,
    /* U+004B "K" */
    0x20, 0x2, 0x48, 0x3, 0x83, 0x3, 0x81, 0xc2,
    0xc0, 0x3f, 0xc0, 0xf, 0xf4, 0x3, 0xff, 0xd0,
    0xe5, 0xbc, 0x30, 0x0, 0x0, 0x0, 0x0,
    /* U+004C "L" */
    0x20, 0x0, 0xc0, 0x7, 0x0, 0x2c, 0x0, 0xb0,
    0x2, 0xc0, 0xb, 0x40, 0x2f, 0xfe, 0x7f, 0x80,
    /* U+004D "M" */
    0x0, 0x0, 0x90, 0x1c, 0x3, 0xc0, 0xf8, 0x1f,
    0x3, 0xe0, 0xfc, 0x1b, 0xc7, 0x74, 0x8b, 0x34,
    0xd3, 0x1f, 0xc3, 0x58, 0x3e, 0x9, 0x90, 0xb0,
    0x14, 0x0, 0x0, 0x0,
    /* U+004E "N" */
    0x0, 0x0, 0x4, 0x0, 0x8b, 0x80, 0x72, 0xf4,
    0x1c, 0xbf, 0x7, 0x2f, 0xf1, 0xcb, 0x1f, 0xf2,
    0x81, 0xfc, 0x90, 0x1f, 0x14, 0x0, 0x0, 0x0,
    0x0,
    /* U+004F "O" */
    0x0, 0xbf, 0xe0, 0x7, 0xe6, 0xfc, 0x1d, 0x0,
    0x2c, 0x34, 0x0, 0x1c, 0x70, 0x0, 0x2c, 0xb0,
    0x0, 0x38, 0x7c, 0x1, 0xf0, 0x2f, 0xff, 0xc0,
    0x7, 0xf9, 0x0,
    /* U+0050 "P" */
    0x3f, 0xff, 0x2e, 0x56, 0xcb, 0x0, 0xf2, 0xc0,
    0xb8, 0xba, 0xf4, 0x2f, 0xd0, 0xb, 0x40, 0x2,
    0x80, 0x0, 0xa0, 0x0, 0x0, 0x0, 0x0,
    /* U+0051 "Q" */
    0x0, 0x7f, 0xe0, 0x7, 0xe9, 0xbc, 0x1d, 0x0,
    0x1d, 0x30, 0x0, 0x8, 0x70, 0x0, 0x8, 0xb0,
    0xd, 0x34, 0x74, 0xf, 0xe0, 0x3f, 0xbf, 0xd0,
    0xb, 0xe4, 0xf0, 0x0, 0x0, 0x24,
    /* U+0052 "R" */
    0x2f, 0xff, 0x8b, 0xaa, 0xbd, 0xb4, 0x3, 0xdb,
    0x40, 0xfc, 0x74, 0xbd, 0x7, 0xfd, 0x0, 0x3f,
    0xd0, 0x3, 0xff, 0xc0, 0x3c, 0x1a, 0x0,
    /* U+0053 "S" */
    0x0, 0xbd, 0x1, 0xef, 0x40, 0xd0, 0x80, 0xf0,
    0x0, 0x7f, 0xff, 0x1f, 0xff, 0xe0, 0x0, 0xb4,
    0x15, 0xb8, 0xb, 0xe4, 0x0,
    /* U+0054 "T" */
    0x1a, 0xff, 0x5a, 0xfe, 0x40, 0x1c, 0x0, 0x7,
    0x0, 0x0, 0xc0, 0x0, 0x30, 0x0, 0xc, 0x0,
    0x3, 0x0, 0x0, 0x80, 0x0,
    /* U+0055 "U" */
    0x0, 0x1c, 0x10, 0x1c, 0x60, 0x1c, 0x70, 0x1c,
    0x70, 0x1c, 0xb0, 0x1c, 0xb0, 0x2c, 0x7a, 0xf8,
    0x3f, 0xc0,
    /* U+0056 "V" */
    0x0, 0x8, 0x50, 0x18, 0x60, 0x30, 0x30, 0x60,
    0x38, 0xc0, 0x1e, 0xc0, 0xf, 0x80, 0xb, 0x40,
    0x3, 0x0,
    /* U+0057 "W" */
    0x0, 0x74, 0x2a, 0xb, 0xc3, 0xb0, 0xed, 0x77,
    0x4c, 0xea, 0x39, 0x8b, 0xe3, 0xf4, 0x7d, 0x1f,
    0x43, 0xd0, 0xf0, 0x1c, 0xa, 0x0, 0x0,
    /* U+0058 "X" */
    0x0, 0x0, 0x60, 0x20, 0x3c, 0x60, 0x1f, 0xc0,
    0xf, 0xc0, 0xf, 0xe0, 0xe, 0xb8, 0x1c, 0x1d,
    0x38, 0x1, 0x20, 0x0,
    /* U+0059 "Y" */
    0x90, 0x25, 0xc1, 0xc3, 0xee, 0x7, 0xf0, 0xf,
    0x80, 0x3c, 0x0, 0xe0, 0x3, 0x40, 0x18, 0x0,
    /* U+005A "Z" */
    0xaf, 0xfe, 0x0, 0xb, 0xe0, 0x0, 0xf8, 0x0,
    0x2e, 0x0, 0x7, 0xc0, 0x0, 0xf4, 0x0, 0x3f,
    0x0, 0x3, 0xff, 0xfc, 0x39, 0x55, 0x0,
    /* U+005B "[" */
    0x0, 0x0, 0x2d, 0xe, 0x2, 0x80, 0x30, 0x6,
    0x0, 0xa0, 0x7, 0x0, 0x3d, 0x1, 0xf8,
    /* U+005C "\\" */
    0xa0, 0x0, 0x34, 0x0, 0x2c, 0x0, 0xe, 0x0,
    0x7, 0x40, 0x2, 0xc0, 0x0, 0xe0, 0x0, 0x34,
    0x0, 0x1c,
    /* U+005D "]" */
    0x10, 0x3, 0xc0, 0xb, 0x0, 0x18, 0x0, 0x80,
    0x6, 0x0, 0xa0, 0xe, 0x7, 0xd1, 0xf4,
    /* U+005F "_" */
    0xff, 0xf8,
    /* U+0061 "a" */
    0x3, 0xc0, 0xb, 0xe0, 0xe, 0xf0, 0x28, 0x74,
    0x38, 0x78, 0x3f, 0xfc, 0x74, 0x2d, 0x90, 0xe,
    0x80, 0x6,
    /* U+0062 "b" */
    0x0, 0x0, 0x1f, 0xff, 0x4b, 0x42, 0xe2, 0xd6,
    0xe0, 0xbf, 0xfe, 0x1f, 0x41, 0xf7, 0x0, 0x7d,
    0xc0, 0xbc, 0x7f, 0xf8, 0xf, 0xe0, 0x0,
    /* U+0063 "c" */
    0x2, 0xf0, 0x3f, 0xd2, 0xc6, 0xd, 0x0, 0x70,
    0x2, 0x40, 0xa, 0x0, 0x2e, 0xbc, 0x7f, 0xd0,
    /* U+0064 "d" */
    0x3f, 0xff, 0xdb, 0x95, 0x6d, 0xb0, 0x1, 0xdb,
    0x0, 0x2c, 0xb0, 0x7, 0xb, 0x0, 0xd0, 0xb4,
    0x34, 0x7, 0xed, 0x0, 0x2e, 0x0, 0x0,
    /* U+0065 "e" */
    0x1b, 0xf8, 0xbd, 0x0, 0xb0, 0x0, 0xb0, 0x15,
    0xbf, 0xe4, 0xb8, 0x0, 0xb0, 0x4, 0xbf, 0xfc,
    0xbe, 0x80,
    /* U+0066 "f" */
    0x7f, 0xfa, 0xea, 0x9b, 0x0, 0x2c, 0x0, 0xb0,
    0x2, 0xff, 0xb, 0x90, 0x2c, 0x0, 0x60, 0x0,
    /* U+0067 "g" */
    0x1, 0xfe, 0x2, 0x80, 0x2, 0x80, 0x0, 0xc1,
    0xa8, 0xb1, 0xff, 0xac, 0x0, 0xe7, 0x40, 0xb4,
    0xff, 0xf8, 0xb, 0xe4, 0x0,
    /* U+0068 "h" */
    0x0, 0x0, 0x90, 0xd, 0x90, 0xd, 0xa0, 0xd,
    0xb0, 0x2d, 0xbf, 0xfe, 0xb9, 0x7e, 0xb0, 0x1e,
    0xa0, 0xe, 0x80, 0x6,
    /* U+0069 "i" */
    0x16, 0xaa, 0xaa, 0xaa, 0x50,
    /* U+006A "j" */
    0x1, 0xbf, 0x2, 0xfe, 0x0, 0x3, 0x40, 0x0,
    0x90, 0x0, 0x24, 0x0, 0x9, 0x0, 0x3, 0x2,
    0x81, 0xc0, 0x7f, 0xd0, 0x0,
    /* U+006B "k" */
    0x20, 0x0, 0xcb, 0x0, 0x74, 0x70, 0x2c, 0x3,
    0x1d, 0x0, 0x3f, 0xc0, 0x3, 0xfc, 0x0, 0x3a,
    0xfe, 0x3, 0x1, 0xf0, 0x20, 0x0, 0x0,
    /* U+006C "l" */
    0x24, 0x0, 0x90, 0x2, 0x40, 0x9, 0x0, 0x34,
    0x0, 0xd0, 0x3, 0x40, 0x1e, 0xa8, 0xbf, 0xf0,
    0x0, 0x0,
    /* U+006D "m" */
    0x0, 0x0, 0x0, 0x0, 0x2, 0x0, 0xe0, 0x2c,
    0x7, 0xc0, 0xf0, 0x2f, 0x8b, 0xd0, 0xef, 0x3f,
    0x83, 0x1f, 0xcf, 0x1c, 0x3d, 0x2c, 0x70, 0xf0,
    0x35, 0x81, 0xc0, 0x50,
    /* U+006E "n" */
    0x0, 0x8, 0x90, 0xc, 0xb0, 0xc, 0xbc, 0xc,
    0xbf, 0xc, 0x8f, 0x8c, 0x83, 0xec, 0x80, 0xbc,
    0x80, 0x1c,
    /* U+006F "o" */
    0x1, 0xbe, 0x0, 0xbf, 0xfc, 0x1d, 0x1, 0xe3,
    0x0, 0xb, 0x70, 0x0, 0x7b, 0x0, 0xe, 0xb4,
    0x7, 0xc7, 0xff, 0xf4, 0x2f, 0xf8, 0x0,
    /* U+0070 "p" */
    0x3f, 0xfd, 0xb9, 0x5e, 0xb0, 0xe, 0x70, 0x7d,
    0x7b, 0xf4, 0x7f, 0x40, 0x78, 0x0, 0x30, 0x0,
    0x30, 0x0,
    /* U+0071 "q" */
    0x1, 0xff, 0x80, 0x2e, 0x5b, 0xc2, 0xc0, 0xb,
    0xc, 0x0, 0x1c, 0x70, 0xa, 0xb2, 0xc0, 0x3f,
    0x4b, 0x81, 0xfc, 0xf, 0xff, 0xf4, 0x1f, 0xe4,
    0xb0, 0x0, 0x0, 0x40,
    /* U+0072 "r" */
    0x2f, 0xff, 0xcb, 0xaa, 0xad, 0xb0, 0x2, 0xdb,
    0x0, 0xb8, 0xb5, 0xbd, 0xb, 0xfe, 0x0, 0xbf,
    0xf4, 0x7, 0x8f, 0xd0, 0x34, 0x14, 0x0,
    /* U+0073 "s" */
    0x0, 0xbf, 0x1, 0xe5, 0x2, 0x80, 0x1, 0xea,
    0xa4, 0xbf, 0xff, 0x40, 0x1, 0xe0, 0x0, 0xf4,
    0x1, 0xf8, 0xf, 0xe0, 0x0,
    /* U+0074 "t" */
    0x6b, 0xfc, 0x6f, 0xe8, 0x2, 0x40, 0x1, 0x40,
    0x1, 0x40, 0x1, 0x40, 0x1, 0x40, 0x1, 0x40,
    0x1, 0x40,
    /* U+0075 "u" */
    0x0, 0x0, 0x4, 0x2, 0x43, 0x0, 0xd1, 0xc0,
    0x38, 0x70, 0xf, 0x1c, 0x3, 0xcb, 0x1, 0xf2,
    0xc2, 0xf8, 0xbf, 0xf4, 0x2f, 0x90, 0x0,
    /* U+0076 "v" */
    0x30, 0x2, 0x4f, 0x0, 0xd2, 0xd0, 0x70, 0x3c,
    0x3c, 0xb, 0x5d, 0x0, 0xff, 0x0, 0x1f, 0x80,
    0x3, 0xc0, 0x0, 0x0, 0x0,
    /* U+0077 "w" */
    0x0, 0x30, 0x2, 0x90, 0xb8, 0x9, 0x90, 0xec,
    0xc, 0xa0, 0xce, 0x1c, 0x71, 0x8b, 0x38, 0x3f,
    0x43, 0xf4, 0x3f, 0x3, 0xf0, 0x2f, 0x1, 0xf0,
    0xd, 0x0, 0xe0, 0x0, 0x0, 0x0,
    /* U+0078 "x" */
    0x10, 0x10, 0x78, 0x30, 0x2f, 0xd0, 0xf, 0xc0,
    0xb, 0xd0, 0xf, 0xf4, 0x1c, 0x2c, 0x38, 0xa,
    0x20, 0x0,
    /* U+0079 "y" */
    0x0, 0x1, 0x40, 0x5, 0xb0, 0xc, 0x3c, 0x28,
    0x1f, 0xf0, 0x7, 0xe0, 0x1, 0xd0, 0x1, 0xc0,
    0x1, 0xc0, 0x1, 0x40,
    /* U+007A "z" */
    0xaf, 0xfe, 0x0, 0xb, 0xe0, 0x0, 0xf8, 0x0,
    0x2e, 0x0, 0x7, 0xc0, 0x0, 0xf4, 0x0, 0x2f,
    0x0, 0x3, 0xff, 0xfc, 0x39, 0x55, 0x0,
    /* U+007B "{" */
    0x1f, 0x83, 0xd0, 0x70, 0xa, 0x0, 0x60, 0x3,
    0x0, 0x28, 0x0, 0xe0, 0x2, 0xd0, 0x0,
    /* U+007C "|" */
    0x8, 0x88, 0x88, 0x88, 0x88, 0x88, 0x0,
    /* U+007D "}" */
    0x1f, 0x40, 0x7d, 0x0, 0xe0, 0xa, 0x0, 0x60,
    0x8, 0x1, 0x80, 0xb0, 0x3c, 0x1, 0x0
};
/*---------------------
 *  GLYPH DESCRIPTION
 *--------------------*/
static const lv_font_fmt_txt_glyph_dsc_t comic_18_glyph_dsc[] = {
    {.bitmap_index = 0, .adv_w = 0, .box_w = 0, .box_h = 0, .ofs_x = 0, .ofs_y = 0} /* id = 0 reserved */,
    {.bitmap_index = 0, .adv_w = 121, .box_w = 0, .box_h = 0, .ofs_x = 0, .ofs_y = 0},
    {.bitmap_index = 0, .adv_w = 68, .box_w = 4, .box_h = 10, .ofs_x = 0, .ofs_y = 0},
    {.bitmap_index = 10, .adv_w = 69, .box_w = 4, .box_h = 4, .ofs_x = 0, .ofs_y = 6},
    {.bitmap_index = 14, .adv_w = 39, .box_w = 2, .box_h = 4, .ofs_x = 0, .ofs_y = 6},
    {.bitmap_index = 16, .adv_w = 102, .box_w = 6, .box_h = 10, .ofs_x = 0, .ofs_y = 0},
    {.bitmap_index = 31, .adv_w = 102, .box_w = 6, .box_h = 10, .ofs_x = 0, .ofs_y = 0},
    {.bitmap_index = 46, .adv_w = 81, .box_w = 5, .box_h = 5, .ofs_x = 0, .ofs_y = 2},
    {.bitmap_index = 53, .adv_w = 46, .box_w = 3, .box_h = 4, .ofs_x = 0, .ofs_y = -2},
    {.bitmap_index = 56, .adv_w = 85, .box_w = 5, .box_h = 3, .ofs_x = 0, .ofs_y = 2},
    {.bitmap_index = 60, .adv_w = 46, .box_w = 3, .box_h = 3, .ofs_x = 0, .ofs_y = -1},
    {.bitmap_index = 63, .adv_w = 125, .box_w = 8, .box_h = 9, .ofs_x = 0, .ofs_y = 0},
    {.bitmap_index = 81, .adv_w = 184, .box_w = 11, .box_h = 9, .ofs_x = 0, .ofs_y = 0},
    {.bitmap_index = 106, .adv_w = 120, .box_w = 7, .box_h = 9, .ofs_x = 0, .ofs_y = 0},
    {.bitmap_index = 122, .adv_w = 145, .box_w = 9, .box_h = 9, .ofs_x = 0, .ofs_y = 0},
    {.bitmap_index = 143, .adv_w = 156, .box_w = 9, .box_h = 9, .ofs_x = 0, .ofs_y = 0},
    {.bitmap_index = 164, .adv_w = 120, .box_w = 7, .box_h = 9, .ofs_x = 0, .ofs_y = 0},
    {.bitmap_index = 180, .adv_w = 145, .box_w = 9, .box_h = 9, .ofs_x = 0, .ofs_y = 0},
    {.bitmap_index = 201, .adv_w = 177, .box_w = 11, .box_h = 10, .ofs_x = 0, .ofs_y = 0},
    {.bitmap_index = 229, .adv_w = 148, .box_w = 9, .box_h = 9, .ofs_x = 0, .ofs_y = 0},
    {.bitmap_index = 250, .adv_w = 170, .box_w = 10, .box_h = 9, .ofs_x = 0, .ofs_y = 0},
    {.bitmap_index = 273, .adv_w = 177, .box_w = 11, .box_h = 10, .ofs_x = 0, .ofs_y = -1},
    {.bitmap_index = 301, .adv_w = 46, .box_w = 3, .box_h = 8, .ofs_x = 0, .ofs_y = -1},
    {.bitmap_index = 307, .adv_w = 48, .box_w = 3, .box_h = 9, .ofs_x = 0, .ofs_y = -2},
    {.bitmap_index = 314, .adv_w = 102, .box_w = 6, .box_h = 10, .ofs_x = 0, .ofs_y = -1},
    {.bitmap_index = 329, .adv_w = 86, .box_w = 5, .box_h = 5, .ofs_x = 0, .ofs_y = 2},
    {.bitmap_index = 336, .adv_w = 102, .box_w = 6, .box_h = 10, .ofs_x = 0, .ofs_y = -1},
    {.bitmap_index = 351, .adv_w = 194, .box_w = 12, .box_h = 9, .ofs_x = 0, .ofs_y = 0},
    {.bitmap_index = 378, .adv_w = 141, .box_w = 9, .box_h = 10, .ofs_x = 0, .ofs_y = -1},
    {.bitmap_index = 401, .adv_w = 168, .box_w = 10, .box_h = 9, .ofs_x = 0, .ofs_y = 0},
    {.bitmap_index = 424, .adv_w = 147, .box_w = 9, .box_h = 9, .ofs_x = 0, .ofs_y = 0},
    {.bitmap_index = 445, .adv_w = 148, .box_w = 9, .box_h = 10, .ofs_x = 0, .ofs_y = 0},
    {.bitmap_index = 468, .adv_w = 140, .box_w = 9, .box_h = 9, .ofs_x = 0, .ofs_y = 0},
    {.bitmap_index = 489, .adv_w = 140, .box_w = 9, .box_h = 10, .ofs_x = 0, .ofs_y = -1},
    {.bitmap_index = 512, .adv_w = 161, .box_w = 10, .box_h = 9, .ofs_x = 0, .ofs_y = 0},
    {.bitmap_index = 535, .adv_w = 120, .box_w = 7, .box_h = 9, .ofs_x = 0, .ofs_y = 0},
    {.bitmap_index = 551, .adv_w = 127, .box_w = 8, .box_h = 9, .ofs_x = 0, .ofs_y = 0},
    {.bitmap_index = 569, .adv_w = 150, .box_w = 9, .box_h = 9, .ofs_x = 0, .ofs_y = 0},
    {.bitmap_index = 590, .adv_w = 145, .box_w = 9, .box_h = 10, .ofs_x = 0, .ofs_y = -1},
    {.bitmap_index = 613, .adv_w = 120, .box_w = 7, .box_h = 9, .ofs_x = 0, .ofs_y = 0},
    {.bitmap_index = 629, .adv_w = 177, .box_w = 11, .box_h = 10, .ofs_x = 0, .ofs_y = -1},
    {.bitmap_index = 657, .adv_w = 140, .box_w = 9, .box_h = 11, .ofs_x = 0, .ofs_y = -1},
    {.bitmap_index = 682, .adv_w = 190, .box_w = 12, .box_h = 9, .ofs_x = 0, .ofs_y = 0},
    {.bitmap_index = 709, .adv_w = 141, .box_w = 9, .box_h = 10, .ofs_x = 0, .ofs_y = -1},
    {.bitmap_index = 732, .adv_w = 192, .box_w = 12, .box_h = 10, .ofs_x = 0, .ofs_y = -1},
    {.bitmap_index = 762, .adv_w = 163, .box_w = 10, .box_h = 9, .ofs_x = 0, .ofs_y = 0},
    {.bitmap_index = 785, .adv_w = 148, .box_w = 9, .box_h = 9, .ofs_x = 0, .ofs_y = 0},
    {.bitmap_index = 806, .adv_w = 148, .box_w = 9, .box_h = 9, .ofs_x = 0, .ofs_y = 0},
    {.bitmap_index = 827, .adv_w = 125, .box_w = 8, .box_h = 9, .ofs_x = 0, .ofs_y = 0},
    {.bitmap_index = 845, .adv_w = 122, .box_w = 8, .box_h = 9, .ofs_x = 0, .ofs_y = 0},
    {.bitmap_index = 863, .adv_w = 170, .box_w = 10, .box_h = 9, .ofs_x = 0, .ofs_y = 0},
    {.bitmap_index = 886, .adv_w = 134, .box_w = 8, .box_h = 10, .ofs_x = 0, .ofs_y = 0},
    {.bitmap_index = 906, .adv_w = 111, .box_w = 7, .box_h = 9, .ofs_x = 0, .ofs_y = 0},
    {.bitmap_index = 922, .adv_w = 157, .box_w = 10, .box_h = 9, .ofs_x = 0, .ofs_y = 0},
    {.bitmap_index = 945, .adv_w = 102, .box_w = 6, .box_h = 10, .ofs_x = 0, .ofs_y = 0},
    {.bitmap_index = 960, .adv_w = 127, .box_w = 8, .box_h = 9, .ofs_x = 0, .ofs_y = 0},
    {.bitmap_index = 978, .adv_w = 102, .box_w = 6, .box_h = 10, .ofs_x = 0, .ofs_y = 0},
    {.bitmap_index = 993, .adv_w = 108, .box_w = 7, .box_h = 1, .ofs_x = 0, .ofs_y = -1},
    {.bitmap_index = 995, .adv_w = 134, .box_w = 8, .box_h = 9, .ofs_x = 0, .ofs_y = 0},
    {.bitmap_index = 1013, .adv_w = 154, .box_w = 9, .box_h = 10, .ofs_x = 0, .ofs_y = 0},
    {.bitmap_index = 1036, .adv_w = 112, .box_w = 7, .box_h = 9, .ofs_x = 0, .ofs_y = 0},
    {.bitmap_index = 1052, .adv_w = 161, .box_w = 10, .box_h = 9, .ofs_x = 0, .ofs_y = 0},
    {.bitmap_index = 1075, .adv_w = 132, .box_w = 8, .box_h = 9, .ofs_x = 0, .ofs_y = 0},
    {.bitmap_index = 1093, .adv_w = 117, .box_w = 7, .box_h = 9, .ofs_x = 0, .ofs_y = 0},
    {.bitmap_index = 1109, .adv_w = 150, .box_w = 9, .box_h = 9, .ofs_x = 0, .ofs_y = 0},
    {.bitmap_index = 1130, .adv_w = 134, .box_w = 8, .box_h = 10, .ofs_x = 0, .ofs_y = 0},
    {.bitmap_index = 1150, .adv_w = 36, .box_w = 2, .box_h = 9, .ofs_x = 0, .ofs_y = 0},
    {.bitmap_index = 1155, .adv_w = 141, .box_w = 9, .box_h = 9, .ofs_x = 0, .ofs_y = 0},
    {.bitmap_index = 1176, .adv_w = 154, .box_w = 10, .box_h = 9, .ofs_x = 0, .ofs_y = 0},
    {.bitmap_index = 1199, .adv_w = 111, .box_w = 7, .box_h = 10, .ofs_x = 0, .ofs_y = -1},
    {.bitmap_index = 1217, .adv_w = 179, .box_w = 11, .box_h = 10, .ofs_x = 0, .ofs_y = 0},
    {.bitmap_index = 1245, .adv_w = 125, .box_w = 8, .box_h = 9, .ofs_x = 0, .ofs_y = 0},
    {.bitmap_index = 1263, .adv_w = 168, .box_w = 10, .box_h = 9, .ofs_x = 0, .ofs_y = 0},
    {.bitmap_index = 1286, .adv_w = 132, .box_w = 8, .box_h = 9, .ofs_x = 0, .ofs_y = 0},
    {.bitmap_index = 1304, .adv_w = 170, .box_w = 11, .box_h = 10, .ofs_x = 0, .ofs_y = -1},
    {.bitmap_index = 1332, .adv_w = 163, .box_w = 10, .box_h = 9, .ofs_x = 0, .ofs_y = 0},
    {.bitmap_index = 1355, .adv_w = 148, .box_w = 9, .box_h = 9, .ofs_x = 0, .ofs_y = 0},
    {.bitmap_index = 1376, .adv_w = 125, .box_w = 8, .box_h = 9, .ofs_x = 0, .ofs_y = 0},
    {.bitmap_index = 1394, .adv_w = 140, .box_w = 9, .box_h = 10, .ofs_x = 0, .ofs_y = 0},
    {.bitmap_index = 1417, .adv_w = 128, .box_w = 9, .box_h = 9, .ofs_x = -1, .ofs_y = 0},
    {.bitmap_index = 1438, .adv_w = 197, .box_w = 12, .box_h = 10, .ofs_x = 0, .ofs_y = -1},
    {.bitmap_index = 1468, .adv_w = 134, .box_w = 8, .box_h = 9, .ofs_x = 0, .ofs_y = 0},
    {.bitmap_index = 1486, .adv_w = 131, .box_w = 8, .box_h = 10, .ofs_x = 0, .ofs_y = 0},
    {.bitmap_index = 1506, .adv_w = 157, .box_w = 10, .box_h = 9, .ofs_x = 0, .ofs_y = 0},
    {.bitmap_index = 1529, .adv_w = 102, .box_w = 6, .box_h = 10, .ofs_x = 0, .ofs_y = -1},
    {.bitmap_index = 1544, .adv_w = 29, .box_w = 2, .box_h = 13, .ofs_x = 0, .ofs_y = -2},
    {.bitmap_index = 1551, .adv_w = 102, .box_w = 6, .box_h = 10, .ofs_x = 0, .ofs_y = -1}
};
/*---------------------
 *  CHARACTER MAPPING
 *--------------------*/
static const uint8_t glyph_id_ofs_list_0[] = {
    0, 1, 2, 0, 0, 0, 0, 3,
    4, 5
};
/*Collect the unicode lists and glyph_id offsets*/
static const lv_font_fmt_txt_cmap_t comic_18_cmaps[] =
{
    {
        .range_start = 32, .range_length = 10, .glyph_id_start = 1,
        .unicode_list = NULL, .glyph_id_ofs_list = glyph_id_ofs_list_0, .list_length = 10, .type = LV_FONT_FMT_TXT_CMAP_FORMAT0_FULL
    },
    {
        .range_start = 43, .range_length = 21, .glyph_id_start = 7,
        .unicode_list = NULL, .glyph_id_ofs_list = NULL, .list_length = 0, .type = LV_FONT_FMT_TXT_CMAP_FORMAT0_TINY
    },
    {
        .range_start = 65, .range_length = 29, .glyph_id_start = 28,
        .unicode_list = NULL, .glyph_id_ofs_list = NULL, .list_length = 0, .type = LV_FONT_FMT_TXT_CMAP_FORMAT0_TINY
    },
    {
        .range_start = 95, .range_length = 1, .glyph_id_start = 57,
        .unicode_list = NULL, .glyph_id_ofs_list = NULL, .list_length = 0, .type = LV_FONT_FMT_TXT_CMAP_FORMAT0_TINY
    },
    {
        .range_start = 97, .range_length = 29, .glyph_id_start = 58,
        .unicode_list = NULL, .glyph_id_ofs_list = NULL, .list_length = 0, .type = LV_FONT_FMT_TXT_CMAP_FORMAT0_TINY
    }
};
/*--------------------
 *  ALL CUSTOM DATA
 *--------------------*/
/*Store all the custom data of the font*/
static lv_font_fmt_txt_glyph_cache_t comic_18_cache;
static const lv_font_fmt_txt_dsc_t comic_18_font_dsc = {
    .glyph_bitmap = comic_18_glyph_bitmap,
    .glyph_dsc = comic_18_glyph_dsc,
    .cmaps = comic_18_cmaps,
    .kern_dsc = NULL,
    .kern_scale = 0,
    .cmap_num = 5,
    .bpp = 2,
    .kern_classes = 0,
    .bitmap_format = 0,
    .cache = &comic_18_cache
};
/*-----------------
 *  PUBLIC FONT
 *----------------*/
/*Initialize a public general font descriptor*/
const lv_font_t comic_18 = {
    .get_glyph_dsc = lv_font_get_glyph_dsc_fmt_txt,    /*Function pointer to get glyph's data*/
    .get_glyph_bitmap = lv_font_get_bitmap_fmt_txt,    /*Function pointer to get glyph's bitmap*/
    .line_height = 13,          /*The maximum line height required by the font*/
    .base_line = 2,             /*Baseline measured from the bottom of the line*/

    .subpx = LV_FONT_SUBPX_NONE,
    .underline_position = -1,
    .underline_thickness = 1,
    .dsc = &comic_18_font_dsc,          /*The custom font data. Will be accessed by `get_glyph_bitmap/dsc` */
};
#endif

/*******************************************************************************
 * Size: 22 px
 * Bpp: 2
 ******************************************************************************/


#ifdef __has_include

    #if __has_include("lvgl.h")
         #ifndef LV_LVGL_H_INCLUDE_SIMPLE
             #define LV_LVGL_H_INCLUDE_SIMPLE
         #endif
     #endif
 #endif

 #ifdef LV_LVGL_H_INCLUDE_SIMPLE
     #include "lvgl.h"
 #else
     #include "../lvgl-8.3.11/lvgl.h"
 #endif

 #ifndef CURSIVE_24
 #define CURSIVE_24 1
 #endif

 #if CURSIVE_24

/*-----------------
 *    BITMAPS
 *----------------*/
/*Store the image of the glyphs*/
static LV_ATTRIBUTE_LARGE_CONST const uint8_t cursive_24_glyph_bitmap[] = {
    /* U+0020 " " */
    /* U+0021 "!" */
    0xd, 0x1d, 0x2c, 0x2c, 0x2c, 0x38, 0x38, 0x34,
    0x30, 0x10, 0x0, 0x74, 0x74,
    /* U+0022 "\"" */
    0xb3, 0x6c, 0xda, 0x32, 0x4c, 0x0, 0x0,
    /* U+0023 "#" */
    0x0, 0x50, 0x40, 0x0, 0x80, 0xc0, 0x0, 0xc0,
    0xc0, 0xa, 0xff, 0xfe, 0x0, 0x81, 0x80, 0x1,
    0x81, 0x40, 0x1, 0x82, 0x40, 0x2b, 0xff, 0xfc,
    0x3, 0x43, 0x0, 0x7, 0x7, 0x0, 0xb, 0xe,
    0x0, 0xe, 0xd, 0x0, 0x1c, 0x1c, 0x0,
    /* U+0024 "$" */
    0x0, 0x20, 0x0, 0x1b, 0xe0, 0x7, 0x72, 0x80,
    0xe3, 0x18, 0xe, 0x30, 0x0, 0xbf, 0x0, 0x1,
    0xf8, 0x0, 0x7, 0xf0, 0x0, 0x63, 0xc3, 0xc6,
    0x2c, 0xb0, 0xa1, 0xcb, 0xa, 0x2c, 0x78, 0xab,
    0x1, 0xbf, 0x80, 0x0, 0x90, 0x0, 0x0, 0x0,
    /* U+0025 "%" */
    0x0, 0x0, 0x10, 0x1a, 0x2, 0xc3, 0x3a, 0x7c,
    0xc, 0x18, 0xc0, 0x34, 0x8a, 0x0, 0x28, 0x70,
    0x0, 0x3, 0x40, 0x0, 0x2c, 0x0, 0x0, 0xda,
    0x70, 0xf, 0x30, 0x50, 0x75, 0xc1, 0x87, 0x83,
    0x8, 0x2c, 0xb, 0x90,
    /* U+0026 "&" */
    0x1, 0xfd, 0x0, 0x0, 0xb0, 0xb4, 0x0, 0xd,
    0x3, 0x40, 0x0, 0xd0, 0x70, 0x0, 0xb, 0x1d,
    0x0, 0x0, 0x7e, 0x0, 0x0, 0x7, 0xc0, 0x90,
    0x2, 0xdf, 0xb, 0x0, 0x70, 0x7c, 0x30, 0xf,
    0x2, 0xf7, 0x0, 0xf0, 0xb, 0xd0, 0xb, 0xc0,
    0x7f, 0x80, 0x1f, 0xf8, 0x7f, 0x80, 0x0, 0x0,
    0x54,
    /* U+0027 "'" */
    0xae, 0xd8, 0x0,
    /* U+0028 "(" */
    0x0, 0x80, 0xc0, 0x60, 0x30, 0x28, 0xd, 0x3,
    0x1, 0xc0, 0xb0, 0x2c, 0x7, 0x1, 0xd0, 0x38,
    0xb, 0x1, 0xe0, 0x1c,
    /* U+0029 ")" */
    0x38, 0x7, 0x40, 0xf0, 0x2c, 0x3, 0x40, 0xe0,
    0x38, 0xe, 0x3, 0x80, 0xd0, 0x30, 0x18, 0xc,
    0x6, 0x3, 0x2, 0x0,
    /* U+002A "*" */
    0x0, 0x80, 0x28, 0xc0, 0xe, 0xdd, 0x3, 0xf4,
    0x2b, 0xd0, 0x7, 0x24, 0xa, 0x0,
    /* U+002B "+" */
    0x1, 0x0, 0x8, 0x0, 0x30, 0x2f, 0xff, 0x3,
    0x0, 0xc, 0x0, 0x70, 0x0, 0x40,
    /* U+002C "," */
    0x34, 0xe3, 0x14,
    /* U+002D "-" */
    0x0, 0x0, 0xff, 0xc1, 0x14, 0x0,
    /* U+002E "." */
    0x38, 0xd0,
    /* U+002F "/" */
    0x0, 0x8, 0x0, 0x90, 0x3, 0x0, 0xc, 0x0,
    0x60, 0x2, 0x40, 0xc, 0x0, 0x70, 0x2, 0x80,
    0xd, 0x0, 0xb0, 0x3, 0x80, 0x2d, 0x0, 0xf0,
    0x7, 0x40, 0x18, 0x0,
    /* U+0030 "0" */
    0x0, 0x7e, 0x0, 0x50, 0x78, 0xc, 0x3, 0xc2,
    0x80, 0x2d, 0x34, 0x1, 0xd3, 0x40, 0xd, 0x74,
    0x1, 0xd7, 0x40, 0x1c, 0x38, 0x2, 0xc3, 0xc0,
    0x34, 0x2e, 0xe, 0x0, 0xbf, 0x40,
    /* U+0031 "1" */
    0x0, 0x10, 0xf, 0x2, 0xf0, 0x6b, 0xc, 0xb1,
    0x8b, 0x30, 0xe2, 0xe, 0x0, 0xe0, 0xe, 0x1,
    0xd0, 0x1d, 0x1, 0xc0,
    /* U+0032 "2" */
    0x2, 0xf8, 0x2, 0x7, 0xc2, 0x40, 0xf0, 0xa0,
    0x3c, 0x4, 0xe, 0x0, 0xb, 0x0, 0x7, 0x0,
    0x6, 0x0, 0x6, 0x0, 0x4b, 0x90, 0x2f, 0xbf,
    0xf3, 0x42, 0xf4,
    /* U+0033 "3" */
    0x0, 0x0, 0x7, 0xd0, 0x2, 0x7f, 0xf0, 0x41,
    0xfc, 0x0, 0x30, 0x0, 0x20, 0x0, 0x3f, 0xc0,
    0x0, 0x78, 0x0, 0xb, 0x0, 0x1, 0xc0, 0x0,
    0xb1, 0x0, 0x38, 0xb0, 0x2c, 0xb, 0xf4, 0x0,
    /* U+0034 "4" */
    0x0, 0xd0, 0x0, 0x1d, 0x0, 0x2, 0xc0, 0x0,
    0x30, 0x0, 0xa, 0xc, 0x0, 0xc0, 0xc0, 0x24,
    0x1c, 0x3, 0x6, 0xd0, 0xbf, 0xff, 0xc0, 0x3,
    0x80, 0x0, 0x38, 0x0, 0x3, 0x80, 0x0, 0x34,
    0x0,
    /* U+0035 "5" */
    0x0, 0x6, 0x38, 0x7e, 0x3f, 0xf8, 0xc, 0x0,
    0x8, 0x0, 0x1f, 0xf4, 0x0, 0x3c, 0x0, 0x1e,
    0x0, 0xe, 0x0, 0xe, 0x40, 0x1c, 0xf0, 0x38,
    0x2f, 0x90,
    /* U+0036 "6" */
    0x0, 0xbe, 0x0, 0xe0, 0xd0, 0xf0, 0x28, 0x74,
    0xe, 0x2c, 0x0, 0xf, 0x0, 0x3, 0x9b, 0x80,
    0xf4, 0x1c, 0x38, 0x3, 0x4e, 0x0, 0xe3, 0xc0,
    0x34, 0x74, 0x2c, 0x7, 0xf8, 0x0,
    /* U+0037 "7" */
    0x0, 0x0, 0x2f, 0x91, 0x4d, 0xbf, 0xf1, 0x1,
    0xf8, 0x0, 0x24, 0x0, 0xc, 0x0, 0x6, 0x0,
    0x2, 0x40, 0xb, 0xfc, 0x0, 0xa0, 0x0, 0x34,
    0x0, 0x2c, 0x0, 0xe, 0x0, 0x3, 0x0, 0x0,
    /* U+0038 "8" */
    0x2, 0x7d, 0x3, 0x1, 0xc1, 0xc0, 0x30, 0x70,
    0x18, 0xe, 0x18, 0x0, 0xb8, 0x0, 0x7b, 0x40,
    0x74, 0x74, 0x38, 0xf, 0x2c, 0x2, 0xcb, 0x0,
    0xb1, 0xd0, 0x38, 0x1e, 0xa4, 0x0,
    /* U+0039 "9" */
    0x2, 0xb4, 0x3, 0x83, 0x81, 0xc0, 0xb0, 0xe0,
    0x1d, 0x38, 0x3, 0x8e, 0x0, 0xe1, 0xc0, 0x78,
    0x2f, 0x9d, 0x0, 0x7, 0x40, 0x2, 0xc1, 0x0,
    0xe0, 0xe0, 0xb0, 0xf, 0xe0, 0x0,
    /* U+003A ":" */
    0x35, 0xd0, 0x0, 0x0, 0x3, 0x5d,
    /* U+003B ";" */
    0x35, 0xd0, 0x0, 0x0, 0x2, 0x1d, 0x31, 0x84,
    0x0,
    /* U+003C "<" */
    0x0, 0x1, 0xc0, 0x7, 0x80, 0x1e, 0x0, 0xb8,
    0x0, 0x1b, 0xd0, 0x0, 0x2f, 0x80, 0x0, 0x74,
    /* U+003D "=" */
    0x0, 0x0, 0xf, 0xff, 0xd0, 0x0, 0x0, 0x0,
    0x0, 0x3f, 0x41, 0x0, 0x1f, 0x80, 0x0, 0x0,
    /* U+003E ">" */
    0x0, 0x0, 0xa, 0x0, 0x0, 0xf8, 0x0, 0x6,
    0xf4, 0x0, 0xb, 0x80, 0x2d, 0x1, 0xf4, 0x0,
    0xd0, 0x0,
    /* U+003F "?" */
    0x6, 0xe0, 0x2c, 0x3c, 0x30, 0x1d, 0x0, 0x1d,
    0x0, 0x2c, 0x0, 0x74, 0x2, 0xc0, 0x6, 0x0,
    0xb, 0x0, 0x2, 0x0, 0x0, 0x0, 0xb, 0x0,
    0xf, 0x0,
    /* U+0040 "@" */
    0x0, 0xb, 0xf9, 0x0, 0x0, 0xb4, 0x7, 0x80,
    0x3, 0x80, 0x0, 0xe0, 0xe, 0x0, 0x0, 0x74,
    0x2c, 0xf, 0x9c, 0x3c, 0x34, 0x34, 0x7c, 0x3c,
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    0x0, 0x0, 0x0, 0x0,
    /* U+0041 "A" */
    0x0, 0x6, 0x0, 0x0, 0x3, 0xc0, 0x0, 0x2,
    0xb0, 0x0, 0x1, 0x5c, 0x0, 0x0, 0xc7, 0x0,
    0x0, 0x61, 0xc0, 0x0, 0x30, 0x74, 0x0, 0xc,
    0x1d, 0x0, 0x3f, 0xff, 0x82, 0x7, 0x0, 0xd1,
    0x42, 0x80, 0x34, 0x81, 0xd0, 0xe, 0x80, 0xb0,
    0x3, 0xd0, 0x0,
    /* U+0042 "B" */
    0x2, 0xfe, 0x0, 0xd, 0xb, 0x8a, 0x34, 0xb,
    0x75, 0xd0, 0xe, 0x7, 0x40, 0x34, 0x1d, 0x1,
    0xc0, 0x76, 0x5d, 0x1, 0xda, 0xb4, 0x7, 0x0,
    0xb0, 0x1c, 0x1, 0xc0, 0x70, 0xb, 0x1, 0x40,
    0xb0, 0xb, 0xfe, 0x0,
    /* U+0043 "C" */
    0x0, 0xaf, 0x40, 0xd, 0xb, 0x0, 0xd0, 0x1c,
    0xf, 0x0, 0xe0, 0x74, 0x2, 0x2, 0xc0, 0x0,
    0xf, 0x0, 0x0, 0x38, 0x0, 0x1, 0xf0, 0x0,
    0x23, 0xc0, 0x1, 0x8b, 0x80, 0xc, 0xf, 0x96,
    0xc0, 0xb, 0xf4, 0x0,
    /* U+0044 "D" */
    0x0, 0x30, 0x0, 0x0, 0x7, 0x0, 0x0, 0x0,
    0xbf, 0xe0, 0x0, 0xaf, 0x7, 0xe0, 0x24, 0xb0,
    0xb, 0x47, 0xf, 0x0, 0x3c, 0x60, 0xf0, 0x2,
    0xd7, 0xf, 0x0, 0x1d, 0x0, 0xf0, 0x1, 0xd0,
    0xf, 0x0, 0x1c, 0x0, 0xf0, 0x3, 0xc0, 0xe,
    0x0, 0xb0, 0xa, 0xe0, 0x2c, 0x0, 0x6f, 0xa9,
    0x0, 0x0, 0x50, 0x0, 0x0,
    /* U+0045 "E" */
    0x0, 0xaa, 0x0, 0x1d, 0xf, 0x0, 0xe0, 0x2c,
    0x7, 0x40, 0x0, 0xd, 0x0, 0x0, 0x2e, 0xb0,
    0x0, 0xda, 0x80, 0xe, 0x0, 0x1, 0x74, 0x0,
    0x9, 0xd0, 0x0, 0x87, 0xc0, 0x5, 0xf, 0x80,
    0xa0, 0xb, 0xf9, 0x0,
    /* U+0046 "F" */
    0x0, 0x80, 0x0, 0x3, 0x0, 0x1, 0xbf, 0xff,
    0x58, 0xb0, 0x50, 0xe2, 0xc0, 0x1, 0xa, 0x0,
    0x0, 0x38, 0x0, 0x0, 0xff, 0x80, 0x3, 0x80,
    0x0, 0xe, 0x0, 0x0, 0x38, 0x0, 0x1, 0xd0,
    0x0, 0xb, 0x40, 0x0, 0x18, 0x0, 0x0,
    /* U+0047 "G" */
    0x0, 0x7f, 0x80, 0x0, 0x38, 0x1e, 0x0, 0xe,
    0x0, 0xb0, 0x3, 0xc0, 0x0, 0x0, 0x74, 0x0,
    0x0, 0xb, 0x0, 0x0, 0x0, 0xf0, 0x6, 0xe0,
    0xf, 0x0, 0xd3, 0xa8, 0xf0, 0xb, 0xfd, 0xf,
    0x40, 0x3, 0x40, 0x7c, 0x0, 0xb0, 0x3, 0xf4,
    0x6c, 0x0, 0x7, 0xfd, 0x0, 0x0,
    /* U+0048 "H" */
    0x0, 0x0, 0xb, 0x0, 0x0, 0x7, 0x90, 0xf4,
    0x2, 0x90, 0x8b, 0x0, 0xd8, 0x22, 0xc0, 0x36,
    0xc, 0xb0, 0x1e, 0x1, 0x2c, 0xb, 0x80, 0xb,
    0x2, 0xc0, 0xb, 0xc0, 0xf0, 0x3, 0xe1, 0xfc,
    0x0, 0x7f, 0x4f, 0x0, 0xd, 0x3, 0xc0, 0x7,
    0x40, 0xf0, 0x1, 0xd0, 0x2d, 0x0, 0x30, 0xb,
    0x80, 0x0, 0x0, 0x50,
    /* U+0049 "I" */
    0x0, 0x1, 0xd0, 0x0, 0x39, 0x0, 0x6f, 0x40,
    0x38, 0x70, 0x7, 0x7, 0x0, 0x60, 0x70, 0x0,
    0x7, 0x0, 0x0, 0x70, 0x0, 0xb, 0x0, 0x0,
    0xb0, 0x30, 0xd, 0x7, 0x3, 0x80, 0x2f, 0xd0,
    0x0,
    /* U+004A "J" */
    0x0, 0x3, 0x80, 0x0, 0x3e, 0x0, 0xa, 0xe0,
    0x1, 0xc3, 0x40, 0xd, 0xd, 0x0, 0x30, 0x34,
    0x0, 0x1, 0xd0, 0x0, 0x7, 0x4, 0x0, 0x1e,
    0x90, 0x0, 0xb4, 0x0, 0xf, 0xc0, 0x1, 0xcb,
    0x0, 0x1c, 0x2c, 0x0, 0xc0, 0xb0, 0xb, 0x3,
    0xc0, 0x38, 0xf, 0x0, 0xe0, 0x38, 0x3, 0xc0,
    0xd0, 0x7, 0x4b, 0x0, 0xb, 0xe0, 0x0,
    /* U+004B "K" */
    0x0, 0x3, 0xc0, 0x70, 0x0, 0x2d, 0x3, 0xc0,
    0x4, 0xe0, 0x2c, 0x2, 0x83, 0x80, 0xd0, 0xd,
    0xe, 0x7, 0x0, 0x20, 0x38, 0x34, 0x0, 0x0,
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    0x0,
    /* U+004C "L" */
    0x0, 0x6, 0xb4, 0x0, 0x70, 0xa0, 0x3, 0x83,
    0x40, 0x1d, 0x18, 0x0, 0x7a, 0x40, 0x7, 0xc0,
    0x0, 0xf, 0x0, 0x0, 0x38, 0x0, 0x0, 0xe0,
    0x0, 0x7, 0x0, 0x7, 0xfc, 0x0, 0x21, 0xfe,
    0x1, 0x7d, 0x6f, 0xe0,
    /* U+004D "M" */
    0x0, 0x0, 0x2, 0x40, 0x0, 0x0, 0xf, 0x0,
    0x4, 0x0, 0x78, 0x0, 0x74, 0x2, 0xc0, 0x1,
    0xe0, 0xe, 0x0, 0x3, 0xc0, 0xb4, 0x0, 0xb,
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    0x0,
    /* U+004E "N" */
    0x0, 0xc0, 0xf, 0x40, 0xb0, 0xf, 0xe0, 0x2c,
    0xd, 0x0, 0x3, 0x86, 0x0, 0x0, 0xf7, 0x0,
    0x0, 0x3f, 0xc0, 0x0, 0x18, 0xe0, 0x0, 0x9,
    0x2c, 0x0, 0x3, 0xb, 0x40, 0x0, 0xc2, 0xf0,
    0x0, 0x90, 0xac, 0x1, 0xb0, 0x2b, 0x0, 0xf0,
    0x7, 0x40, 0x0,
    /* U+004F "O" */
    0x0, 0x7f, 0xd0, 0x0, 0xb, 0xe3, 0xd0, 0x0,
    0x34, 0x3, 0xc0, 0x2, 0x80, 0xb, 0x40, 0x2e,
    0x0, 0x1e, 0x0, 0xdc, 0x0, 0x38, 0x7, 0x28,
    0x0, 0xe0, 0x1c, 0x38, 0x3, 0x84, 0xb0, 0x3d,
    0xe, 0x81, 0xe0, 0x1b, 0xf0, 0x3, 0xc0, 0x3,
    0x0, 0x7, 0xd0, 0x74, 0x0, 0x7, 0xfe, 0x0,
    0x0,
    /* U+0050 "P" */
    0x0, 0x0, 0x0, 0x0, 0x34, 0x0, 0x1, 0xff,
    0xd0, 0x1e, 0x74, 0xbc, 0x34, 0x70, 0x2d, 0xb0,
    0x70, 0xf, 0x50, 0xb0, 0xf, 0x0, 0xb0, 0xe,
    0x0, 0xb0, 0x1d, 0x1, 0xf0, 0x74, 0x0, 0xfe,
    0x80, 0x0, 0xf0, 0x0, 0x0, 0xf0, 0x0, 0x1,
    0xe0, 0x0, 0x1, 0xd0, 0x0,
    /* U+0051 "Q" */
    0x0, 0x6f, 0xe0, 0x0, 0xa0, 0x2f, 0x0, 0xa0,
    0x2, 0xe0, 0x30, 0x0, 0x3c, 0x28, 0x0, 0xf,
    0xd, 0x0, 0x2, 0xc3, 0x40, 0x0, 0xb0, 0xd0,
    0x0, 0x2c, 0x38, 0x0, 0xe, 0xf, 0x0, 0x7,
    0x2, 0xe2, 0x3, 0x40, 0x3f, 0xf7, 0x40, 0x2,
    0xff, 0x87, 0x0, 0x0, 0xbf, 0x0, 0x0, 0x0,
    0x0,
    /* U+0052 "R" */
    0x0, 0x0, 0x0, 0x0, 0x7, 0x0, 0x0, 0x1,
    0xff, 0x90, 0x1, 0xde, 0xb, 0xc0, 0xb0, 0xe0,
    0x2e, 0xe, 0xe, 0x0, 0xf0, 0x80, 0xd0, 0xf,
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    0x0, 0x0, 0xb, 0x80,
    /* U+0053 "S" */
    0x1, 0xfe, 0x0, 0xb4, 0x38, 0xf, 0x2, 0x40,
    0xf0, 0x0, 0xb, 0x80, 0x0, 0x2f, 0x80, 0x0,
    0x3f, 0x0, 0x0, 0xbc, 0x3c, 0x2, 0xcb, 0x0,
    0x2c, 0xb0, 0x3, 0xc7, 0x80, 0xb0, 0x1b, 0xf8,
    0x0,
    /* U+0054 "T" */
    0x3f, 0x93, 0x0, 0x2, 0xab, 0xfe, 0x0, 0x48,
    0x0, 0x7f, 0xf9, 0x8, 0x1, 0xc0, 0x0, 0x1b,
    0x7, 0x40, 0x0, 0x0, 0x1d, 0x0, 0x0, 0x0,
    0x74, 0x0, 0x0, 0x1, 0xc0, 0x0, 0x0, 0x7,
    0x0, 0x0, 0x0, 0x2c, 0x0, 0x0, 0xc0, 0xe0,
    0x0, 0x7, 0x7, 0x0, 0x0, 0xb, 0xf4, 0x0,
    0x0,
    /* U+0055 "U" */
    0xe, 0x0, 0x70, 0xa, 0xc0, 0x3c, 0x8, 0xa0,
    0xf, 0x2, 0x38, 0x3, 0xc0, 0xe, 0x0, 0xe0,
    0x3, 0x40, 0x74, 0x0, 0xd0, 0x1c, 0x0, 0x34,
    0x7, 0x1, 0x1c, 0x2, 0xc1, 0x7, 0x40, 0xf0,
    0x80, 0xd0, 0xac, 0x80, 0x3c, 0x8b, 0x60, 0x7,
    0xc2, 0xe0, 0x0,
    /* U+0056 "V" */
    0x0, 0x1, 0xd0, 0x0, 0x3, 0xc0, 0x0, 0x7,
    0x40, 0xb0, 0xe, 0xb, 0x50, 0x28, 0x39, 0x40,
    0xa0, 0xe9, 0x2, 0x87, 0x60, 0x9, 0x1e, 0x40,
    0x30, 0x7c, 0x0, 0xc0, 0xe0, 0x3, 0x7, 0xc0,
    0x24, 0x5f, 0x0, 0xc0, 0x2d, 0x9, 0x0, 0x7c,
    0xa0, 0x0, 0x7e, 0x0,
    /* U+0057 "W" */
    0x0, 0xf0, 0x0, 0xe0, 0xe, 0x90, 0x3, 0xc0,
    0x35, 0x41, 0x3, 0x42, 0xc4, 0x3c, 0xa, 0xf,
    0x20, 0xf0, 0x18, 0x3d, 0x87, 0xc0, 0x6a, 0xf8,
    0x2f, 0x1, 0x83, 0x80, 0xec, 0x9, 0xe, 0x6,
    0xb0, 0x30, 0x3c, 0x31, 0xc0, 0xc0, 0xf1, 0x87,
    0x49, 0x2, 0xec, 0xf, 0xa0, 0x3, 0xd0, 0x2e,
    0x0,
    /* U+0058 "X" */
    0x7, 0x0, 0x18, 0x2, 0xc0, 0xd, 0x0, 0xf8,
    0xe, 0x0, 0x1f, 0x7, 0x0, 0x7, 0xe3, 0x0,
    0x2, 0x3e, 0x40, 0x1, 0x4b, 0xc0, 0x0, 0x40,
    0xf0, 0x1, 0x0, 0xfe, 0x2, 0x0, 0xf3, 0xc0,
    0x80, 0xb0, 0xb8, 0xc0, 0xf4, 0xf, 0xe0, 0x78,
    0x0, 0xe0, 0x0,
    /* U+0059 "Y" */
    0xe, 0x0, 0x18, 0x2b, 0x0, 0x3c, 0x8b, 0x0,
    0x78, 0x8b, 0x0, 0x74, 0xe, 0x0, 0xb0, 0xe,
    0x0, 0xb0, 0xd, 0x0, 0xf0, 0xd, 0x0, 0xe0,
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    0x80, 0x0, 0xbe, 0x0,
    /* U+005A "Z" */
    0xf, 0xe4, 0x2c, 0x3, 0xff, 0xf3, 0x0, 0x80,
    0x7f, 0xc0, 0x0, 0x14, 0x0, 0x0, 0x8, 0x0,
    0x0, 0x8, 0x0, 0x0, 0x9, 0x0, 0x0, 0x2,
    0x0, 0x4, 0x3, 0x0, 0x2, 0x1, 0x80, 0x1,
    0x41, 0xfe, 0x40, 0xc0, 0xe6, 0xff, 0xd0, 0x30,
    0xb, 0xd0, 0x0,
    /* U+005B "[" */
    0x1f, 0xf8, 0xb0, 0x2, 0x80, 0xa, 0x0, 0x38,
    0x0, 0xe0, 0x3, 0x80, 0xe, 0x0, 0x34, 0x0,
    0xd0, 0x3, 0x40, 0xd, 0x0, 0x70, 0x1, 0xc0,
    0x7, 0x0, 0xf, 0xfd,
    /* U+005C "\\" */
    0x80, 0x3, 0x0, 0xa, 0x0, 0x1c, 0x0, 0x30,
    0x0, 0xd0, 0x2, 0x80, 0x3, 0x0, 0xd, 0x0,
    0x28, 0x0, 0x70, 0x0, 0xe0, 0x2, 0xc0, 0x7,
    0x80, 0xf, 0x0, 0xc,
    /* U+005D "]" */
    0x3e, 0xe0, 0x7, 0x0, 0x70, 0x7, 0x0, 0x70,
    0xb, 0x0, 0xb0, 0xb, 0x0, 0xf0, 0xe, 0x0,
    0xe0, 0xe, 0x0, 0xe0, 0xe, 0x0, 0xeb, 0xb8,
    /* U+005E "^" */
    0x0, 0x40, 0x0, 0x74, 0x0, 0x3f, 0x0, 0x19,
    0xd0, 0x1c, 0x2d, 0x1c, 0x2, 0xd0,
    /* U+005F "_" */
    0x0, 0x0, 0x0, 0xff, 0xff, 0xd0, 0x0, 0x0,
    0x0,
    /* U+0061 "a" */
    0xf, 0x9c, 0x3, 0x47, 0xc0, 0xb0, 0x38, 0x1e,
    0x3, 0x41, 0xe0, 0xb4, 0x8e, 0xf, 0x44, 0xb6,
    0x7a, 0x3, 0xd3, 0xc0,
    /* U+0062 "b" */
    0x9, 0x0, 0xb, 0x80, 0x3, 0x50, 0x1, 0xc4,
    0x0, 0xb4, 0x0, 0x2e, 0xf4, 0xf, 0xc7, 0x3,
    0xf8, 0xe9, 0xf2, 0xf8, 0x3c, 0xc, 0xf, 0x7,
    0x2, 0xc7, 0x0, 0x3e, 0x0, 0x0,
    /* U+0063 "c" */
    0xb, 0xc0, 0x34, 0xd0, 0xb0, 0xc1, 0xe0, 0x4,
    0xe0, 0x8, 0xf0, 0x20, 0xb4, 0x90, 0x2f, 0x40,
    /* U+0064 "d" */
    0x0, 0x6, 0x0, 0x0, 0xe0, 0x0, 0x1e, 0x0,
    0x2, 0xd0, 0x0, 0x2c, 0x0, 0xfb, 0xc0, 0x38,
    0x38, 0xb, 0x3, 0x81, 0xf0, 0x38, 0x2f, 0x7,
    0x48, 0xf0, 0xb4, 0x8b, 0x67, 0xa0, 0x3d, 0x3c,
    0x0,
    /* U+0065 "e" */
    0xf, 0xc0, 0x34, 0xd0, 0xb0, 0xc1, 0xe3, 0x85,
    0xf8, 0x8, 0xe0, 0x24, 0xb4, 0xa0, 0x2f, 0x40,
    /* U+0066 "f" */
    0x1, 0xc0, 0x3, 0x40, 0xb, 0x40, 0xe, 0x40,
    0xd, 0x40, 0x1d, 0x0, 0x3d, 0x0, 0x7d, 0x18,
    0x3f, 0xd0, 0x28, 0x80, 0x38, 0x80, 0x38, 0x80,
    0x38, 0x80, 0x38, 0x80, 0x38, 0x80, 0x38, 0x80,
    0x38, 0x80, 0x38, 0x80, 0x39, 0x0, 0x1e, 0x0,
    /* U+0067 "g" */
    0xf, 0x9c, 0x3, 0x43, 0xc0, 0xb0, 0x38, 0x4e,
    0x3, 0x84, 0xe0, 0x7a, 0xe, 0xb, 0xc0, 0xb6,
    0x34, 0x3, 0xd7, 0x40, 0x1, 0xb0, 0x0, 0x63,
    0x0, 0xc, 0x70, 0x2, 0x87, 0x0, 0x34, 0x70,
    0x3, 0x8e, 0x0, 0x1f, 0x80, 0x0,
    /* U+0068 "h" */
    0xe, 0x0, 0x2, 0xe0, 0x0, 0x36, 0x0, 0x7,
    0x60, 0x0, 0xb5, 0x0, 0xb, 0x8b, 0x0, 0xb5,
    0xf4, 0xf, 0x27, 0x41, 0xf8, 0x74, 0x4f, 0x47,
    0x8, 0xf0, 0x71, 0xf, 0xb, 0x60, 0xf0, 0x78,
    0x0,
    /* U+0069 "i" */
    0x34, 0x3, 0x40, 0x10, 0x0, 0x0, 0x30, 0xb,
    0x0, 0xf0, 0x4e, 0x8, 0xe1, 0x4e, 0x20, 0xe8,
    0xf, 0x40,
    /* U+006A "j" */
    0x0, 0x28, 0x0, 0xe, 0x0, 0x0, 0x0, 0x0,
    0x0, 0x0, 0x24, 0x0, 0x1d, 0x0, 0x7, 0x4,
    0x1, 0xc8, 0x0, 0xb5, 0x0, 0x2e, 0x0, 0xb,
    0x0, 0x3, 0x80, 0x2, 0xe0, 0x3, 0x38, 0x2,
    0x4e, 0x0, 0xc3, 0x40, 0xb0, 0xd0, 0x2c, 0x70,
    0x3, 0xf4, 0x0,
    /* U+006B "k" */
    0x18, 0x0, 0x38, 0x0, 0x78, 0x0, 0x74, 0x0,
    0x74, 0x0, 0xb0, 0xf0, 0xb2, 0xb4, 0xb8, 0x30,
    0xb8, 0x60, 0xb2, 0x80, 0xf3, 0x40, 0xf2, 0xc0,
    0xe0, 0xe0, 0x0, 0xb0, 0x0, 0x2d,
    /* U+006C "l" */
    0x1d, 0x3, 0x50, 0x75, 0x7, 0x40, 0xb8, 0xb,
    0x80, 0xf0, 0xf, 0x0, 0xe0, 0x8e, 0x4, 0xe2,
    0xf, 0x90, 0xb4, 0x0,
    /* U+006D "m" */
    0x24, 0xf0, 0xb0, 0xb, 0x6f, 0x2f, 0x0, 0xf1,
    0xb9, 0x70, 0xf, 0x8b, 0x47, 0x8, 0xf4, 0xb0,
    0xb0, 0x4f, 0xb, 0xb, 0x20, 0xf0, 0xb0, 0xb9,
    0xf, 0xb, 0x7, 0x80,
    /* U+006E "n" */
    0xd, 0x2c, 0x0, 0xf2, 0xf4, 0x3, 0xc9, 0xd0,
    0xf, 0x87, 0x8, 0x3c, 0x2c, 0x20, 0xf0, 0xb2,
    0x3, 0x82, 0xd4, 0xe, 0x7, 0x80,
    /* U+006F "o" */
    0x1f, 0xe0, 0x3, 0xd3, 0x80, 0xab, 0x2d, 0x8e,
    0x2f, 0xd0, 0xe0, 0x28, 0xf, 0x3, 0x40, 0x74,
    0xb0, 0x2, 0xf8, 0x0,
    /* U+0070 "p" */
    0xa, 0x7c, 0x7, 0xa7, 0x81, 0xe0, 0xb0, 0x78,
    0x1c, 0x1c, 0x7, 0x7, 0x2, 0x82, 0xc1, 0xc0,
    0xbb, 0xd0, 0x2c, 0x0, 0xe, 0x0, 0x3, 0x80,
    0x1, 0xe0, 0x0, 0x78, 0x0, 0x2d, 0x0, 0x6,
    0x0, 0x0,
    /* U+0071 "q" */
    0xf, 0x9c, 0x3, 0x43, 0xc0, 0xb0, 0x38, 0x4e,
    0x3, 0x44, 0xe0, 0xb5, 0xe, 0xf, 0x50, 0xb6,
    0xbc, 0x3, 0xd7, 0x80, 0x0, 0x70, 0x0, 0xb,
    0x0, 0x0, 0xb0, 0x0, 0xf, 0x0, 0x0, 0xf0,
    0x0, 0x1e, 0x0, 0x0, 0xc0, 0x0,
    /* U+0072 "r" */
    0xa0, 0x3, 0xc0, 0x7, 0x90, 0x3, 0x81, 0xd,
    0x20, 0x74, 0x41, 0xd8, 0x3, 0xc0,
    /* U+0073 "s" */
    0x2e, 0xb, 0x10, 0xe0, 0x1f, 0x14, 0x3c, 0x2,
    0xc0, 0x8c, 0xa, 0x80,
    /* U+0074 "t" */
    0x6, 0x0, 0x38, 0x0, 0xe0, 0x3, 0x40, 0x7e,
    0x90, 0x74, 0x1, 0xc0, 0x4b, 0x5, 0x2c, 0x20,
    0xb1, 0x42, 0xd8, 0x7, 0xc0,
    /* U+0075 "u" */
    0x34, 0x28, 0xf, 0x3, 0x40, 0xf0, 0x70, 0xe,
    0xb, 0x4, 0xe0, 0xf0, 0x8e, 0x1f, 0x20, 0xe6,
    0xb6, 0xb, 0x87, 0x80,
    /* U+0076 "v" */
    0x30, 0xe0, 0x2c, 0xa8, 0xf, 0x1e, 0x7, 0x82,
    0xf4, 0xf0, 0x10, 0x2c, 0x20, 0x7, 0x54, 0x0,
    0xf8, 0x0,
    /* U+0077 "w" */
    0x30, 0x7, 0x40, 0xb0, 0x4d, 0x80, 0xf0, 0xcf,
    0x85, 0xe1, 0xc3, 0xe4, 0xe2, 0xc1, 0x0, 0xe2,
    0xc2, 0x0, 0xb3, 0xd5, 0x0, 0x3c, 0xb8, 0x0,
    /* U+0078 "x" */
    0xc, 0xc, 0x2, 0xd2, 0x40, 0xf, 0x60, 0x0,
    0x7c, 0x8, 0x3, 0xc0, 0x40, 0x7d, 0x20, 0x1d,
    0xf5, 0x3, 0x83, 0x80,
    /* U+0079 "y" */
    0x34, 0x24, 0x3c, 0x1d, 0xf, 0x7, 0x7, 0x82,
    0xc8, 0xe0, 0xf8, 0x38, 0xad, 0xe, 0x5b, 0x2,
    0xe3, 0x80, 0x2, 0xe0, 0x3, 0x38, 0x2, 0x4e,
    0x0, 0xc3, 0x40, 0xb0, 0xd0, 0x2c, 0x70, 0x3,
    0xf4, 0x0,
    /* U+007A "z" */
    0xa0, 0x20, 0x3d, 0x1c, 0x7, 0xfd, 0x0, 0x8,
    0x5, 0x4, 0x2, 0xa, 0x1, 0x4b, 0xff, 0x83,
    0xb, 0x80,
    /* U+007B "{" */
    0x1, 0xd0, 0x34, 0x7, 0x0, 0xb0, 0xb, 0x0,
    0x70, 0xb, 0x2, 0xd0, 0x1d, 0x0, 0xb0, 0xf,
    0x0, 0xe0, 0xd, 0x0, 0xd0, 0xa, 0x0, 0x34,
    /* U+007C "|" */
    0x23, 0x33, 0x33, 0x66, 0x6a, 0xa9, 0x9d, 0xdc,
    0x80,
    /* U+007D "}" */
    0x28, 0x3, 0x80, 0xb0, 0x2c, 0xf, 0x3, 0x80,
    0xe0, 0x1e, 0xb, 0x43, 0x40, 0xd0, 0x34, 0xd,
    0x3, 0x41, 0xc1, 0xc0,
    /* U+007E "~" */
    0x2f, 0x42, 0xa7, 0xfe, 0x40, 0xb8,
    /* U+00C0 "À" */
    0x0, 0xc, 0x0, 0x0, 0xf, 0x0, 0x0, 0x2,
    0xc0, 0x0, 0x0, 0x0, 0x0, 0x6, 0x0, 0x0,
    0xf, 0x0, 0x0, 0x2b, 0x0, 0x0, 0x57, 0x0,
    0x0, 0xc7, 0x0, 0x1, 0x87, 0x0, 0x3, 0x7,
    0x40, 0x3, 0x7, 0x40, 0x3f, 0xff, 0x82, 0x1c,
    0x3, 0x45, 0x28, 0x3, 0x48, 0x74, 0x3, 0xa0,
    0xb0, 0x3, 0xd0,
    /* U+00C2 "Â" */
    0x0, 0x3, 0x0, 0x0, 0x2, 0xd0, 0x0, 0x2,
    0x5c, 0x0, 0x0, 0x1, 0x40, 0x0, 0x6, 0x0,
    0x0, 0x3, 0xc0, 0x0, 0x2, 0xb0, 0x0, 0x1,
    0x5c, 0x0, 0x0, 0xc7, 0x0, 0x0, 0x61, 0xc0,
    0x0, 0x30, 0x74, 0x0, 0xc, 0x1d, 0x0, 0x3f,
    0xff, 0x82, 0x7, 0x0, 0xd1, 0x42, 0x80, 0x34,
    0x81, 0xd0, 0xe, 0x80, 0xb0, 0x3, 0xd0, 0x0,
    /* U+00C4 "Ä" */
    0x0, 0x24, 0xa0, 0x0, 0xe, 0x3c, 0x0, 0x0,
    0x0, 0x0, 0x0, 0x18, 0x0, 0x0, 0xf, 0x0,
    0x0, 0xa, 0xc0, 0x0, 0x5, 0x70, 0x0, 0x3,
    0x1c, 0x0, 0x1, 0x87, 0x0, 0x0, 0xc1, 0xd0,
    0x0, 0x30, 0x74, 0x0, 0xff, 0xfe, 0x8, 0x1c,
    0x3, 0x45, 0xa, 0x0, 0xd2, 0x7, 0x40, 0x3a,
    0x2, 0xc0, 0xf, 0x40,
    /* U+00C6 "Æ" */
    0x0, 0x6, 0x6, 0xa0, 0x0, 0x0, 0xf3, 0x43,
    0x80, 0x0, 0x27, 0xe0, 0x24, 0x0, 0x5, 0x7d,
    0x0, 0x0, 0x0, 0xc7, 0xd0, 0x0, 0x0, 0x14,
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    0xe0, 0x24, 0x0, 0x0, 0xb, 0xf8, 0x0,
    /* U+00C7 "Ç" */
    0x0, 0xaf, 0x40, 0xd, 0xb, 0x0, 0xd0, 0x1c,
    0xf, 0x0, 0xe0, 0x74, 0x2, 0x2, 0xc0, 0x0,
    0xf, 0x0, 0x0, 0x38, 0x0, 0x1, 0xf0, 0x0,
    0x23, 0xc0, 0x0, 0x87, 0x80, 0xc, 0xf, 0x92,
    0xc0, 0xb, 0xf4, 0x0, 0x2, 0x0, 0x0, 0xd,
    0x0, 0x0, 0xa0, 0x0,
    /* U+00C8 "È" */
    0x0, 0x30, 0x0, 0x0, 0xe0, 0x0, 0x0, 0xb0,
    0x0, 0x0, 0x0, 0x0, 0xaa, 0x0, 0x1d, 0xf,
    0x0, 0xe0, 0x2c, 0x7, 0x40, 0x0, 0xd, 0x0,
    0x0, 0x2e, 0xb0, 0x0, 0xda, 0x80, 0xe, 0x0,
    0x1, 0x74, 0x0, 0x9, 0xd0, 0x0, 0x87, 0xc0,
    0x5, 0xf, 0x80, 0xa0, 0xb, 0xf9, 0x0,
    /* U+00C9 "É" */
    0x0, 0x5, 0x0, 0x0, 0x28, 0x0, 0x0, 0xc0,
    0x0, 0x4, 0x0, 0x0, 0x0, 0x0, 0x2, 0xa8,
    0x0, 0x74, 0x3c, 0x3, 0x80, 0xb0, 0x1d, 0x0,
    0x0, 0x34, 0x0, 0x0, 0xba, 0xc0, 0x3, 0x6a,
    0x0, 0x38, 0x0, 0x5, 0xd0, 0x0, 0x27, 0x40,
    0x2, 0x1f, 0x0, 0x14, 0x3e, 0x2, 0x80, 0x2f,
    0xe4, 0x0,
    /* U+00CA "Ê" */
    0x0, 0xc, 0x0, 0x0, 0xb4, 0x0, 0x9, 0x34,
    0x0, 0x0, 0x0, 0x0, 0xaa, 0x0, 0x1d, 0xf,
    0x0, 0xe0, 0x2c, 0x7, 0x40, 0x0, 0xd, 0x0,
    0x0, 0x2e, 0xb0, 0x0, 0xda, 0x80, 0xe, 0x0,
    0x1, 0x74, 0x0, 0x9, 0xd0, 0x0, 0x87, 0xc0,
    0x5, 0xf, 0x80, 0xa0, 0xb, 0xf9, 0x0,
    /* U+00CB "Ë" */
    0x0, 0x92, 0x80, 0x3, 0x8e, 0x0, 0x0, 0x0,
    0x0, 0x0, 0x0, 0x0, 0xaa, 0x0, 0x1d, 0xf,
    0x0, 0xe0, 0x2c, 0x7, 0x40, 0x0, 0xd, 0x0,
    0x0, 0x2e, 0xb0, 0x0, 0xda, 0x80, 0xe, 0x0,
    0x1, 0x74, 0x0, 0x9, 0xd0, 0x0, 0x87, 0xc0,
    0x5, 0xf, 0x80, 0xa0, 0xb, 0xf9, 0x0,
    /* U+00CE "Î" */
    0x0, 0x0, 0x0, 0x0, 0xf0, 0x0, 0x2b, 0x80,
    0x1, 0x4, 0x0, 0x0, 0x0, 0x0, 0x1d, 0x0,
    0x3, 0x90, 0x6, 0xf4, 0x3, 0x87, 0x0, 0x70,
    0x70, 0x6, 0x7, 0x0, 0x0, 0x70, 0x0, 0x7,
    0x0, 0x0, 0xb0, 0x0, 0xb, 0x3, 0x0, 0xd0,
    0x70, 0x38, 0x2, 0xfd, 0x0,
    /* U+00CF "Ï" */
    0x0, 0x92, 0x80, 0xd, 0x38, 0x0, 0x0, 0x0,
    0x0, 0x0, 0x0, 0x1, 0xd0, 0x0, 0x39, 0x0,
    0x6f, 0x40, 0x38, 0x70, 0x7, 0x7, 0x0, 0x60,
    0x70, 0x0, 0x7, 0x0, 0x0, 0x70, 0x0, 0xb,
    0x0, 0x0, 0xb0, 0x30, 0xd, 0x7, 0x3, 0x80,
    0x2f, 0xd0, 0x0,
    /* U+00D4 "Ô" */
    0x0, 0x3, 0x0, 0x0, 0x0, 0x2c, 0x0, 0x0,
    0x2, 0x5c, 0x0, 0x0, 0x0, 0x10, 0x0, 0x0,
    0x7f, 0xd0, 0x0, 0xb, 0xe3, 0xd0, 0x0, 0x34,
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    0x7, 0xd0, 0x74, 0x0, 0x7, 0xfe, 0x0, 0x0,
    /* U+00D6 "Ö" */
    0x0, 0x74, 0xd0, 0x0, 0x1, 0x82, 0x40, 0x0,
    0x0, 0x0, 0x0, 0x0, 0x1f, 0xf4, 0x0, 0x2,
    0xf8, 0xf4, 0x0, 0xd, 0x0, 0xf0, 0x0, 0xa0,
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    0x1, 0xff, 0x80, 0x0,
    /* U+00DB "Û" */
    0x0, 0xc, 0x0, 0x0, 0xb, 0x40, 0x0, 0x9,
    0x70, 0x0, 0x0, 0x5, 0x0, 0xe, 0x0, 0x70,
    0xa, 0xc0, 0x3c, 0x8, 0xa0, 0xf, 0x2, 0x38,
    0x3, 0xc0, 0xe, 0x0, 0xe0, 0x3, 0x40, 0x74,
    0x0, 0xd0, 0x1c, 0x0, 0x34, 0x7, 0x1, 0x1c,
    0x2, 0xc1, 0x7, 0x40, 0xf0, 0x80, 0xd0, 0xac,
    0x80, 0x3c, 0x8b, 0x60, 0x7, 0xc2, 0xe0, 0x0,
    /* U+00DC "Ü" */
    0x0, 0x92, 0x40, 0x0, 0x74, 0xe0, 0x0, 0x0,
    0x0, 0x0, 0x38, 0x1, 0xc0, 0x2b, 0x0, 0xf0,
    0x22, 0x80, 0x3c, 0x8, 0xe0, 0xf, 0x0, 0x38,
    0x3, 0x80, 0xd, 0x1, 0xd0, 0x3, 0x40, 0x70,
    0x0, 0xd0, 0x1c, 0x4, 0x70, 0xb, 0x4, 0x1d,
    0x3, 0xc2, 0x3, 0x42, 0xb2, 0x0, 0xf2, 0x2d,
    0x80, 0x1f, 0xb, 0x80,
    /* U+00E0 "à" */
    0x1, 0x0, 0x0, 0xb0, 0x0, 0x3, 0x80, 0x0,
    0xb, 0x0, 0x0, 0x0, 0x0, 0xf9, 0xc0, 0x34,
    0x7c, 0xb, 0x3, 0x81, 0xe0, 0x34, 0x1e, 0xb,
    0x48, 0xe0, 0xf4, 0x4b, 0x67, 0xa0, 0x3d, 0x3c,
    0x0,
    /* U+00E2 "â" */
    0x0, 0x40, 0x0, 0x2c, 0x0, 0x2, 0xd0, 0x0,
    0x43, 0x40, 0x0, 0x0, 0x0, 0xf9, 0xc0, 0x34,
    0x7c, 0xb, 0x3, 0x81, 0xe0, 0x34, 0x1e, 0xb,
    0x48, 0xe0, 0xf4, 0x4b, 0x67, 0xa0, 0x3d, 0x3c,
    0x0,
    /* U+00E4 "ä" */
    0xa, 0x28, 0x0, 0xe3, 0xc0, 0x0, 0x0, 0x0,
    0x0, 0x0, 0xf, 0x9c, 0x3, 0x47, 0xc0, 0xb0,
    0x38, 0x1e, 0x3, 0x41, 0xe0, 0xb4, 0x8e, 0xf,
    0x44, 0xb6, 0x7a, 0x3, 0xd3, 0xc0,
    /* U+00E6 "æ" */
    0xb, 0xcb, 0xc0, 0x38, 0x38, 0xc0, 0x70, 0x34,
    0xc1, 0xa0, 0x72, 0x42, 0xe0, 0x76, 0x5, 0xb0,
    0x7c, 0x8, 0x74, 0xbc, 0x70, 0x2f, 0x5f, 0x80,
    /* U+00E7 "ç" */
    0xb, 0xc0, 0x34, 0xd0, 0xb0, 0xc1, 0xe0, 0x4,
    0xe0, 0x8, 0xe0, 0x24, 0xb4, 0xa0, 0x3f, 0x80,
    0xc, 0x0, 0x6, 0x0, 0x2c, 0x0,
    /* U+00E8 "è" */
    0x0, 0x0, 0xe, 0x0, 0xb, 0x0, 0x1, 0xd0,
    0x0, 0x0, 0xf, 0xc0, 0x34, 0xd0, 0xb0, 0xc1,
    0xe3, 0x85, 0xf8, 0x8, 0xe0, 0x24, 0xb4, 0xa0,
    0x2f, 0x40,
    /* U+00E9 "é" */
    0x0, 0x40, 0x0, 0xd0, 0x1, 0xc0, 0x6, 0x0,
    0x0, 0x0, 0xf, 0xc0, 0x34, 0xd0, 0xb0, 0xc1,
    0xe3, 0x85, 0xf8, 0x8, 0xe0, 0x24, 0xb4, 0xa0,
    0x2f, 0x40,
    /* U+00EA "ê" */
    0x0, 0x0, 0x3, 0x80, 0x6, 0xd0, 0x4, 0x10,
    0x0, 0x0, 0xf, 0xc0, 0x34, 0xd0, 0xb0, 0xc1,
    0xe3, 0x85, 0xf8, 0x8, 0xe0, 0x24, 0xb4, 0xa0,
    0x2f, 0x40,
    /* U+00EB "ë" */
    0x18, 0x60, 0x2c, 0x70, 0x0, 0x0, 0x0, 0x0,
    0xf, 0xc0, 0x34, 0xd0, 0xb0, 0xc1, 0xe3, 0x85,
    0xf8, 0x8, 0xe0, 0x24, 0xb4, 0xa0, 0x2f, 0x40,
    /* U+00EE "î" */
    0x0, 0x0, 0x38, 0x2, 0xb4, 0x10, 0x10, 0x0,
    0x0, 0x30, 0x2, 0xc0, 0xf, 0x4, 0x38, 0x20,
    0xe1, 0x43, 0x88, 0xe, 0x80, 0x3d, 0x0,
    /* U+00EF "ï" */
    0x61, 0x82, 0xcb, 0x0, 0x0, 0x0, 0x0, 0xc,
    0x0, 0xb0, 0x3, 0xc1, 0xe, 0x8, 0x38, 0x50,
    0xe2, 0x3, 0xa0, 0xf, 0x40,
    /* U+00F4 "ô" */
    0x0, 0x40, 0x0, 0x1c, 0x0, 0x2, 0xa0, 0x0,
    0x41, 0x0, 0x0, 0x0, 0x1, 0xfe, 0x0, 0x3d,
    0x38, 0xa, 0xb2, 0xd8, 0xe2, 0xfd, 0xe, 0x2,
    0x80, 0xf0, 0x34, 0x7, 0x4b, 0x0, 0x2f, 0x80,
    0x0,
    /* U+00F6 "ö" */
    0x9, 0x24, 0x0, 0xd3, 0x80, 0x0, 0x0, 0x0,
    0x0, 0x0, 0x1f, 0xe0, 0x3, 0xd3, 0x80, 0xab,
    0x2d, 0x8e, 0x2f, 0xd0, 0xe0, 0x28, 0xf, 0x3,
    0x40, 0x74, 0xb0, 0x2, 0xf8, 0x0,
    /* U+00FB "û" */
    0x0, 0x40, 0x0, 0x2c, 0x0, 0x6, 0xe0, 0x0,
    0x41, 0x0, 0x0, 0x0, 0x3, 0x42, 0x80, 0xf0,
    0x34, 0xf, 0x7, 0x0, 0xe0, 0xb0, 0x4e, 0xf,
    0x8, 0xe1, 0xf2, 0xe, 0x6b, 0x60, 0xb8, 0x78,
    0x0,
    /* U+00FC "ü" */
    0x18, 0x20, 0x2, 0xc7, 0x40, 0x0, 0x0, 0x0,
    0x0, 0x0, 0x34, 0x28, 0xf, 0x3, 0x40, 0xf0,
    0x70, 0xe, 0xb, 0x4, 0xe0, 0xf0, 0x8e, 0x1f,
    0x20, 0xe6, 0xb6, 0xb, 0x87, 0x80,
    /* U+00FF "ÿ" */
    0x18, 0x20, 0xb, 0x1d, 0x0, 0x0, 0x0, 0x0,
    0x0, 0x34, 0x24, 0x3c, 0x1d, 0xf, 0x7, 0x7,
    0x82, 0xc8, 0xe0, 0xf8, 0x38, 0xad, 0xe, 0x5b,
    0x2, 0xe3, 0x80, 0x2, 0xe0, 0x3, 0x38, 0x2,
    0x4e, 0x0, 0xc3, 0x40, 0xb0, 0xd0, 0x2c, 0x70,
    0x3, 0xf4, 0x0,
    /* U+0152 "Œ" */
    0x0, 0xbf, 0x80, 0xa, 0xe0, 0x0, 0xee, 0x2d,
    0x2d, 0x1c, 0x0, 0x78, 0x3, 0xde, 0x1d, 0x0,
    0x3d, 0x0, 0x7f, 0xb8, 0x0, 0x2f, 0xe0, 0xf,
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    0xfe, 0x0, 0xbf, 0x90, 0x0,
    /* U+0153 "œ" */
    0xb, 0xf4, 0xbc, 0x2, 0xf1, 0xf4, 0xd0, 0x37,
    0xf, 0xc, 0x17, 0x34, 0xe3, 0x41, 0x71, 0xdf,
    0x80, 0x87, 0x42, 0xf0, 0x14, 0x3c, 0x3b, 0x86,
    0x1, 0xfd, 0x2f, 0x80,
    /* U+0178 "Ÿ" */
    0x0, 0xb2, 0xc0, 0x0, 0xa2, 0x80, 0x0, 0x0,
    0x0, 0xe, 0x0, 0x18, 0x2b, 0x0, 0x3c, 0x8b,
    0x0, 0x78, 0x8b, 0x0, 0x74, 0xe, 0x0, 0xb0,
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    0xd3, 0x80, 0x0, 0xbe, 0x0
};
/*---------------------
 *  GLYPH DESCRIPTION
 *--------------------*/
static const lv_font_fmt_txt_glyph_dsc_t cursive_24_glyph_dsc[] = {
    {.bitmap_index = 0, .adv_w = 0, .box_w = 0, .box_h = 0, .ofs_x = 0, .ofs_y = 0} /* id = 0 reserved */,
    {.bitmap_index = 0, .adv_w = 70, .box_w = 0, .box_h = 0, .ofs_x = 0, .ofs_y = 0},
    {.bitmap_index = 0, .adv_w = 89, .box_w = 4, .box_h = 13, .ofs_x = 1, .ofs_y = 0},
    {.bitmap_index = 13, .adv_w = 87, .box_w = 5, .box_h = 5, .ofs_x = 0, .ofs_y = 8},
    {.bitmap_index = 20, .adv_w = 201, .box_w = 12, .box_h = 13, .ofs_x = 0, .ofs_y = 0},
    {.bitmap_index = 59, .adv_w = 169, .box_w = 10, .box_h = 16, .ofs_x = 0, .ofs_y = -2},
    {.bitmap_index = 99, .adv_w = 183, .box_w = 11, .box_h = 13, .ofs_x = 0, .ofs_y = 0},
    {.bitmap_index = 135, .adv_w = 187, .box_w = 14, .box_h = 14, .ofs_x = 0, .ofs_y = -1},
    {.bitmap_index = 184, .adv_w = 46, .box_w = 2, .box_h = 5, .ofs_x = 0, .ofs_y = 8},
    {.bitmap_index = 187, .adv_w = 96, .box_w = 5, .box_h = 16, .ofs_x = 1, .ofs_y = -3},
    {.bitmap_index = 207, .adv_w = 91, .box_w = 5, .box_h = 16, .ofs_x = 0, .ofs_y = -3},
    {.bitmap_index = 227, .adv_w = 131, .box_w = 8, .box_h = 7, .ofs_x = 0, .ofs_y = 7},
    {.bitmap_index = 241, .adv_w = 142, .box_w = 7, .box_h = 8, .ofs_x = 1, .ofs_y = 1},
    {.bitmap_index = 255, .adv_w = 54, .box_w = 3, .box_h = 4, .ofs_x = 0, .ofs_y = -2},
    {.bitmap_index = 258, .adv_w = 101, .box_w = 7, .box_h = 3, .ofs_x = -1, .ofs_y = 4},
    {.bitmap_index = 264, .adv_w = 63, .box_w = 3, .box_h = 2, .ofs_x = 0, .ofs_y = 0},
    {.bitmap_index = 266, .adv_w = 96, .box_w = 7, .box_h = 16, .ofs_x = -1, .ofs_y = -3},
    {.bitmap_index = 294, .adv_w = 164, .box_w = 10, .box_h = 12, .ofs_x = 0, .ofs_y = 0},
    {.bitmap_index = 324, .adv_w = 110, .box_w = 6, .box_h = 13, .ofs_x = 0, .ofs_y = 0},
    {.bitmap_index = 344, .adv_w = 146, .box_w = 9, .box_h = 12, .ofs_x = 0, .ofs_y = 0},
    {.bitmap_index = 371, .adv_w = 142, .box_w = 9, .box_h = 14, .ofs_x = 0, .ofs_y = 0},
    {.bitmap_index = 403, .adv_w = 155, .box_w = 10, .box_h = 13, .ofs_x = 0, .ofs_y = 0},
    {.bitmap_index = 436, .adv_w = 138, .box_w = 8, .box_h = 13, .ofs_x = 0, .ofs_y = 0},
    {.bitmap_index = 462, .adv_w = 157, .box_w = 9, .box_h = 13, .ofs_x = 0, .ofs_y = 0},
    {.bitmap_index = 492, .adv_w = 125, .box_w = 9, .box_h = 14, .ofs_x = 0, .ofs_y = 0},
    {.bitmap_index = 524, .adv_w = 143, .box_w = 9, .box_h = 13, .ofs_x = 0, .ofs_y = 0},
    {.bitmap_index = 554, .adv_w = 151, .box_w = 9, .box_h = 13, .ofs_x = 0, .ofs_y = 0},
    {.bitmap_index = 584, .adv_w = 72, .box_w = 3, .box_h = 8, .ofs_x = 1, .ofs_y = 0},
    {.bitmap_index = 590, .adv_w = 71, .box_w = 3, .box_h = 11, .ofs_x = 1, .ofs_y = -3},
    {.bitmap_index = 599, .adv_w = 156, .box_w = 9, .box_h = 7, .ofs_x = 0, .ofs_y = 2},
    {.bitmap_index = 615, .adv_w = 180, .box_w = 9, .box_h = 7, .ofs_x = 1, .ofs_y = 2},
    {.bitmap_index = 631, .adv_w = 159, .box_w = 9, .box_h = 8, .ofs_x = 0, .ofs_y = 2},
    {.bitmap_index = 649, .adv_w = 136, .box_w = 8, .box_h = 13, .ofs_x = 0, .ofs_y = 0},
    {.bitmap_index = 675, .adv_w = 256, .box_w = 16, .box_h = 17, .ofs_x = 0, .ofs_y = -5},
    {.bitmap_index = 743, .adv_w = 176, .box_w = 13, .box_h = 13, .ofs_x = 0, .ofs_y = 0},
    {.bitmap_index = 786, .adv_w = 178, .box_w = 11, .box_h = 13, .ofs_x = 0, .ofs_y = 0},
    {.bitmap_index = 822, .adv_w = 145, .box_w = 11, .box_h = 13, .ofs_x = 0, .ofs_y = 0},
    {.bitmap_index = 858, .adv_w = 230, .box_w = 14, .box_h = 15, .ofs_x = 0, .ofs_y = -1},
    {.bitmap_index = 911, .adv_w = 153, .box_w = 11, .box_h = 13, .ofs_x = 0, .ofs_y = 0},
    {.bitmap_index = 947, .adv_w = 144, .box_w = 11, .box_h = 14, .ofs_x = 0, .ofs_y = -1},
    {.bitmap_index = 986, .adv_w = 194, .box_w = 14, .box_h = 13, .ofs_x = 0, .ofs_y = 0},
    {.bitmap_index = 1032, .adv_w = 194, .box_w = 13, .box_h = 16, .ofs_x = 0, .ofs_y = -1},
    {.bitmap_index = 1084, .adv_w = 151, .box_w = 10, .box_h = 13, .ofs_x = 0, .ofs_y = 0},
    {.bitmap_index = 1117, .adv_w = 146, .box_w = 11, .box_h = 20, .ofs_x = 0, .ofs_y = -7},
    {.bitmap_index = 1172, .adv_w = 230, .box_w = 15, .box_h = 15, .ofs_x = 0, .ofs_y = -2},
    {.bitmap_index = 1229, .adv_w = 170, .box_w = 11, .box_h = 13, .ofs_x = 0, .ofs_y = 0},
    {.bitmap_index = 1265, .adv_w = 229, .box_w = 15, .box_h = 15, .ofs_x = 0, .ofs_y = 0},
    {.bitmap_index = 1322, .adv_w = 175, .box_w = 13, .box_h = 13, .ofs_x = 0, .ofs_y = 0},
    {.bitmap_index = 1365, .adv_w = 206, .box_w = 15, .box_h = 13, .ofs_x = 0, .ofs_y = 0},
    {.bitmap_index = 1414, .adv_w = 195, .box_w = 12, .box_h = 15, .ofs_x = 0, .ofs_y = 0},
    {.bitmap_index = 1459, .adv_w = 211, .box_w = 13, .box_h = 15, .ofs_x = 0, .ofs_y = -2},
    {.bitmap_index = 1508, .adv_w = 206, .box_w = 14, .box_h = 17, .ofs_x = 0, .ofs_y = -2},
    {.bitmap_index = 1568, .adv_w = 169, .box_w = 10, .box_h = 13, .ofs_x = 0, .ofs_y = 0},
    {.bitmap_index = 1601, .adv_w = 148, .box_w = 15, .box_h = 13, .ofs_x = 0, .ofs_y = 0},
    {.bitmap_index = 1650, .adv_w = 179, .box_w = 13, .box_h = 13, .ofs_x = 0, .ofs_y = 0},
    {.bitmap_index = 1693, .adv_w = 178, .box_w = 11, .box_h = 16, .ofs_x = 0, .ofs_y = 0},
    {.bitmap_index = 1737, .adv_w = 243, .box_w = 15, .box_h = 13, .ofs_x = 0, .ofs_y = 0},
    {.bitmap_index = 1786, .adv_w = 184, .box_w = 13, .box_h = 13, .ofs_x = 0, .ofs_y = 0},
    {.bitmap_index = 1829, .adv_w = 183, .box_w = 12, .box_h = 20, .ofs_x = 0, .ofs_y = -7},
    {.bitmap_index = 1889, .adv_w = 176, .box_w = 13, .box_h = 13, .ofs_x = 0, .ofs_y = 0},
    {.bitmap_index = 1932, .adv_w = 131, .box_w = 7, .box_h = 16, .ofs_x = 1, .ofs_y = -3},
    {.bitmap_index = 1960, .adv_w = 96, .box_w = 7, .box_h = 16, .ofs_x = 0, .ofs_y = -3},
    {.bitmap_index = 1988, .adv_w = 118, .box_w = 6, .box_h = 16, .ofs_x = 0, .ofs_y = -3},
    {.bitmap_index = 2012, .adv_w = 189, .box_w = 9, .box_h = 6, .ofs_x = 1, .ofs_y = 9},
    {.bitmap_index = 2026, .adv_w = 162, .box_w = 11, .box_h = 3, .ofs_x = -1, .ofs_y = -3},
    {.bitmap_index = 2035, .adv_w = 135, .box_w = 10, .box_h = 8, .ofs_x = 0, .ofs_y = 0},
    {.bitmap_index = 2055, .adv_w = 126, .box_w = 9, .box_h = 13, .ofs_x = 0, .ofs_y = 0},
    {.bitmap_index = 2085, .adv_w = 101, .box_w = 8, .box_h = 8, .ofs_x = 0, .ofs_y = 0},
    {.bitmap_index = 2101, .adv_w = 139, .box_w = 10, .box_h = 13, .ofs_x = 0, .ofs_y = 0},
    {.bitmap_index = 2134, .adv_w = 103, .box_w = 8, .box_h = 8, .ofs_x = 0, .ofs_y = 0},
    {.bitmap_index = 2150, .adv_w = 80, .box_w = 8, .box_h = 20, .ofs_x = -1, .ofs_y = -7},
    {.bitmap_index = 2190, .adv_w = 131, .box_w = 10, .box_h = 15, .ofs_x = 0, .ofs_y = -7},
    {.bitmap_index = 2228, .adv_w = 131, .box_w = 10, .box_h = 13, .ofs_x = 0, .ofs_y = 0},
    {.bitmap_index = 2261, .adv_w = 62, .box_w = 6, .box_h = 12, .ofs_x = 0, .ofs_y = 0},
    {.bitmap_index = 2279, .adv_w = 59, .box_w = 9, .box_h = 19, .ofs_x = -4, .ofs_y = -7},
    {.bitmap_index = 2322, .adv_w = 121, .box_w = 8, .box_h = 15, .ofs_x = 0, .ofs_y = -2},
    {.bitmap_index = 2352, .adv_w = 62, .box_w = 6, .box_h = 13, .ofs_x = 0, .ofs_y = 0},
    {.bitmap_index = 2372, .adv_w = 191, .box_w = 14, .box_h = 8, .ofs_x = 0, .ofs_y = 0},
    {.bitmap_index = 2400, .adv_w = 131, .box_w = 11, .box_h = 8, .ofs_x = -1, .ofs_y = 0},
    {.bitmap_index = 2422, .adv_w = 128, .box_w = 10, .box_h = 8, .ofs_x = 0, .ofs_y = 0},
    {.bitmap_index = 2442, .adv_w = 127, .box_w = 9, .box_h = 15, .ofs_x = -1, .ofs_y = -7},
    {.bitmap_index = 2476, .adv_w = 133, .box_w = 10, .box_h = 15, .ofs_x = 0, .ofs_y = -7},
    {.bitmap_index = 2514, .adv_w = 90, .box_w = 7, .box_h = 8, .ofs_x = 0, .ofs_y = 0},
    {.bitmap_index = 2528, .adv_w = 73, .box_w = 6, .box_h = 8, .ofs_x = 0, .ofs_y = 0},
    {.bitmap_index = 2540, .adv_w = 71, .box_w = 7, .box_h = 12, .ofs_x = -1, .ofs_y = 0},
    {.bitmap_index = 2561, .adv_w = 128, .box_w = 10, .box_h = 8, .ofs_x = 0, .ofs_y = 0},
    {.bitmap_index = 2581, .adv_w = 123, .box_w = 9, .box_h = 8, .ofs_x = 0, .ofs_y = 0},
    {.bitmap_index = 2599, .adv_w = 164, .box_w = 12, .box_h = 8, .ofs_x = 0, .ofs_y = 0},
    {.bitmap_index = 2623, .adv_w = 111, .box_w = 10, .box_h = 8, .ofs_x = -1, .ofs_y = 0},
    {.bitmap_index = 2643, .adv_w = 123, .box_w = 9, .box_h = 15, .ofs_x = 0, .ofs_y = -7},
    {.bitmap_index = 2677, .adv_w = 120, .box_w = 9, .box_h = 8, .ofs_x = 0, .ofs_y = 0},
    {.bitmap_index = 2695, .adv_w = 104, .box_w = 6, .box_h = 16, .ofs_x = 0, .ofs_y = -3},
    {.bitmap_index = 2719, .adv_w = 67, .box_w = 2, .box_h = 17, .ofs_x = 1, .ofs_y = -4},
    {.bitmap_index = 2728, .adv_w = 96, .box_w = 5, .box_h = 16, .ofs_x = 0, .ofs_y = -3},
    {.bitmap_index = 2748, .adv_w = 160, .box_w = 8, .box_h = 3, .ofs_x = 1, .ofs_y = 4},
    {.bitmap_index = 2754, .adv_w = 176, .box_w = 12, .box_h = 17, .ofs_x = 0, .ofs_y = 0},
    {.bitmap_index = 2805, .adv_w = 176, .box_w = 13, .box_h = 17, .ofs_x = 0, .ofs_y = 0},
    {.bitmap_index = 2861, .adv_w = 176, .box_w = 13, .box_h = 16, .ofs_x = 0, .ofs_y = 0},
    {.bitmap_index = 2913, .adv_w = 257, .box_w = 18, .box_h = 14, .ofs_x = 0, .ofs_y = -1},
    {.bitmap_index = 2976, .adv_w = 145, .box_w = 11, .box_h = 16, .ofs_x = 0, .ofs_y = -3},
    {.bitmap_index = 3020, .adv_w = 156, .box_w = 11, .box_h = 17, .ofs_x = 0, .ofs_y = 0},
    {.bitmap_index = 3067, .adv_w = 156, .box_w = 11, .box_h = 18, .ofs_x = 0, .ofs_y = 0},
    {.bitmap_index = 3117, .adv_w = 156, .box_w = 11, .box_h = 17, .ofs_x = 0, .ofs_y = 0},
    {.bitmap_index = 3164, .adv_w = 156, .box_w = 11, .box_h = 17, .ofs_x = 0, .ofs_y = 0},
    {.bitmap_index = 3211, .adv_w = 151, .box_w = 10, .box_h = 18, .ofs_x = 0, .ofs_y = 0},
    {.bitmap_index = 3256, .adv_w = 151, .box_w = 10, .box_h = 17, .ofs_x = 0, .ofs_y = 0},
    {.bitmap_index = 3299, .adv_w = 207, .box_w = 15, .box_h = 17, .ofs_x = 0, .ofs_y = 0},
    {.bitmap_index = 3363, .adv_w = 208, .box_w = 15, .box_h = 16, .ofs_x = 0, .ofs_y = 0},
    {.bitmap_index = 3423, .adv_w = 183, .box_w = 13, .box_h = 17, .ofs_x = 0, .ofs_y = 0},
    {.bitmap_index = 3479, .adv_w = 183, .box_w = 13, .box_h = 16, .ofs_x = 0, .ofs_y = 0},
    {.bitmap_index = 3531, .adv_w = 135, .box_w = 10, .box_h = 13, .ofs_x = 0, .ofs_y = 0},
    {.bitmap_index = 3564, .adv_w = 135, .box_w = 10, .box_h = 13, .ofs_x = 0, .ofs_y = 0},
    {.bitmap_index = 3597, .adv_w = 135, .box_w = 10, .box_h = 12, .ofs_x = 0, .ofs_y = 0},
    {.bitmap_index = 3627, .adv_w = 169, .box_w = 12, .box_h = 8, .ofs_x = 0, .ofs_y = 0},
    {.bitmap_index = 3651, .adv_w = 101, .box_w = 8, .box_h = 11, .ofs_x = 0, .ofs_y = -3},
    {.bitmap_index = 3673, .adv_w = 103, .box_w = 8, .box_h = 13, .ofs_x = 0, .ofs_y = 0},
    {.bitmap_index = 3699, .adv_w = 103, .box_w = 8, .box_h = 13, .ofs_x = 0, .ofs_y = 0},
    {.bitmap_index = 3725, .adv_w = 103, .box_w = 8, .box_h = 13, .ofs_x = 0, .ofs_y = 0},
    {.bitmap_index = 3751, .adv_w = 103, .box_w = 8, .box_h = 12, .ofs_x = 0, .ofs_y = 0},
    {.bitmap_index = 3775, .adv_w = 62, .box_w = 7, .box_h = 13, .ofs_x = -1, .ofs_y = 0},
    {.bitmap_index = 3798, .adv_w = 62, .box_w = 7, .box_h = 12, .ofs_x = -1, .ofs_y = 0},
    {.bitmap_index = 3819, .adv_w = 128, .box_w = 10, .box_h = 13, .ofs_x = 0, .ofs_y = 0},
    {.bitmap_index = 3852, .adv_w = 128, .box_w = 10, .box_h = 12, .ofs_x = 0, .ofs_y = 0},
    {.bitmap_index = 3882, .adv_w = 128, .box_w = 10, .box_h = 13, .ofs_x = 0, .ofs_y = 0},
    {.bitmap_index = 3915, .adv_w = 128, .box_w = 10, .box_h = 12, .ofs_x = 0, .ofs_y = 0},
    {.bitmap_index = 3945, .adv_w = 123, .box_w = 9, .box_h = 19, .ofs_x = 0, .ofs_y = -7},
    {.bitmap_index = 3988, .adv_w = 315, .box_w = 21, .box_h = 13, .ofs_x = 0, .ofs_y = 0},
    {.bitmap_index = 4057, .adv_w = 181, .box_w = 14, .box_h = 8, .ofs_x = -1, .ofs_y = 0},
    {.bitmap_index = 4085, .adv_w = 183, .box_w = 12, .box_h = 23, .ofs_x = 0, .ofs_y = -7}
};
/*---------------------
 *  CHARACTER MAPPING
 *--------------------*/
static const uint16_t cursive_24_unicode_list_2[] = {
    0x0, 0x2, 0x4, 0x6, 0x7, 0x8, 0x9, 0xa,
    0xb, 0xe, 0xf, 0x14, 0x16, 0x1b, 0x1c, 0x20,
    0x22, 0x24, 0x26, 0x27, 0x28, 0x29, 0x2a, 0x2b,
    0x2e, 0x2f, 0x34, 0x36, 0x3b, 0x3c, 0x3f, 0x92,
    0x93, 0xb8
};
/*Collect the unicode lists and glyph_id offsets*/
static const lv_font_fmt_txt_cmap_t cursive_24_cmaps[] =
{
    {
        .range_start = 32, .range_length = 64, .glyph_id_start = 1,
        .unicode_list = NULL, .glyph_id_ofs_list = NULL, .list_length = 0, .type = LV_FONT_FMT_TXT_CMAP_FORMAT0_TINY
    },
    {
        .range_start = 97, .range_length = 30, .glyph_id_start = 65,
        .unicode_list = NULL, .glyph_id_ofs_list = NULL, .list_length = 0, .type = LV_FONT_FMT_TXT_CMAP_FORMAT0_TINY
    },
    {
        .range_start = 192, .range_length = 185, .glyph_id_start = 95,
        .unicode_list = cursive_24_unicode_list_2, .glyph_id_ofs_list = NULL, .list_length = 34, .type = LV_FONT_FMT_TXT_CMAP_SPARSE_TINY
    }
};
/*--------------------
 *  ALL CUSTOM DATA
 *--------------------*/
/*Store all the custom data of the font*/
static lv_font_fmt_txt_glyph_cache_t cursive_24_cache;
static const lv_font_fmt_txt_dsc_t cursive_24_font_dsc = {
    .glyph_bitmap = cursive_24_glyph_bitmap,
    .glyph_dsc = cursive_24_glyph_dsc,
    .cmaps = cursive_24_cmaps,
    .kern_dsc = NULL,
    .kern_scale = 0,
    .cmap_num = 3,
    .bpp = 2,
    .kern_classes = 0,
    .bitmap_format = 0,
    .cache = &cursive_24_cache
};
/*-----------------
 *  PUBLIC FONT
 *----------------*/
/*Initialize a public general font descriptor*/
const lv_font_t cursive_24 = {
    .get_glyph_dsc = lv_font_get_glyph_dsc_fmt_txt,    /*Function pointer to get glyph's data*/
    .get_glyph_bitmap = lv_font_get_bitmap_fmt_txt,    /*Function pointer to get glyph's bitmap*/
    .line_height = 25,          /*The maximum line height required by the font*/
    .base_line = 7,             /*Baseline measured from the bottom of the line*/

    .subpx = LV_FONT_SUBPX_NONE,
    .underline_position = -1,
    .underline_thickness = 1,
    .dsc = &cursive_24_font_dsc,          /*The custom font data. Will be accessed by `get_glyph_bitmap/dsc` */
};
#endif

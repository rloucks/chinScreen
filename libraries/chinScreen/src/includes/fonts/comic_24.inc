/*******************************************************************************
 * Size: 24 px
 * Bpp: 2
 ******************************************************************************/


#ifdef __has_include

    #if __has_include("lvgl.h")
         #ifndef LV_LVGL_H_INCLUDE_SIMPLE
             #define LV_LVGL_H_INCLUDE_SIMPLE
         #endif
     #endif
 #endif

 #ifdef LV_LVGL_H_INCLUDE_SIMPLE
     #include "lvgl.h"
 #else
     #include "../lvgl-8.3.11/lvgl.h"
 #endif

 #ifndef COMIC_24
 #define COMIC_24 1
 #endif

 #if COMIC_24

/*-----------------
 *    BITMAPS
 *----------------*/
/*Store the image of the glyphs*/
static LV_ATTRIBUTE_LARGE_CONST const uint8_t comic_24_glyph_bitmap[] = {
    /* U+0020 " " */
    /* U+0021 "!" */
    0x0, 0x0, 0x20, 0x28, 0xe, 0x7, 0x82, 0xd0,
    0xf0, 0x3c, 0xe, 0x1, 0x0, 0x0, 0x10, 0x3c,
    0x0,
    /* U+0022 "\"" */
    0x0, 0x2, 0x4c, 0x31, 0x86, 0x34, 0x93, 0x0,
    /* U+0027 "'" */
    0x0, 0x93, 0x18, 0x90,
    /* U+0028 "(" */
    0x0, 0x4, 0x0, 0xbc, 0x2, 0xe0, 0xb, 0x0,
    0x1c, 0x0, 0x34, 0x0, 0x30, 0x0, 0x70, 0x0,
    0x78, 0x0, 0x3d, 0x0, 0x2f, 0x90, 0xb, 0xf0,
    /* U+0029 ")" */
    0x10, 0x0, 0x3e, 0x0, 0x7, 0xc0, 0x0, 0xb0,
    0x0, 0x38, 0x0, 0xc, 0x0, 0xd, 0x0, 0xe,
    0x0, 0x1e, 0x0, 0x3d, 0x6, 0xfc, 0xf, 0xe0,
    /* U+002B "+" */
    0xb, 0x0, 0xb0, 0x6f, 0xab, 0xff, 0xb, 0x0,
    0xb0,
    /* U+002C "," */
    0x0, 0x2c, 0x34, 0x70, 0xa0,
    /* U+002D "-" */
    0x6a, 0x92, 0xff, 0xc0,
    /* U+002E "." */
    0x0, 0x3c, 0xb4, 0x0,
    /* U+002F "/" */
    0x0, 0x1, 0xd0, 0x0, 0x3c, 0x0, 0xb, 0x40,
    0x1, 0xf0, 0x0, 0x3c, 0x0, 0xf, 0x40, 0x2,
    0xd0, 0x0, 0x78, 0x0, 0xf, 0x0, 0x2, 0xc0,
    0x0, 0x74, 0x0, 0x0,
    /* U+0030 "0" */
    0x0, 0x2f, 0xf9, 0x0, 0x7, 0xff, 0xff, 0x0,
    0xb8, 0x1, 0xff, 0x7, 0x80, 0x0, 0xbd, 0x3c,
    0x0, 0x0, 0xf5, 0xf0, 0x0, 0x3, 0xd7, 0xc0,
    0x0, 0x2f, 0x1f, 0x80, 0x2, 0xf8, 0x3f, 0xd0,
    0x6f, 0x80, 0x7f, 0xff, 0xf4, 0x0, 0x1f, 0xf9,
    0x0, 0x0,
    /* U+0031 "1" */
    0xb, 0xf0, 0x3, 0xff, 0x0, 0x17, 0xf0, 0x0,
    0x1f, 0x0, 0x1, 0xf0, 0x0, 0x1f, 0x0, 0x1,
    0xf0, 0x0, 0x1f, 0x0, 0x2, 0xf8, 0x2, 0xff,
    0xe8, 0xbf, 0xff, 0xc0,
    /* U+0032 "2" */
    0x3, 0xfe, 0x0, 0xb, 0xff, 0xd0, 0x0, 0x1,
    0xf8, 0x0, 0x0, 0x3c, 0x6, 0xff, 0xfc, 0x3f,
    0xff, 0xf8, 0x7e, 0x55, 0x50, 0x7c, 0x0, 0x0,
    0x7d, 0x0, 0x0, 0x3f, 0xff, 0xf0, 0x3f, 0xab,
    0xf0,
    /* U+0033 "3" */
    0x2f, 0xff, 0xe0, 0x79, 0x57, 0xf0, 0x0, 0x7,
    0xe0, 0x0, 0x6f, 0x80, 0x1f, 0xff, 0xf8, 0x2e,
    0x90, 0x3f, 0x0, 0x0, 0x2f, 0x0, 0x0, 0x7d,
    0x15, 0x5b, 0xf0, 0x3f, 0xff, 0x40, 0x2f, 0xe4,
    0x0,
    /* U+0034 "4" */
    0x20, 0x0, 0x43, 0x80, 0xc, 0x3c, 0x0, 0xc3,
    0xc0, 0xc, 0x3e, 0x56, 0xc3, 0xff, 0xfc, 0x2f,
    0xff, 0xc0, 0x0, 0x2c, 0x0, 0x1, 0xc0, 0x0,
    0x1c, 0x0, 0x1, 0xc0,
    /* U+0035 "5" */
    0x3f, 0xab, 0xf0, 0x3f, 0xff, 0xf0, 0x7d, 0x0,
    0x0, 0x7d, 0x0, 0x0, 0x3f, 0xff, 0xf0, 0xf,
    0xff, 0xfc, 0x0, 0x15, 0x7d, 0x0, 0x0, 0x7c,
    0x0, 0x2, 0xf4, 0xb, 0xff, 0xd0, 0x3, 0xfe,
    0x0,
    /* U+0036 "6" */
    0x0, 0x1, 0xa4, 0x0, 0x0, 0xba, 0xfd, 0x0,
    0xf, 0x0, 0x50, 0x0, 0xe0, 0x0, 0x0, 0x1e,
    0x0, 0x0, 0x1, 0xfb, 0xff, 0xfe, 0x7, 0xfe,
    0x55, 0xbe, 0x1f, 0x0, 0x0, 0xbc, 0x3f, 0x0,
    0x7, 0xe0, 0x3f, 0xff, 0xfe, 0x0, 0x1b, 0xff,
    0x80, 0x0,
    /* U+0037 "7" */
    0x1b, 0xff, 0xf8, 0x2f, 0xff, 0xfd, 0x1, 0x0,
    0x3d, 0x0, 0x0, 0x3c, 0x0, 0x0, 0xb4, 0x0,
    0x2, 0xe0, 0x0, 0xb, 0x80, 0x0, 0x7e, 0x0,
    0x2, 0xf4, 0x0, 0xf, 0xc0, 0x0, 0x3e, 0x0,
    0x0,
    /* U+0038 "8" */
    0x0, 0xbf, 0xfe, 0x0, 0x7f, 0xef, 0xfc, 0x1f,
    0x80, 0x1f, 0xc3, 0xd0, 0x7, 0xf0, 0x3f, 0xea,
    0xfc, 0x0, 0x7f, 0xff, 0xe0, 0x7, 0xd0, 0x1f,
    0x82, 0xf4, 0x0, 0xf8, 0x7f, 0x41, 0xbf, 0x3,
    0xff, 0xff, 0x80, 0x6, 0xaa, 0x80, 0x0,
    /* U+0039 "9" */
    0x1, 0xbf, 0xf9, 0x0, 0x7f, 0xff, 0xfe, 0x3,
    0xf0, 0x0, 0x7e, 0xf, 0x0, 0x0, 0xbc, 0x3f,
    0x95, 0x6f, 0xf0, 0x3f, 0xff, 0xeb, 0xc0, 0x0,
    0x0, 0x3c, 0x0, 0x0, 0x3, 0x80, 0x0, 0x0,
    0x74, 0x0, 0x3f, 0xaf, 0x0, 0x0, 0x1a, 0x90,
    0x0, 0x0,
    /* U+003A ":" */
    0x14, 0x7c, 0x60, 0x0, 0x0, 0x0, 0x3c, 0xb4,
    0x0,
    /* U+003B ";" */
    0x0, 0x38, 0xb8, 0x10, 0x0, 0x0, 0x0, 0x2c,
    0x34, 0x70, 0xa0,
    /* U+003C "<" */
    0xb, 0xf0, 0x2f, 0x90, 0x3d, 0x0, 0x78, 0x0,
    0x70, 0x0, 0x30, 0x0, 0x34, 0x0, 0x1c, 0x0,
    0xb, 0x0, 0x2, 0xe0, 0x0, 0xbc, 0x0, 0x4,
    /* U+003D "=" */
    0x2a, 0xa1, 0xff, 0xd0, 0x0, 0x15, 0x54, 0xbf,
    0xf0,
    /* U+003E ">" */
    0xf, 0xe0, 0x6, 0xfc, 0x0, 0x3d, 0x0, 0x1e,
    0x0, 0xe, 0x0, 0xd, 0x0, 0xc, 0x0, 0x38,
    0x0, 0xb0, 0x7, 0xc0, 0x3e, 0x0, 0x10, 0x0,
    /* U+003F "?" */
    0x0, 0x5a, 0xff, 0xfd, 0x2f, 0xff, 0xff, 0xfc,
    0x7e, 0x50, 0x3, 0xf4, 0x38, 0x0, 0x1f, 0xd0,
    0x0, 0x1, 0xfd, 0x0, 0x0, 0x1f, 0xd0, 0x0,
    0x0, 0xff, 0xc0, 0x0, 0x1, 0xff, 0xe0, 0x0,
    0x0, 0x6a, 0x80, 0x0, 0x0, 0x0, 0x0, 0x0,
    0x0, 0x7e, 0x0, 0x0,
    /* U+0041 "A" */
    0x0, 0xb, 0x80, 0x0, 0xff, 0x80, 0xf, 0xaf,
    0x0, 0xb4, 0x3d, 0x3, 0x80, 0xf8, 0x2d, 0xb,
    0xe1, 0xff, 0xff, 0xcf, 0xfe, 0xff, 0x7c, 0x0,
    0x3d, 0xd0, 0x0, 0xa7, 0x0, 0x0, 0x0, 0x0,
    0x0,
    /* U+0042 "B" */
    0x6, 0xbf, 0xfe, 0x7, 0xff, 0xff, 0xfc, 0x2e,
    0x0, 0x1f, 0xc1, 0xc0, 0x3, 0xf0, 0x1d, 0x7,
    0xfc, 0x1, 0xff, 0xff, 0xe0, 0x1f, 0xaa, 0xaf,
    0x81, 0xe0, 0x1, 0xf4, 0x1f, 0x1, 0xfe, 0x1,
    0xff, 0xff, 0x40, 0x1f, 0xf9, 0x0, 0x0,
    /* U+0043 "C" */
    0x0, 0x7, 0xf4, 0x0, 0x7f, 0xfc, 0x2, 0xd0,
    0x4, 0xb, 0x0, 0x0, 0x1c, 0x0, 0x0, 0x38,
    0x0, 0x0, 0x34, 0x0, 0x0, 0x74, 0x0, 0x0,
    0x78, 0x0, 0x0, 0x3f, 0xaa, 0x90, 0x1f, 0xff,
    0xc0,
    /* U+0044 "D" */
    0x0, 0x0, 0x0, 0x3f, 0xff, 0xe0, 0x7f, 0xff,
    0xfc, 0x7d, 0x0, 0x3d, 0x7c, 0x0, 0x1d, 0x7c,
    0x0, 0x2c, 0x3c, 0x0, 0x74, 0x3d, 0x1, 0xe0,
    0x3d, 0xb, 0x80, 0x3f, 0xfe, 0x0, 0x2f, 0xf4,
    0x0, 0x1f, 0x40, 0x0,
    /* U+0045 "E" */
    0x16, 0xbf, 0xf9, 0xff, 0x94, 0x7, 0x40, 0x0,
    0x1d, 0x0, 0x0, 0x74, 0x0, 0x1, 0xff, 0xff,
    0xf7, 0xfa, 0x55, 0x1d, 0x0, 0x0, 0x78, 0x0,
    0x1, 0xff, 0xff, 0xe7, 0xff, 0xfd, 0x0,
    /* U+0046 "F" */
    0x2f, 0xff, 0xf9, 0xff, 0xe5, 0x7, 0xd0, 0x0,
    0x1f, 0x0, 0x0, 0x3c, 0x0, 0x0, 0xf0, 0x0,
    0x3, 0xff, 0xf0, 0xf, 0xfe, 0x40, 0x3d, 0x0,
    0x0, 0xf4, 0x0, 0x2, 0xd0, 0x0, 0x2, 0x0,
    0x0,
    /* U+0047 "G" */
    0x0, 0xb, 0xfc, 0x0, 0x2f, 0xe9, 0x0, 0x3d,
    0x0, 0x0, 0x38, 0x0, 0x0, 0x2c, 0x0, 0x0,
    0xe, 0x1f, 0xff, 0xd7, 0x41, 0x55, 0xb9, 0xe0,
    0x0, 0x1e, 0x3e, 0x0, 0x1f, 0x7, 0xff, 0xfe,
    0x0, 0x2f, 0xe4, 0x0,
    /* U+0048 "H" */
    0x0, 0x0, 0x0, 0x0, 0x14, 0x60, 0x3, 0x87,
    0x0, 0x38, 0x70, 0x3, 0x87, 0x55, 0xfc, 0x7f,
    0xff, 0xc7, 0xff, 0xfc, 0x74, 0x7, 0xc7, 0x0,
    0x3c, 0x70, 0x2, 0xc7, 0x0, 0xc,
    /* U+0049 "I" */
    0xb, 0xff, 0xe3, 0xff, 0xf8, 0x17, 0xfd, 0x0,
    0x1f, 0x0, 0x1, 0xf0, 0x0, 0x1f, 0x0, 0x1,
    0xf0, 0x0, 0x1f, 0x0, 0x2, 0xf8, 0x2, 0xff,
    0xe4, 0xbf, 0xff, 0xc0,
    /* U+004A "J" */
    0x0, 0x6, 0xfe, 0x3, 0xff, 0xfc, 0x0, 0x1b,
    0xf0, 0x0, 0x0, 0xb0, 0x0, 0x0, 0x30, 0x0,
    0x0, 0x34, 0x0, 0x0, 0x30, 0x0, 0x0, 0xb0,
    0x0, 0x2, 0xd0, 0xb9, 0x1f, 0x80, 0x2f, 0xf9,
    0x0,
    /* U+004B "K" */
    0x20, 0x0, 0x1c, 0x20, 0x0, 0xb8, 0x34, 0x2,
    0xe0, 0x38, 0xb, 0x80, 0x3c, 0x2e, 0x0, 0x3f,
    0xf8, 0x0, 0x2f, 0xf8, 0x0, 0x2f, 0xff, 0x80,
    0x2f, 0xff, 0xf4, 0x2d, 0x0, 0x64, 0x2c, 0x0,
    0x0, 0x10, 0x0, 0x0,
    /* U+004C "L" */
    0xc, 0x0, 0x3, 0xc0, 0x0, 0x3c, 0x0, 0x7,
    0x80, 0x0, 0x74, 0x0, 0x7, 0x40, 0x0, 0x74,
    0x0, 0x7, 0xc0, 0x0, 0x7e, 0xaa, 0x87, 0xff,
    0xf8, 0x3f, 0xe4, 0x0,
    /* U+004D "M" */
    0x0, 0x0, 0x2, 0x80, 0x1d, 0x0, 0x3c, 0x3,
    0xf0, 0xb, 0xd0, 0x3f, 0x0, 0xfe, 0xb, 0xf4,
    0x2f, 0xe0, 0xdb, 0x83, 0x9e, 0xc, 0xbc, 0xf1,
    0xf2, 0x87, 0xfe, 0xf, 0x34, 0x3f, 0xc0, 0xf3,
    0x3, 0xf8, 0xb, 0x70, 0xf, 0x0, 0x21, 0x0,
    0x0, 0x0,
    /* U+004E "N" */
    0x0, 0x0, 0x0, 0x0, 0x0, 0xd7, 0x80, 0x3,
    0x5f, 0x80, 0xd, 0x7f, 0x80, 0x39, 0xff, 0x80,
    0xe7, 0xff, 0x83, 0x9e, 0x1f, 0x9f, 0x70, 0x1f,
    0xfd, 0xc0, 0x1f, 0xf7, 0x0, 0x1f, 0x4c, 0x0,
    0x0, 0x0, 0x0, 0x0,
    /* U+004F "O" */
    0x0, 0xb, 0xfe, 0x40, 0x3, 0xff, 0xff, 0xc0,
    0x7e, 0x0, 0xf, 0xc7, 0x80, 0x0, 0x1f, 0x3c,
    0x0, 0x0, 0x3d, 0xd0, 0x0, 0x1, 0xe7, 0x80,
    0x0, 0xf, 0x1f, 0x40, 0x0, 0xb8, 0x3f, 0x91,
    0x6f, 0x80, 0x3f, 0xff, 0xf4, 0x0, 0x1f, 0xf9,
    0x0, 0x0,
    /* U+0050 "P" */
    0x2f, 0xff, 0xf5, 0xff, 0xff, 0xf7, 0xc0, 0x7,
    0xde, 0x0, 0x3e, 0x74, 0xb, 0xe1, 0xff, 0xf8,
    0x7, 0xfe, 0x0, 0x1f, 0x80, 0x0, 0x70, 0x0,
    0x1, 0xc0, 0x0, 0x7, 0x0, 0x0, 0x0, 0x0,
    0x0,
    /* U+0051 "Q" */
    0x0, 0xb, 0xff, 0x90, 0x0, 0xbf, 0xff, 0xf4,
    0x7, 0xd0, 0x0, 0xbc, 0x1e, 0x0, 0x0, 0x2c,
    0x3c, 0x0, 0x0, 0xc, 0x74, 0x0, 0x0, 0x18,
    0x74, 0x0, 0xd0, 0xb0, 0x78, 0x0, 0xfb, 0xd0,
    0x3e, 0x41, 0xff, 0x80, 0x1f, 0xff, 0xff, 0x80,
    0x2, 0xfe, 0x7, 0xc0, 0x0, 0x0, 0x0, 0xe0,
    0x0, 0x0, 0x0, 0x10,
    /* U+0052 "R" */
    0x1b, 0xff, 0xfe, 0x1f, 0xff, 0xff, 0xd7, 0xc0,
    0x0, 0xf9, 0xf0, 0x0, 0xfd, 0x7c, 0x1, 0xfe,
    0x1f, 0x7, 0xf8, 0x3, 0xff, 0xe0, 0x0, 0xff,
    0xf0, 0x0, 0x3f, 0xfe, 0x0, 0xb, 0xeb, 0xf8,
    0x1, 0xe0, 0x1b, 0x40,
    /* U+0053 "S" */
    0x0, 0x1f, 0xe0, 0x1, 0xff, 0xf0, 0x7, 0x80,
    0xd0, 0xf, 0x0, 0x0, 0x3f, 0x15, 0x50, 0x7f,
    0xff, 0xfc, 0x7f, 0xff, 0xfd, 0x0, 0x0, 0x7d,
    0x0, 0x0, 0xfc, 0x2, 0xaf, 0xf0, 0x2, 0xfe,
    0x40,
    /* U+0054 "T" */
    0x16, 0xaf, 0xfd, 0x7f, 0xff, 0xf4, 0x0, 0x7d,
    0x0, 0x0, 0x3c, 0x0, 0x0, 0x3c, 0x0, 0x0,
    0x3c, 0x0, 0x0, 0x3c, 0x0, 0x0, 0x3c, 0x0,
    0x0, 0x2c, 0x0, 0x0, 0x2c, 0x0, 0x0, 0xc,
    0x0,
    /* U+0055 "U" */
    0x0, 0x1, 0xc2, 0x0, 0x1c, 0x30, 0x1, 0xc3,
    0x40, 0x1d, 0x34, 0x1, 0xd7, 0x80, 0x1d, 0x78,
    0x1, 0xe7, 0xc0, 0x1e, 0x7c, 0xb, 0xd3, 0xff,
    0xf8, 0x3f, 0xf4, 0x0,
    /* U+0056 "V" */
    0x0, 0x0, 0x91, 0x0, 0x1c, 0x70, 0x3, 0x43,
    0x40, 0x70, 0x2c, 0xd, 0x1, 0xd1, 0xc0, 0xf,
    0x78, 0x0, 0x7f, 0x0, 0x3, 0xf0, 0x0, 0x1e,
    0x0, 0x0, 0xe0, 0x0,
    /* U+0057 "W" */
    0x0, 0xb, 0x40, 0x9b, 0x0, 0xfc, 0xd, 0x78,
    0x1f, 0xe1, 0xc7, 0xc2, 0xdf, 0x2c, 0x3d, 0x34,
    0xf7, 0xc3, 0xe3, 0x4b, 0xb8, 0x2f, 0xf0, 0x7f,
    0x80, 0xff, 0x3, 0xf4, 0xf, 0xe0, 0x1f, 0x40,
    0x3d, 0x0, 0xb0, 0x2, 0xc0, 0x0, 0x0,
    /* U+0058 "X" */
    0x0, 0x0, 0x1, 0xe0, 0xd, 0x3, 0xe0, 0xe0,
    0x7, 0xff, 0x0, 0x7, 0xf8, 0x0, 0xf, 0xf0,
    0x0, 0x3f, 0xe0, 0x1, 0xfb, 0xe0, 0xb, 0x43,
    0xe0, 0x78, 0x3, 0xc3, 0xc0, 0x1, 0xc, 0x0,
    0x0,
    /* U+0059 "Y" */
    0xa0, 0x2, 0x5d, 0x2, 0xd3, 0xd1, 0xf0, 0x7f,
    0xf4, 0xb, 0xf8, 0x0, 0xfc, 0x0, 0x3e, 0x0,
    0xf, 0x0, 0x7, 0x80, 0x2, 0xc0, 0x0, 0x90,
    0x0,
    /* U+005A "Z" */
    0xbf, 0xff, 0xf0, 0x0, 0x1b, 0xfd, 0x0, 0x0,
    0xfd, 0x0, 0x0, 0xbc, 0x0, 0x0, 0xbd, 0x0,
    0x0, 0xbd, 0x0, 0x0, 0x7f, 0x0, 0x0, 0x3f,
    0x40, 0x0, 0x2f, 0xfa, 0xaa, 0xf, 0xff, 0xff,
    0x81, 0xd0, 0x0, 0x0,
    /* U+005B "[" */
    0x0, 0x4, 0x0, 0xbc, 0x2, 0xe0, 0xb, 0x0,
    0x1c, 0x0, 0x34, 0x0, 0x30, 0x0, 0x70, 0x0,
    0x78, 0x0, 0x3d, 0x0, 0x2f, 0x90, 0xb, 0xf0,
    /* U+005C "\\" */
    0x70, 0x0, 0x3, 0xc0, 0x0, 0x1e, 0x0, 0x0,
    0xf4, 0x0, 0x3, 0xc0, 0x0, 0x1f, 0x0, 0x0,
    0xb8, 0x0, 0x2, 0xd0, 0x0, 0xf, 0x0, 0x0,
    0x38, 0x0, 0x1, 0xd0,
    /* U+005D "]" */
    0x10, 0x0, 0x3e, 0x0, 0x7, 0xc0, 0x0, 0xb0,
    0x0, 0x38, 0x0, 0xc, 0x0, 0xd, 0x0, 0xe,
    0x0, 0x1e, 0x0, 0x3d, 0x6, 0xfc, 0xf, 0xe0,
    /* U+005F "_" */
    0xff, 0xff, 0xc0, 0x0, 0x0,
    /* U+0061 "a" */
    0x0, 0xb4, 0x0, 0xb, 0xf0, 0x0, 0x7f, 0xe0,
    0x3, 0xd7, 0xc0, 0x1e, 0xf, 0x80, 0xb4, 0x2f,
    0x3, 0xfa, 0xfd, 0xf, 0xff, 0xf8, 0x74, 0x3,
    0xf2, 0x80, 0x3, 0xc9, 0x0, 0x3, 0x40,
    /* U+0062 "b" */
    0x0, 0x0, 0x0, 0x2f, 0xff, 0xe0, 0x7d, 0x57,
    0xf0, 0x7c, 0x7, 0xe0, 0x7d, 0x7f, 0x80, 0x7f,
    0xff, 0xf8, 0x7f, 0x90, 0x3f, 0x3c, 0x0, 0x3f,
    0x3c, 0x0, 0xbd, 0x3e, 0x6f, 0xf0, 0x3f, 0xff,
    0x40, 0x2f, 0xe4, 0x0,
    /* U+0063 "c" */
    0x0, 0x7f, 0x0, 0xbf, 0xd0, 0xba, 0xf0, 0x78,
    0x0, 0x3c, 0x0, 0xd, 0x0, 0x7, 0x0, 0x1,
    0xc0, 0x0, 0x74, 0x5, 0x5f, 0xff, 0xc3, 0xff,
    0xc0,
    /* U+0064 "d" */
    0x2f, 0xff, 0xff, 0x5f, 0xff, 0xff, 0xe7, 0xc0,
    0x0, 0xfa, 0xf0, 0x0, 0x3c, 0xbc, 0x0, 0x1e,
    0x2f, 0x0, 0xf, 0xb, 0xc0, 0xf, 0x1, 0xf0,
    0xf, 0x0, 0x7d, 0x1f, 0x0, 0xf, 0xfe, 0x0,
    0x1, 0xf8, 0x0, 0x0,
    /* U+0065 "e" */
    0x6, 0xff, 0xd1, 0xff, 0x40, 0x7, 0xc0, 0x0,
    0x1d, 0x0, 0x0, 0x78, 0x5, 0xa1, 0xff, 0xf9,
    0x7, 0xe4, 0x0, 0x1d, 0x0, 0x0, 0x7a, 0xaa,
    0xf1, 0xff, 0xfe, 0x7, 0xf9, 0x40, 0x0,
    /* U+0066 "f" */
    0x7f, 0xff, 0xdf, 0xff, 0xe7, 0x80, 0x1, 0xd0,
    0x0, 0x74, 0x0, 0x1e, 0x0, 0x7, 0xff, 0xc1,
    0xfe, 0x50, 0x7c, 0x0, 0x1d, 0x0, 0x3, 0x0,
    0x0,
    /* U+0067 "g" */
    0x0, 0x7f, 0xf0, 0x2, 0xe0, 0x50, 0xb, 0x0,
    0x0, 0x1d, 0x0, 0x0, 0x38, 0x2f, 0xfc, 0x74,
    0x7f, 0xfe, 0x74, 0x0, 0x1e, 0x7c, 0x0, 0x3d,
    0x3f, 0x56, 0xfc, 0x2f, 0xff, 0xe0, 0x7, 0xfe,
    0x0,
    /* U+0068 "h" */
    0x0, 0x0, 0x1, 0xc0, 0x3, 0x87, 0x0, 0xf,
    0x1c, 0x0, 0x3c, 0x70, 0x0, 0xf1, 0xe0, 0xb,
    0xc7, 0xff, 0xff, 0x1f, 0xeb, 0xfc, 0x7c, 0x2,
    0xf1, 0xd0, 0x3, 0xc7, 0x0, 0xb, 0x18, 0x0,
    0x0,
    /* U+0069 "i" */
    0x10, 0xc7, 0x1c, 0x72, 0xcb, 0x2c, 0x71, 0xc2,
    0x0,
    /* U+006A "j" */
    0x0, 0x6f, 0xfc, 0x3, 0xff, 0xd0, 0x1, 0x57,
    0x40, 0x0, 0x3, 0x40, 0x0, 0x3, 0x40, 0x0,
    0x3, 0x40, 0x0, 0x3, 0x40, 0x0, 0x3, 0x40,
    0x40, 0x7, 0x0, 0xbd, 0x6f, 0x0, 0x3f, 0xfd,
    0x0,
    /* U+006B "k" */
    0x20, 0x0, 0x7, 0x1d, 0x0, 0xb, 0x43, 0x80,
    0xf, 0x0, 0xe0, 0x1e, 0x0, 0x3c, 0x7c, 0x0,
    0xb, 0xfd, 0x0, 0x2, 0xff, 0x40, 0x0, 0xbf,
    0xfe, 0x40, 0x1c, 0x1b, 0xf8, 0x7, 0x0, 0x1a,
    0x1, 0xc0, 0x0, 0x0,
    /* U+006C "l" */
    0xc, 0x0, 0x3, 0x0, 0x0, 0xc0, 0x0, 0x30,
    0x0, 0xc, 0x0, 0x7, 0x0, 0x2, 0xc0, 0x0,
    0xb0, 0x0, 0x3c, 0x0, 0xf, 0xaa, 0x87, 0xff,
    0xf0, 0x0, 0x0,
    /* U+006D "m" */
    0x0, 0x0, 0x0, 0x0, 0x0, 0x0, 0x60, 0x3,
    0x80, 0xf, 0x0, 0xbc, 0x2, 0xf0, 0xf, 0xf0,
    0x3f, 0x41, 0xff, 0x4b, 0xf8, 0x2d, 0xbc, 0xff,
    0xc3, 0xc7, 0xfd, 0x7c, 0x3c, 0x3f, 0xc3, 0xd3,
    0x83, 0xf4, 0x2e, 0x74, 0x1f, 0x0, 0xf7, 0x0,
    0xf0, 0x3,
    /* U+006E "n" */
    0x0, 0x0, 0xc5, 0x0, 0xe, 0x74, 0x0, 0xe7,
    0xd0, 0xe, 0x7f, 0x40, 0xe7, 0xfc, 0xe, 0x6b,
    0xf0, 0xe5, 0x1f, 0xde, 0x50, 0x7f, 0xe5, 0x0,
    0xfe, 0x50, 0x1, 0xe0,
    /* U+006F "o" */
    0x0, 0x2f, 0xf4, 0x0, 0x1f, 0xff, 0xf0, 0xb,
    0xe9, 0x6f, 0x81, 0xe0, 0x0, 0x7c, 0x3c, 0x0,
    0x3, 0xc3, 0x40, 0x0, 0x2c, 0x74, 0x0, 0x3,
    0xc7, 0x80, 0x1, 0xf4, 0x7e, 0x55, 0xfe, 0x3,
    0xff, 0xff, 0x80, 0xf, 0xff, 0x80, 0x0,
    /* U+0070 "p" */
    0x1f, 0xff, 0xf1, 0xff, 0xff, 0xc7, 0xc0, 0xf,
    0x5f, 0x0, 0xbc, 0x7c, 0xf, 0xe0, 0xfb, 0xfd,
    0x3, 0xff, 0x40, 0xf, 0xd0, 0x0, 0x3d, 0x0,
    0x0, 0xf0, 0x0, 0x3, 0x80, 0x0, 0x0,
    /* U+0071 "q" */
    0x0, 0x2f, 0xfe, 0x0, 0x2f, 0xfb, 0xfc, 0xb,
    0x80, 0x3, 0xd1, 0xd0, 0x0, 0x2d, 0x38, 0x0,
    0x2, 0xd3, 0x40, 0x7, 0x3c, 0x74, 0x0, 0xff,
    0x87, 0xc0, 0xb, 0xf0, 0x3f, 0xaa, 0xff, 0x2,
    0xff, 0xff, 0xfc, 0xb, 0xfe, 0x42, 0xd0, 0x0,
    0x0, 0x0,
    /* U+0072 "r" */
    0x1f, 0xff, 0xff, 0x1f, 0xff, 0xff, 0xe7, 0x40,
    0x0, 0xf9, 0xd0, 0x0, 0x7d, 0x74, 0x0, 0xbd,
    0x1f, 0x7, 0xf4, 0xb, 0xff, 0xe0, 0x2, 0xff,
    0xf8, 0x0, 0x7e, 0x7f, 0xd0, 0xf, 0x43, 0xfc,
    0x2, 0xc0, 0x4, 0x0,
    /* U+0073 "s" */
    0x0, 0x1b, 0xfc, 0x0, 0xff, 0x90, 0x7, 0x40,
    0x0, 0x2d, 0x0, 0x0, 0x7f, 0xff, 0xf8, 0x7f,
    0xff, 0xfd, 0x0, 0x0, 0x7d, 0x0, 0x0, 0xbc,
    0x0, 0x1, 0xf8, 0x1, 0x6f, 0xe0, 0x7, 0xf9,
    0x0,
    /* U+0074 "t" */
    0x2a, 0xff, 0xd7, 0xff, 0xa9, 0x1, 0xb0, 0x0,
    0x7, 0x0, 0x0, 0x70, 0x0, 0x7, 0x0, 0x0,
    0x70, 0x0, 0x7, 0x0, 0x0, 0x70, 0x0, 0x7,
    0x0, 0x0, 0x70, 0x0,
    /* U+0075 "u" */
    0x0, 0x0, 0x0, 0x40, 0x2, 0x83, 0x40, 0xf,
    0xd, 0x0, 0x3c, 0x34, 0x0, 0xf4, 0xd0, 0x3,
    0xe7, 0x40, 0xf, 0xdd, 0x0, 0x3f, 0x74, 0x7,
    0xf9, 0xea, 0xff, 0x8b, 0xff, 0xe0, 0x2f, 0x90,
    0x0,
    /* U+0076 "v" */
    0x34, 0x0, 0x1c, 0xf0, 0x0, 0xf2, 0xf0, 0x7,
    0x83, 0xd0, 0x3d, 0xf, 0xc1, 0xf0, 0xf, 0x4f,
    0x80, 0x2f, 0xfc, 0x0, 0x3f, 0xe0, 0x0, 0x7f,
    0x0, 0x0, 0xb0, 0x0, 0x0, 0x0, 0x0,
    /* U+0077 "w" */
    0x0, 0x0, 0x0, 0x0, 0x50, 0x7, 0x0, 0xa,
    0xa0, 0xf, 0x80, 0xd, 0x70, 0x1f, 0xd0, 0x2c,
    0x70, 0x28, 0xf0, 0x38, 0x74, 0x34, 0xb8, 0x70,
    0x3c, 0x70, 0x7d, 0xf0, 0x3f, 0xf0, 0x3f, 0xe0,
    0x1f, 0xd0, 0x1f, 0xd0, 0xf, 0xc0, 0xf, 0xc0,
    0x7, 0x80, 0x3, 0x80, 0x1, 0x0, 0x0, 0x0,
    /* U+0078 "x" */
    0x0, 0x0, 0x0, 0x80, 0x9, 0x7, 0xd0, 0x70,
    0xb, 0xeb, 0x40, 0xb, 0xfc, 0x0, 0xf, 0xe0,
    0x0, 0x3f, 0xd0, 0x0, 0xfb, 0xd0, 0xb, 0x43,
    0xd0, 0x3c, 0x3, 0xc2, 0xc0, 0x1, 0xc, 0x0,
    0x0,
    /* U+0079 "y" */
    0x0, 0x0, 0x0, 0x0, 0x0, 0xc7, 0x0, 0xa,
    0xf, 0x40, 0x70, 0x2f, 0x83, 0x80, 0x2f, 0xfc,
    0x0, 0x1f, 0xe0, 0x0, 0x1f, 0x0, 0x0, 0x3c,
    0x0, 0x0, 0xe0, 0x0, 0x3, 0x40, 0x0, 0xc,
    0x0,
    /* U+007A "z" */
    0xbf, 0xff, 0xf0, 0x0, 0x1b, 0xfd, 0x0, 0x0,
    0xfd, 0x0, 0x0, 0xbc, 0x0, 0x0, 0xbd, 0x0,
    0x0, 0xbd, 0x0, 0x0, 0x7f, 0x0, 0x0, 0x3f,
    0x80, 0x0, 0x2f, 0xfa, 0xaa, 0xf, 0xff, 0xff,
    0x81, 0xd0, 0x0, 0x0,
    /* U+007B "{" */
    0xb, 0xf0, 0x2f, 0x90, 0x3d, 0x0, 0x78, 0x0,
    0x70, 0x0, 0x30, 0x0, 0x34, 0x0, 0x1c, 0x0,
    0xb, 0x0, 0x2, 0xe0, 0x0, 0xbc, 0x0, 0x4,
    /* U+007C "|" */
    0x1, 0x55, 0x55, 0x55, 0x55, 0x55, 0x55, 0x54,
    /* U+007D "}" */
    0xf, 0xe0, 0x6, 0xfc, 0x0, 0x3d, 0x0, 0x1e,
    0x0, 0xe, 0x0, 0xd, 0x0, 0xc, 0x0, 0x38,
    0x0, 0xb0, 0x7, 0xc0, 0x3e, 0x0, 0x10, 0x0
};
/*---------------------
 *  GLYPH DESCRIPTION
 *--------------------*/
static const lv_font_fmt_txt_glyph_dsc_t comic_24_glyph_dsc[] = {
    {.bitmap_index = 0, .adv_w = 0, .box_w = 0, .box_h = 0, .ofs_x = 0, .ofs_y = 0} /* id = 0 reserved */,
    {.bitmap_index = 0, .adv_w = 161, .box_w = 0, .box_h = 0, .ofs_x = 0, .ofs_y = 0},
    {.bitmap_index = 0, .adv_w = 90, .box_w = 5, .box_h = 13, .ofs_x = 0, .ofs_y = 0},
    {.bitmap_index = 17, .adv_w = 92, .box_w = 6, .box_h = 5, .ofs_x = 0, .ofs_y = 7},
    {.bitmap_index = 25, .adv_w = 52, .box_w = 3, .box_h = 5, .ofs_x = 0, .ofs_y = 7},
    {.bitmap_index = 29, .adv_w = 136, .box_w = 8, .box_h = 12, .ofs_x = 0, .ofs_y = 0},
    {.bitmap_index = 53, .adv_w = 136, .box_w = 8, .box_h = 12, .ofs_x = 0, .ofs_y = 0},
    {.bitmap_index = 77, .adv_w = 108, .box_w = 6, .box_h = 6, .ofs_x = 0, .ofs_y = 2},
    {.bitmap_index = 86, .adv_w = 61, .box_w = 4, .box_h = 5, .ofs_x = 0, .ofs_y = -2},
    {.bitmap_index = 91, .adv_w = 113, .box_w = 7, .box_h = 2, .ofs_x = 0, .ofs_y = 4},
    {.bitmap_index = 95, .adv_w = 61, .box_w = 4, .box_h = 4, .ofs_x = 0, .ofs_y = -1},
    {.bitmap_index = 99, .adv_w = 167, .box_w = 10, .box_h = 11, .ofs_x = 0, .ofs_y = 0},
    {.bitmap_index = 127, .adv_w = 246, .box_w = 15, .box_h = 11, .ofs_x = 0, .ofs_y = 0},
    {.bitmap_index = 169, .adv_w = 159, .box_w = 10, .box_h = 11, .ofs_x = 0, .ofs_y = 0},
    {.bitmap_index = 197, .adv_w = 194, .box_w = 12, .box_h = 11, .ofs_x = 0, .ofs_y = 0},
    {.bitmap_index = 230, .adv_w = 207, .box_w = 12, .box_h = 11, .ofs_x = 0, .ofs_y = 0},
    {.bitmap_index = 263, .adv_w = 159, .box_w = 10, .box_h = 11, .ofs_x = 0, .ofs_y = 0},
    {.bitmap_index = 291, .adv_w = 194, .box_w = 12, .box_h = 11, .ofs_x = 0, .ofs_y = 0},
    {.bitmap_index = 324, .adv_w = 236, .box_w = 15, .box_h = 11, .ofs_x = 0, .ofs_y = 0},
    {.bitmap_index = 366, .adv_w = 198, .box_w = 12, .box_h = 11, .ofs_x = 0, .ofs_y = 0},
    {.bitmap_index = 399, .adv_w = 227, .box_w = 14, .box_h = 11, .ofs_x = 0, .ofs_y = 0},
    {.bitmap_index = 438, .adv_w = 236, .box_w = 15, .box_h = 11, .ofs_x = 0, .ofs_y = 0},
    {.bitmap_index = 480, .adv_w = 61, .box_w = 4, .box_h = 9, .ofs_x = 0, .ofs_y = -1},
    {.bitmap_index = 489, .adv_w = 63, .box_w = 4, .box_h = 11, .ofs_x = 0, .ofs_y = -2},
    {.bitmap_index = 500, .adv_w = 136, .box_w = 8, .box_h = 12, .ofs_x = 0, .ofs_y = -1},
    {.bitmap_index = 524, .adv_w = 115, .box_w = 7, .box_h = 5, .ofs_x = 0, .ofs_y = 2},
    {.bitmap_index = 533, .adv_w = 136, .box_w = 8, .box_h = 12, .ofs_x = 0, .ofs_y = -1},
    {.bitmap_index = 557, .adv_w = 259, .box_w = 16, .box_h = 11, .ofs_x = 0, .ofs_y = 0},
    {.bitmap_index = 601, .adv_w = 188, .box_w = 11, .box_h = 12, .ofs_x = 0, .ofs_y = -1},
    {.bitmap_index = 634, .adv_w = 225, .box_w = 14, .box_h = 11, .ofs_x = 0, .ofs_y = 0},
    {.bitmap_index = 673, .adv_w = 196, .box_w = 12, .box_h = 11, .ofs_x = 0, .ofs_y = 0},
    {.bitmap_index = 706, .adv_w = 198, .box_w = 12, .box_h = 12, .ofs_x = 0, .ofs_y = 0},
    {.bitmap_index = 742, .adv_w = 186, .box_w = 11, .box_h = 11, .ofs_x = 0, .ofs_y = 0},
    {.bitmap_index = 773, .adv_w = 186, .box_w = 11, .box_h = 12, .ofs_x = 0, .ofs_y = -1},
    {.bitmap_index = 806, .adv_w = 215, .box_w = 13, .box_h = 11, .ofs_x = 0, .ofs_y = 0},
    {.bitmap_index = 842, .adv_w = 159, .box_w = 10, .box_h = 12, .ofs_x = 0, .ofs_y = 0},
    {.bitmap_index = 872, .adv_w = 169, .box_w = 10, .box_h = 11, .ofs_x = 0, .ofs_y = 0},
    {.bitmap_index = 900, .adv_w = 200, .box_w = 12, .box_h = 11, .ofs_x = 0, .ofs_y = 0},
    {.bitmap_index = 933, .adv_w = 194, .box_w = 12, .box_h = 12, .ofs_x = 0, .ofs_y = -1},
    {.bitmap_index = 969, .adv_w = 159, .box_w = 10, .box_h = 11, .ofs_x = 0, .ofs_y = 0},
    {.bitmap_index = 997, .adv_w = 236, .box_w = 14, .box_h = 12, .ofs_x = 0, .ofs_y = -1},
    {.bitmap_index = 1039, .adv_w = 186, .box_w = 11, .box_h = 13, .ofs_x = 0, .ofs_y = -1},
    {.bitmap_index = 1075, .adv_w = 253, .box_w = 15, .box_h = 11, .ofs_x = 0, .ofs_y = 0},
    {.bitmap_index = 1117, .adv_w = 188, .box_w = 11, .box_h = 12, .ofs_x = 0, .ofs_y = -1},
    {.bitmap_index = 1150, .adv_w = 255, .box_w = 16, .box_h = 13, .ofs_x = 0, .ofs_y = -2},
    {.bitmap_index = 1202, .adv_w = 217, .box_w = 13, .box_h = 11, .ofs_x = 0, .ofs_y = 0},
    {.bitmap_index = 1238, .adv_w = 198, .box_w = 12, .box_h = 11, .ofs_x = 0, .ofs_y = 0},
    {.bitmap_index = 1271, .adv_w = 198, .box_w = 12, .box_h = 11, .ofs_x = 0, .ofs_y = 0},
    {.bitmap_index = 1304, .adv_w = 167, .box_w = 10, .box_h = 11, .ofs_x = 0, .ofs_y = 0},
    {.bitmap_index = 1332, .adv_w = 163, .box_w = 10, .box_h = 11, .ofs_x = 0, .ofs_y = 0},
    {.bitmap_index = 1360, .adv_w = 227, .box_w = 14, .box_h = 11, .ofs_x = 0, .ofs_y = 0},
    {.bitmap_index = 1399, .adv_w = 179, .box_w = 11, .box_h = 12, .ofs_x = 0, .ofs_y = 0},
    {.bitmap_index = 1432, .adv_w = 148, .box_w = 9, .box_h = 11, .ofs_x = 0, .ofs_y = 0},
    {.bitmap_index = 1457, .adv_w = 209, .box_w = 13, .box_h = 11, .ofs_x = 0, .ofs_y = 0},
    {.bitmap_index = 1493, .adv_w = 136, .box_w = 8, .box_h = 12, .ofs_x = 0, .ofs_y = 0},
    {.bitmap_index = 1517, .adv_w = 169, .box_w = 10, .box_h = 11, .ofs_x = 0, .ofs_y = 0},
    {.bitmap_index = 1545, .adv_w = 136, .box_w = 8, .box_h = 12, .ofs_x = 0, .ofs_y = 0},
    {.bitmap_index = 1569, .adv_w = 144, .box_w = 9, .box_h = 2, .ofs_x = 0, .ofs_y = -2},
    {.bitmap_index = 1574, .adv_w = 179, .box_w = 11, .box_h = 11, .ofs_x = 0, .ofs_y = 0},
    {.bitmap_index = 1605, .adv_w = 205, .box_w = 12, .box_h = 12, .ofs_x = 0, .ofs_y = 0},
    {.bitmap_index = 1641, .adv_w = 150, .box_w = 9, .box_h = 11, .ofs_x = 0, .ofs_y = 0},
    {.bitmap_index = 1666, .adv_w = 215, .box_w = 13, .box_h = 11, .ofs_x = 0, .ofs_y = 0},
    {.bitmap_index = 1702, .adv_w = 177, .box_w = 11, .box_h = 11, .ofs_x = 0, .ofs_y = 0},
    {.bitmap_index = 1733, .adv_w = 156, .box_w = 9, .box_h = 11, .ofs_x = 0, .ofs_y = 0},
    {.bitmap_index = 1758, .adv_w = 200, .box_w = 12, .box_h = 11, .ofs_x = 0, .ofs_y = 0},
    {.bitmap_index = 1791, .adv_w = 179, .box_w = 11, .box_h = 12, .ofs_x = 0, .ofs_y = 0},
    {.bitmap_index = 1824, .adv_w = 48, .box_w = 3, .box_h = 11, .ofs_x = 0, .ofs_y = 0},
    {.bitmap_index = 1833, .adv_w = 188, .box_w = 12, .box_h = 11, .ofs_x = 0, .ofs_y = 0},
    {.bitmap_index = 1866, .adv_w = 205, .box_w = 13, .box_h = 11, .ofs_x = 0, .ofs_y = 0},
    {.bitmap_index = 1902, .adv_w = 148, .box_w = 9, .box_h = 12, .ofs_x = 0, .ofs_y = -1},
    {.bitmap_index = 1929, .adv_w = 238, .box_w = 14, .box_h = 12, .ofs_x = 0, .ofs_y = 0},
    {.bitmap_index = 1971, .adv_w = 167, .box_w = 10, .box_h = 11, .ofs_x = 0, .ofs_y = 0},
    {.bitmap_index = 1999, .adv_w = 225, .box_w = 14, .box_h = 11, .ofs_x = 0, .ofs_y = 0},
    {.bitmap_index = 2038, .adv_w = 177, .box_w = 11, .box_h = 11, .ofs_x = 0, .ofs_y = 0},
    {.bitmap_index = 2069, .adv_w = 227, .box_w = 14, .box_h = 12, .ofs_x = 0, .ofs_y = -1},
    {.bitmap_index = 2111, .adv_w = 217, .box_w = 13, .box_h = 11, .ofs_x = 0, .ofs_y = 0},
    {.bitmap_index = 2147, .adv_w = 198, .box_w = 12, .box_h = 11, .ofs_x = 0, .ofs_y = 0},
    {.bitmap_index = 2180, .adv_w = 167, .box_w = 10, .box_h = 11, .ofs_x = 0, .ofs_y = 0},
    {.bitmap_index = 2208, .adv_w = 186, .box_w = 11, .box_h = 12, .ofs_x = 0, .ofs_y = 0},
    {.bitmap_index = 2241, .adv_w = 171, .box_w = 11, .box_h = 11, .ofs_x = -1, .ofs_y = 0},
    {.bitmap_index = 2272, .adv_w = 263, .box_w = 16, .box_h = 12, .ofs_x = 0, .ofs_y = 0},
    {.bitmap_index = 2320, .adv_w = 179, .box_w = 11, .box_h = 12, .ofs_x = 0, .ofs_y = 0},
    {.bitmap_index = 2353, .adv_w = 175, .box_w = 11, .box_h = 12, .ofs_x = 0, .ofs_y = 0},
    {.bitmap_index = 2386, .adv_w = 209, .box_w = 13, .box_h = 11, .ofs_x = 0, .ofs_y = 0},
    {.bitmap_index = 2422, .adv_w = 136, .box_w = 8, .box_h = 12, .ofs_x = 0, .ofs_y = -1},
    {.bitmap_index = 2446, .adv_w = 38, .box_w = 2, .box_h = 16, .ofs_x = 0, .ofs_y = -2},
    {.bitmap_index = 2454, .adv_w = 136, .box_w = 8, .box_h = 12, .ofs_x = 0, .ofs_y = -1}
};
/*---------------------
 *  CHARACTER MAPPING
 *--------------------*/
static const uint8_t glyph_id_ofs_list_0[] = {
    0, 1, 2, 0, 0, 0, 0, 3,
    4, 5
};
/*Collect the unicode lists and glyph_id offsets*/
static const lv_font_fmt_txt_cmap_t comic_24_cmaps[] =
{
    {
        .range_start = 32, .range_length = 10, .glyph_id_start = 1,
        .unicode_list = NULL, .glyph_id_ofs_list = glyph_id_ofs_list_0, .list_length = 10, .type = LV_FONT_FMT_TXT_CMAP_FORMAT0_FULL
    },
    {
        .range_start = 43, .range_length = 21, .glyph_id_start = 7,
        .unicode_list = NULL, .glyph_id_ofs_list = NULL, .list_length = 0, .type = LV_FONT_FMT_TXT_CMAP_FORMAT0_TINY
    },
    {
        .range_start = 65, .range_length = 29, .glyph_id_start = 28,
        .unicode_list = NULL, .glyph_id_ofs_list = NULL, .list_length = 0, .type = LV_FONT_FMT_TXT_CMAP_FORMAT0_TINY
    },
    {
        .range_start = 95, .range_length = 1, .glyph_id_start = 57,
        .unicode_list = NULL, .glyph_id_ofs_list = NULL, .list_length = 0, .type = LV_FONT_FMT_TXT_CMAP_FORMAT0_TINY
    },
    {
        .range_start = 97, .range_length = 29, .glyph_id_start = 58,
        .unicode_list = NULL, .glyph_id_ofs_list = NULL, .list_length = 0, .type = LV_FONT_FMT_TXT_CMAP_FORMAT0_TINY
    }
};
/*--------------------
 *  ALL CUSTOM DATA
 *--------------------*/
/*Store all the custom data of the font*/
static lv_font_fmt_txt_glyph_cache_t comic_24_cache;
static const lv_font_fmt_txt_dsc_t comic_24_font_dsc = {
    .glyph_bitmap = comic_24_glyph_bitmap,
    .glyph_dsc = comic_24_glyph_dsc,
    .cmaps = comic_24_cmaps,
    .kern_dsc = NULL,
    .kern_scale = 0,
    .cmap_num = 5,
    .bpp = 2,
    .kern_classes = 0,
    .bitmap_format = 0,
    .cache = &comic_24_cache
};
/*-----------------
 *  PUBLIC FONT
 *----------------*/
/*Initialize a public general font descriptor*/
const lv_font_t comic_24 = {
    .get_glyph_dsc = lv_font_get_glyph_dsc_fmt_txt,    /*Function pointer to get glyph's data*/
    .get_glyph_bitmap = lv_font_get_bitmap_fmt_txt,    /*Function pointer to get glyph's bitmap*/
    .line_height = 16,          /*The maximum line height required by the font*/
    .base_line = 2,             /*Baseline measured from the bottom of the line*/

    .subpx = LV_FONT_SUBPX_NONE,
    .underline_position = -1,
    .underline_thickness = 1,
    .dsc = &comic_24_font_dsc,          /*The custom font data. Will be accessed by `get_glyph_bitmap/dsc` */
};
#endif

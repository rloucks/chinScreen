/*******************************************************************************
 * Size: 20 px
 * Bpp: 2
 ******************************************************************************/


#ifdef __has_include

    #if __has_include("lvgl.h")
         #ifndef LV_LVGL_H_INCLUDE_SIMPLE
             #define LV_LVGL_H_INCLUDE_SIMPLE
         #endif
     #endif
 #endif

 #ifdef LV_LVGL_H_INCLUDE_SIMPLE
     #include "lvgl.h"
 #else
     #include "../lvgl-8.3.11/lvgl.h"
 #endif

 #ifndef CURSIVE_20
 #define CURSIVE_20 1
 #endif

 #if CURSIVE_20

/*-----------------
 *    BITMAPS
 *----------------*/
/*Store the image of the glyphs*/
static LV_ATTRIBUTE_LARGE_CONST const uint8_t cursive_20_glyph_bitmap[] = {
    /* U+0020 " " */
    /* U+0021 "!" */
    0xc, 0x2c, 0x3c, 0x38, 0x34, 0x34, 0x30, 0x30,
    0x30, 0x0, 0x20, 0xb0,
    /* U+0022 "\"" */
    0xa7, 0xa7, 0x96, 0x40,
    /* U+0023 "#" */
    0x0, 0x81, 0x0, 0x2, 0x8, 0x0, 0x14, 0x20,
    0x6, 0xfb, 0xfe, 0x2, 0x42, 0x0, 0x8, 0x8,
    0x1, 0xbb, 0xff, 0x1, 0xc2, 0x40, 0x6, 0xc,
    0x0, 0x38, 0x70, 0x1, 0xd2, 0xc0, 0xb, 0xd,
    0x0,
    /* U+0024 "$" */
    0x1, 0xfd, 0x2, 0x95, 0xc0, 0xc5, 0x20, 0x36,
    0x40, 0xb, 0xd0, 0x0, 0x7d, 0x0, 0xb, 0xe0,
    0x3, 0x2d, 0x38, 0xc3, 0x6c, 0x30, 0xcb, 0xc,
    0xd0, 0xbf, 0x40, 0x0, 0x80, 0x0,
    /* U+0025 "%" */
    0x6, 0x41, 0xc2, 0x7d, 0xb4, 0x60, 0xcd, 0x3,
    0x9, 0xc0, 0x19, 0x34, 0x0, 0xa, 0x0, 0x0,
    0xc0, 0x0, 0x39, 0x98, 0xb, 0x34, 0x21, 0xd3,
    0x45, 0x38, 0x1e, 0x80,
    /* U+0026 "&" */
    0x2, 0xb8, 0x0, 0xd, 0xe, 0x0, 0xc, 0xe,
    0x0, 0xc, 0xc, 0x0, 0xe, 0x70, 0x0, 0x7,
    0x80, 0x0, 0x1f, 0xc3, 0xc0, 0x70, 0xf0, 0xd0,
    0xf0, 0x7c, 0xc0, 0xf0, 0x1f, 0x80, 0xb8, 0xb,
    0xd0, 0x2f, 0xa4, 0xfd, 0x0, 0x0, 0x14,
    /* U+0027 "'" */
    0x9d, 0xd4,
    /* U+0028 "(" */
    0x1, 0x41, 0x80, 0xc0, 0x90, 0x30, 0x1c, 0xb,
    0x2, 0x80, 0xb0, 0x2c, 0x7, 0x0, 0xe0, 0x2c,
    0x3, 0x80,
    /* U+0029 ")" */
    0x34, 0xb, 0x0, 0xe0, 0x2c, 0x7, 0x0, 0xc0,
    0x30, 0xc, 0x7, 0x2, 0x80, 0xc0, 0x60, 0x30,
    0x20, 0x0,
    /* U+002A "*" */
    0x0, 0x40, 0x95, 0x0, 0xe6, 0x80, 0xf8, 0x2b,
    0xc0, 0x38, 0x80, 0x40, 0x0,
    /* U+002B "+" */
    0x0, 0x0, 0x8, 0x0, 0x20, 0x2f, 0xfc, 0x6,
    0x0, 0x24, 0x0, 0x80, 0x0,
    /* U+002C "," */
    0x11, 0xd3, 0x14,
    /* U+002D "-" */
    0x0, 0x3, 0xfe, 0x0, 0x0,
    /* U+002E "." */
    0x21, 0xd0,
    /* U+002F "/" */
    0x0, 0x20, 0x0, 0xc0, 0x6, 0x0, 0x24, 0x0,
    0xc0, 0x3, 0x0, 0x28, 0x0, 0xc0, 0x7, 0x0,
    0x38, 0x1, 0xd0, 0xf, 0x0, 0x74, 0x1, 0x80,
    0x0,
    /* U+0030 "0" */
    0x0, 0xb8, 0x2, 0x3, 0xc1, 0x80, 0x74, 0xd0,
    0xe, 0x30, 0x3, 0x9c, 0x0, 0xe7, 0x0, 0x35,
    0xd0, 0xc, 0x38, 0xa, 0xf, 0x7, 0x0, 0xbe,
    0x0,
    /* U+0031 "1" */
    0x0, 0xc0, 0x2d, 0x4, 0xd0, 0x8d, 0x14, 0xd2,
    0xc, 0x61, 0xc0, 0x1c, 0x2, 0xc0, 0x2c, 0x2,
    0x80,
    /* U+0032 "2" */
    0x2, 0xe4, 0x5, 0xf, 0x2, 0x41, 0xd0, 0x90,
    0x74, 0x0, 0x2c, 0x0, 0x1c, 0x0, 0x1c, 0x0,
    0x18, 0x0, 0x2d, 0x2, 0x2f, 0xfa, 0x8d, 0x1f,
    0x80,
    /* U+0033 "3" */
    0x2e, 0x0, 0x37, 0xfd, 0x10, 0xbd, 0x0, 0x60,
    0x1, 0x80, 0x3, 0xf4, 0x0, 0x2c, 0x0, 0xd,
    0x0, 0xd, 0x0, 0x1c, 0xb0, 0x34, 0x2e, 0x80,
    /* U+0034 "4" */
    0x1, 0xc0, 0x0, 0xb0, 0x0, 0x34, 0x0, 0x1c,
    0x0, 0xc, 0x10, 0x6, 0xd, 0x2, 0x3, 0x40,
    0xc1, 0xf8, 0xbf, 0xfb, 0x0, 0x1c, 0x0, 0x7,
    0x0, 0x1, 0xc0,
    /* U+0035 "5" */
    0x0, 0xc, 0x10, 0x7c, 0x3f, 0xe0, 0x8, 0x0,
    0x14, 0x0, 0x2f, 0xe0, 0x0, 0x78, 0x0, 0x2c,
    0x0, 0x2c, 0x0, 0x28, 0xe0, 0x70, 0x2e, 0x80,
    /* U+0036 "6" */
    0x1, 0xb8, 0x7, 0x7, 0xc, 0x6, 0x28, 0x0,
    0x36, 0xa4, 0x3c, 0xd, 0x34, 0xa, 0x34, 0x7,
    0x38, 0xa, 0x2c, 0xc, 0xb, 0xa0,
    /* U+0037 "7" */
    0xb9, 0x8, 0xdb, 0xfc, 0x40, 0x74, 0x0, 0x20,
    0x0, 0x90, 0x0, 0xc0, 0xf, 0xe4, 0x3, 0x0,
    0xb, 0x0, 0xd, 0x0, 0x1c, 0x0,
    /* U+0038 "8" */
    0x5, 0xb8, 0x1c, 0xd, 0x28, 0xd, 0x1c, 0x18,
    0x7, 0x90, 0x6, 0xe0, 0x2c, 0x3c, 0x70, 0x1d,
    0xb0, 0xd, 0xb0, 0x1c, 0x2e, 0xa0,
    /* U+0039 "9" */
    0x2, 0xa0, 0xc, 0x2c, 0x28, 0xd, 0x34, 0xe,
    0x34, 0xf, 0x28, 0xe, 0xa, 0x9e, 0x0, 0xd,
    0x0, 0x1c, 0x34, 0x34, 0x1e, 0x90,
    /* U+003A ":" */
    0x71, 0x80, 0x0, 0x0, 0x87, 0x0,
    /* U+003B ";" */
    0x71, 0x80, 0x0, 0x0, 0x4b, 0xc, 0x80, 0x0,
    /* U+003C "<" */
    0x0, 0x0, 0x0, 0x1, 0xc0, 0x7, 0x80, 0x69,
    0x0, 0x2e, 0x40, 0x0, 0x7e, 0x0, 0x1, 0xa0,
    /* U+003D "=" */
    0x3f, 0xfd, 0x0, 0x0, 0x0, 0x4, 0x3f, 0xfc,
    0x0, 0x0,
    /* U+003E ">" */
    0x0, 0x0, 0xf, 0x40, 0x0, 0xbd, 0x0, 0x1,
    0xb8, 0x0, 0x64, 0x2, 0xd0, 0x3, 0x40, 0x0,
    /* U+003F "?" */
    0xa, 0xd0, 0xd1, 0xd2, 0x3, 0x80, 0xd, 0x0,
    0xb0, 0xd, 0x0, 0xd0, 0x2, 0x80, 0x0, 0x0,
    0x24, 0x0, 0xe0, 0x0,
    /* U+0040 "@" */
    0x0, 0x1a, 0xa4, 0x0, 0x2d, 0x0, 0xa0, 0xe,
    0x0, 0x3, 0xc2, 0xc2, 0xe7, 0x1d, 0x30, 0xa0,
    0xf0, 0xeb, 0xc, 0xe, 0xe, 0xe1, 0xc0, 0xd0,
    0xee, 0x1c, 0x2d, 0xc, 0xe0, 0xd5, 0xd3, 0x8f,
    0xb, 0x8f, 0xe0, 0x7c, 0x0, 0x0, 0x2, 0xf4,
    0x1, 0x90, 0x7, 0xff, 0x90, 0x0, 0x0, 0x0,
    0x0,
    /* U+0041 "A" */
    0x0, 0xc, 0x0, 0x0, 0xf0, 0x0, 0x5, 0xd0,
    0x0, 0x23, 0x40, 0x1, 0x4d, 0x0, 0x8, 0x38,
    0x0, 0x50, 0xe0, 0x1f, 0xeb, 0x81, 0x18, 0xe,
    0x4, 0xd0, 0x38, 0x87, 0x0, 0xf5, 0x28, 0x2,
    0xe0,
    /* U+0042 "B" */
    0x3, 0x0, 0x0, 0xbb, 0x90, 0x7b, 0x7, 0xcd,
    0x70, 0xd, 0x4b, 0x0, 0xe0, 0xb0, 0xc, 0xb,
    0x56, 0x80, 0xb6, 0xb8, 0xb, 0x1, 0xc0, 0xb0,
    0x1c, 0x5, 0x3, 0x40, 0xfe, 0x90,
    /* U+0043 "C" */
    0x1, 0xad, 0x0, 0xa0, 0x30, 0x1c, 0x3, 0x3,
    0x40, 0xb0, 0x70, 0x0, 0xa, 0x0, 0x0, 0xe0,
    0x0, 0xe, 0x0, 0x5, 0xf0, 0x0, 0x8b, 0x0,
    0x24, 0x3d, 0x9, 0x0, 0xfe, 0x0,
    /* U+0044 "D" */
    0x0, 0x90, 0x0, 0x0, 0x3f, 0xe0, 0x0, 0x9d,
    0xb, 0x40, 0xd3, 0x40, 0xb4, 0x60, 0xd0, 0xf,
    0x28, 0x34, 0x2, 0xc6, 0xd, 0x0, 0x70, 0x7,
    0x40, 0x1c, 0x1, 0xd0, 0x7, 0x0, 0x74, 0x3,
    0x80, 0x1c, 0x1, 0xc0, 0x2b, 0x1, 0xc0, 0x7,
    0xea, 0x40, 0x0,
    /* U+0045 "E" */
    0x1, 0xad, 0x0, 0xb0, 0x70, 0xc, 0x7, 0x1,
    0xc0, 0x0, 0x1c, 0x0, 0x0, 0xfb, 0x40, 0x1d,
    0xa4, 0x3, 0x40, 0x1, 0x70, 0x0, 0x17, 0x40,
    0x8, 0x3c, 0x2, 0x0, 0xbe, 0x80,
    /* U+0046 "F" */
    0x0, 0x80, 0x0, 0x28, 0x0, 0x1b, 0xff, 0xd5,
    0x34, 0x0, 0xe3, 0x40, 0x4, 0x30, 0x0, 0x3,
    0x0, 0x1, 0xff, 0xc0, 0x7, 0x0, 0x0, 0x70,
    0x0, 0xb, 0x0, 0x0, 0xe0, 0x0,
    /* U+0047 "G" */
    0x0, 0xbe, 0x0, 0x1, 0xc0, 0xf0, 0x1, 0xc0,
    0x1c, 0x0, 0xd0, 0x0, 0x0, 0x70, 0x0, 0x0,
    0x28, 0x0, 0x0, 0xe, 0x0, 0xa8, 0x3, 0x80,
    0xa2, 0xa4, 0xf0, 0xf, 0xe0, 0x2d, 0x0, 0x30,
    0x3, 0xd0, 0x34, 0x0, 0x2f, 0xe0, 0x0,
    /* U+0048 "H" */
    0x0, 0x0, 0x28, 0x1f, 0x0, 0x78, 0x23, 0x80,
    0xa8, 0x53, 0x80, 0xd8, 0x23, 0x80, 0xe4, 0x3,
    0x81, 0xe0, 0x3, 0x42, 0xc0, 0xf, 0x4b, 0xc0,
    0xb, 0xe2, 0xc0, 0x7, 0x2, 0xc0, 0xb, 0x2,
    0xc0, 0xb, 0x1, 0xd0, 0x6, 0x0, 0xe0,
    /* U+0049 "I" */
    0x0, 0x3, 0x80, 0x3, 0xd0, 0x1a, 0xd0, 0x1c,
    0x34, 0xd, 0xd, 0x1, 0x3, 0x40, 0x0, 0xd0,
    0x0, 0x34, 0x0, 0xc, 0x8, 0xb, 0x7, 0x3,
    0x40, 0xbe, 0x0,
    /* U+004A "J" */
    0x0, 0xa, 0x0, 0x1, 0xe0, 0x2, 0xbc, 0x0,
    0xd2, 0x80, 0x1c, 0x28, 0x0, 0x43, 0x80, 0x0,
    0x38, 0x0, 0x3, 0xa4, 0x0, 0x38, 0x0, 0x1f,
    0x40, 0xa, 0x34, 0x2, 0x43, 0x40, 0x70, 0x34,
    0xe, 0x7, 0x40, 0xd0, 0x70, 0xe, 0xb, 0x0,
    0xb0, 0xd0, 0x2, 0xe4, 0x0,
    /* U+004B "K" */
    0x0, 0xb, 0x2, 0xc0, 0x1, 0xd0, 0x74, 0x5,
    0x1c, 0xa, 0x0, 0xc1, 0xc0, 0xc0, 0x8, 0x2c,
    0x28, 0x0, 0x2, 0xc3, 0x0, 0x0, 0x2c, 0xc0,
    0x0, 0x2, 0xed, 0x0, 0x0, 0x38, 0xb0, 0x9,
    0x3, 0x7, 0x40, 0xd0, 0xe0, 0x3c, 0x6, 0xe4,
    0x1, 0xe0, 0x0, 0x0, 0xb, 0xc0, 0x0, 0x0,
    0x0,
    /* U+004C "L" */
    0x0, 0xa, 0xd0, 0x3, 0x4a, 0x0, 0x70, 0xd0,
    0xa, 0x28, 0x1, 0xf8, 0x0, 0xd, 0x0, 0x1,
    0xd0, 0x0, 0x1c, 0x0, 0x2, 0xc0, 0x6, 0xb4,
    0x0, 0x8b, 0xe0, 0x17, 0xd6, 0xf8,
    /* U+004D "M" */
    0x0, 0x0, 0xd, 0x0, 0x0, 0x0, 0xe0, 0x2,
    0x80, 0x1d, 0x0, 0x2c, 0x3, 0xc0, 0x0, 0xe0,
    0xb4, 0x0, 0xf, 0x1b, 0x40, 0x1, 0xba, 0x34,
    0x0, 0x25, 0xc3, 0x0, 0x3, 0x1c, 0x30, 0x10,
    0x62, 0xd3, 0x8, 0xc, 0x2d, 0x34, 0x82, 0x82,
    0xd3, 0x60, 0xe0, 0x38, 0x3d, 0x0,
    /* U+004E "N" */
    0x2, 0x40, 0x3d, 0x3, 0x80, 0xe9, 0x3, 0xc2,
    0x40, 0x1, 0xe2, 0x0, 0x1, 0xfd, 0x0, 0x2,
    0x7c, 0x0, 0x3, 0x1c, 0x0, 0x3, 0xe, 0x0,
    0x6, 0x1f, 0x0, 0xc, 0x1b, 0x0, 0x28, 0x1b,
    0x0, 0xe0, 0xe, 0x0,
    /* U+004F "O" */
    0x0, 0xaf, 0x40, 0x0, 0xc0, 0x78, 0x0, 0x6a,
    0xb, 0x0, 0x38, 0x1, 0xd0, 0x3d, 0x0, 0x38,
    0xd, 0x80, 0xe, 0x7, 0x34, 0x3, 0x82, 0xc2,
    0x80, 0xd9, 0x70, 0xa, 0xb8, 0xe, 0x0, 0x34,
    0x2, 0xe0, 0x28, 0x0, 0x2f, 0xe4, 0x0,
    /* U+0050 "P" */
    0x0, 0x0, 0x0, 0x0, 0xc0, 0x0, 0x1f, 0xf8,
    0x7, 0x38, 0x7c, 0x70, 0xe0, 0x3a, 0x83, 0x80,
    0xe4, 0xe, 0x3, 0x80, 0x34, 0xd, 0x0, 0xd0,
    0xa0, 0x7, 0xe8, 0x0, 0xd, 0x0, 0x0, 0x74,
    0x0, 0x2, 0xc0, 0x0, 0xb, 0x0, 0x0,
    /* U+0051 "Q" */
    0x0, 0xbf, 0x80, 0x3, 0x41, 0xf0, 0xc, 0x0,
    0x78, 0x18, 0x0, 0x3c, 0x34, 0x0, 0x2c, 0x30,
    0x0, 0x2c, 0x30, 0x0, 0x2c, 0x70, 0x0, 0x28,
    0x38, 0x0, 0x30, 0x3c, 0x0, 0xa0, 0x1f, 0xf6,
    0x80, 0x7, 0xff, 0xc, 0x0, 0x7, 0xf0, 0x0,
    0x0, 0x0,
    /* U+0052 "R" */
    0x0, 0x0, 0x0, 0x0, 0x90, 0x0, 0x1, 0xff,
    0x40, 0x19, 0xc1, 0xf0, 0x61, 0xc0, 0x74, 0xd2,
    0xc0, 0x3c, 0x82, 0xc0, 0x2c, 0x2, 0xc0, 0x28,
    0x2, 0xc0, 0x34, 0x2, 0xd9, 0xa0, 0x3, 0xda,
    0xc0, 0x3, 0x80, 0xe0, 0x7, 0x80, 0xb0, 0x7,
    0x0, 0x78, 0x0, 0x0, 0x3f, 0x0, 0x0, 0x4,
    /* U+0053 "S" */
    0x2, 0xfd, 0x3, 0xc1, 0xc1, 0xd0, 0x20, 0x78,
    0x0, 0xb, 0xc0, 0x0, 0x7e, 0x0, 0x2, 0xf0,
    0x0, 0x2d, 0x38, 0x3, 0x6c, 0x1, 0xcb, 0x40,
    0xe0, 0x7f, 0x90,
    /* U+0054 "T" */
    0x7f, 0x95, 0x0, 0x29, 0xbf, 0xd0, 0x18, 0x0,
    0xfb, 0xe1, 0x40, 0x34, 0x0, 0x1a, 0xe, 0x0,
    0x0, 0x3, 0x80, 0x0, 0x0, 0xe0, 0x0, 0x0,
    0x34, 0x0, 0x0, 0xd, 0x0, 0x2, 0x7, 0x0,
    0x1, 0xc2, 0x80, 0x0, 0x2f, 0x80, 0x0,
    /* U+0055 "U" */
    0x1d, 0x0, 0xc0, 0x1d, 0x2, 0xc0, 0x8d, 0x3,
    0xc0, 0x4d, 0x3, 0xc0, 0xc, 0x3, 0x80, 0xc,
    0x3, 0x40, 0x1c, 0x3, 0x40, 0x1c, 0x3, 0x44,
    0x1c, 0xb, 0x8, 0x1c, 0x1b, 0x10, 0xd, 0x27,
    0x60, 0xb, 0x87, 0xc0,
    /* U+0056 "V" */
    0x0, 0x3, 0x80, 0x0, 0x3d, 0x3, 0x80, 0xe0,
    0xec, 0xa, 0xd, 0x80, 0x61, 0xc8, 0x6, 0x1d,
    0x40, 0x61, 0xe0, 0x9, 0x1d, 0x0, 0xc1, 0xd0,
    0xc, 0x2e, 0x2, 0x40, 0xf0, 0x30, 0xb, 0x4c,
    0x0, 0x2f, 0x0,
    /* U+0057 "W" */
    0x1, 0xd0, 0x3, 0x40, 0x32, 0x0, 0x3c, 0xb,
    0x20, 0x80, 0xc0, 0xe2, 0x3c, 0x8, 0xd, 0x53,
    0xc0, 0x94, 0xe8, 0x3c, 0x8, 0x2e, 0x6, 0xc0,
    0x80, 0xd0, 0x9c, 0xc, 0xd, 0x9, 0xd0, 0x80,
    0xe2, 0xd, 0x20, 0xf, 0x60, 0xfa, 0x0, 0x78,
    0x7, 0x80,
    /* U+0058 "X" */
    0x9, 0x0, 0x60, 0xf, 0x0, 0xd0, 0xf, 0x2,
    0x80, 0xb, 0x83, 0x0, 0xb, 0xc8, 0x0, 0x15,
    0xf8, 0x0, 0x20, 0xb0, 0x0, 0x0, 0xf8, 0x4,
    0x3, 0xbc, 0x8, 0xb, 0x1e, 0x24, 0x3c, 0xb,
    0xa0, 0x74, 0x3, 0xc0,
    /* U+0059 "Y" */
    0x1d, 0x0, 0x60, 0x78, 0x3, 0xc8, 0xd0, 0xe,
    0x13, 0x40, 0x74, 0xd, 0x1, 0xc0, 0x30, 0x7,
    0x0, 0xc0, 0x2c, 0x7, 0x0, 0xe0, 0x1c, 0x7,
    0x80, 0x70, 0x1e, 0x40, 0xe2, 0x3c, 0x1, 0xe2,
    0xe0, 0x0, 0x23, 0x80, 0x2, 0x4d, 0x0, 0x1c,
    0x34, 0x0, 0xa1, 0xc0, 0x3, 0x8b, 0x0, 0x7,
    0xb0, 0x0,
    /* U+005A "Z" */
    0xf, 0x90, 0x0, 0x1e, 0xf8, 0xb0, 0x4, 0xb,
    0xf0, 0x0, 0x8, 0x0, 0x0, 0x20, 0x0, 0x0,
    0x80, 0x0, 0x0, 0x80, 0x0, 0x2, 0x0, 0x8,
    0x5, 0x0, 0x4, 0xf, 0x90, 0x20, 0x3a, 0xfe,
    0xd0, 0x70, 0x1f, 0x80,
    /* U+005B "[" */
    0x2f, 0xe0, 0xd0, 0x3, 0x40, 0xd, 0x0, 0x34,
    0x0, 0xc0, 0x3, 0x0, 0xc, 0x0, 0x70, 0x1,
    0xc0, 0x7, 0x0, 0x1c, 0x0, 0x70, 0x1, 0xea,
    0x80,
    /* U+005C "\\" */
    0x80, 0x8, 0x0, 0x50, 0x2, 0x0, 0x30, 0x2,
    0x40, 0x18, 0x0, 0xc0, 0xd, 0x0, 0xb0, 0x3,
    0x80, 0x3c, 0x1, 0xd0, 0x9,
    /* U+005D "]" */
    0x3a, 0xd0, 0xd, 0x0, 0xd0, 0xd, 0x0, 0xd0,
    0xd, 0x0, 0xd0, 0xc, 0x0, 0xc0, 0xc, 0x1,
    0xc0, 0x1c, 0x1, 0xca, 0xa4,
    /* U+005E "^" */
    0x0, 0x40, 0x3, 0xc0, 0x6, 0xd0, 0x1c, 0x74,
    0x60, 0x1d,
    /* U+005F "_" */
    0x0, 0x0, 0x13, 0xff, 0xfe,
    /* U+0061 "a" */
    0x1f, 0x70, 0xc, 0x2c, 0xa, 0x7, 0x7, 0x43,
    0xc1, 0xd1, 0xf2, 0x3c, 0xad, 0x43, 0xcb, 0x40,
    /* U+0062 "b" */
    0xc, 0x0, 0xa, 0x40, 0x3, 0x50, 0x1, 0xd0,
    0x0, 0xb4, 0x0, 0x3b, 0xb0, 0xe, 0xca, 0x3,
    0xf5, 0xd8, 0xe7, 0xf4, 0x38, 0x28, 0xf, 0xc,
    0x1, 0xf8, 0x0,
    /* U+0063 "c" */
    0x1b, 0x80, 0xc7, 0xa, 0x0, 0x74, 0x1, 0xe0,
    0x23, 0xc2, 0x3, 0xf0, 0x0,
    /* U+0064 "d" */
    0x0, 0xc, 0x0, 0xb, 0x0, 0x3, 0xc0, 0x0,
    0xe0, 0x0, 0x34, 0x7, 0xac, 0x3, 0x7, 0x2,
    0x81, 0xc1, 0xe0, 0xb0, 0x78, 0x3c, 0x8f, 0x2b,
    0x50, 0xf1, 0xe0,
    /* U+0065 "e" */
    0x1b, 0x41, 0xc7, 0xe, 0x28, 0x7a, 0x41, 0xe0,
    0x22, 0xc2, 0x43, 0xf4, 0x0,
    /* U+0066 "f" */
    0x2, 0x80, 0x1d, 0x0, 0x94, 0x3, 0x50, 0xd,
    0x0, 0x78, 0x3, 0xd0, 0x1e, 0x89, 0x3f, 0x80,
    0xe1, 0x3, 0x48, 0xd, 0x20, 0x34, 0x80, 0xd2,
    0x3, 0x48, 0xd, 0x10, 0x3a, 0x0, 0xb4, 0x0,
    /* U+0067 "g" */
    0x1e, 0x64, 0xc, 0x1d, 0xa, 0x7, 0x13, 0x43,
    0xd4, 0xd0, 0xf8, 0x3c, 0xac, 0x3, 0xde, 0x0,
    0xa, 0x80, 0x8, 0xa0, 0x6, 0x28, 0x3, 0xd,
    0x0, 0xd3, 0x0, 0x2e, 0x40, 0x0,
    /* U+0068 "h" */
    0xd, 0x0, 0xe, 0x40, 0x7, 0x50, 0x1, 0xd4,
    0x0, 0xb8, 0x0, 0x2e, 0x38, 0xf, 0x2f, 0x3,
    0x92, 0xc1, 0xf4, 0xe1, 0x3c, 0x38, 0x8e, 0xe,
    0x83, 0x83, 0xd0,
    /* U+0069 "i" */
    0x0, 0xd, 0x3, 0x0, 0x0, 0x30, 0x2c, 0xe,
    0x7, 0x84, 0xd2, 0x36, 0xf, 0x40,
    /* U+006A "j" */
    0x0, 0x0, 0x0, 0xd, 0x0, 0x3, 0x0, 0x0,
    0x0, 0x0, 0x30, 0x0, 0x1c, 0x0, 0x7, 0x10,
    0x2, 0xd4, 0x0, 0xb4, 0x0, 0x2c, 0x0, 0xe,
    0x0, 0xb, 0x80, 0xc, 0xd0, 0x9, 0x34, 0x3,
    0xd, 0x0, 0xc3, 0x0, 0x2e, 0x40, 0x0,
    /* U+006B "k" */
    0x24, 0x0, 0x74, 0x0, 0x74, 0x0, 0x70, 0x0,
    0xb0, 0x0, 0xb2, 0xe0, 0xb5, 0xb0, 0xb8, 0x90,
    0xb6, 0x40, 0xf7, 0x0, 0xe3, 0x80, 0xe0, 0xd0,
    0x0, 0x28,
    /* U+006C "l" */
    0x1c, 0xd, 0x7, 0x42, 0xe0, 0xa4, 0x3c, 0xe,
    0x3, 0x81, 0xe1, 0x38, 0x8e, 0x83, 0xd0,
    /* U+006D "m" */
    0x31, 0xd2, 0xc0, 0x2c, 0xba, 0xb4, 0xf, 0x8f,
    0x4c, 0x13, 0xd3, 0x87, 0x4, 0xf0, 0xd1, 0xc8,
    0x38, 0x34, 0x75, 0xe, 0xd, 0x1e, 0x0,
    /* U+006E "n" */
    0x1c, 0x38, 0x3, 0xcb, 0xc0, 0x3a, 0x38, 0x13,
    0xd3, 0x84, 0x3c, 0x34, 0x43, 0x83, 0x60, 0x38,
    0x3c, 0x0,
    /* U+006F "o" */
    0x2f, 0xd0, 0x1f, 0x1c, 0xe, 0xd3, 0x63, 0x4b,
    0xd0, 0xe0, 0x30, 0x2c, 0x28, 0x2, 0xf4, 0x0,
    /* U+0070 "p" */
    0x9, 0xb8, 0x1e, 0x5c, 0x1e, 0xd, 0x1c, 0xd,
    0x2c, 0xc, 0x28, 0x28, 0x2e, 0xa0, 0x38, 0x0,
    0x38, 0x0, 0x38, 0x0, 0x74, 0x0, 0x74, 0x0,
    0x60, 0x0,
    /* U+0071 "q" */
    0x1e, 0x64, 0xc, 0x2c, 0xa, 0xb, 0x13, 0x43,
    0xc4, 0xd0, 0xf4, 0x3c, 0xbd, 0x3, 0xcf, 0x0,
    0x3, 0x80, 0x0, 0xe0, 0x0, 0x38, 0x0, 0x1d,
    0x0, 0xb, 0x0, 0x2, 0x80, 0x0,
    /* U+0072 "r" */
    0xd0, 0x3, 0x80, 0x2, 0xc1, 0x7, 0x8, 0x1c,
    0x40, 0x72, 0x1, 0xe0, 0x0,
    /* U+0073 "s" */
    0x3d, 0xe, 0x0, 0xd0, 0x8b, 0x50, 0x3c, 0x8,
    0xc0, 0xa4, 0x0,
    /* U+0074 "t" */
    0x0, 0x0, 0x34, 0x0, 0xd0, 0x3, 0x0, 0x3e,
    0x40, 0x70, 0x2, 0xc1, 0xb, 0x8, 0x2c, 0x40,
    0xb5, 0x1, 0xe0, 0x0,
    /* U+0075 "u" */
    0x30, 0x30, 0x3c, 0x2c, 0xe, 0xe, 0x7, 0x83,
    0x44, 0xd2, 0xd2, 0x39, 0x76, 0xb, 0x4f, 0x0,
    /* U+0076 "v" */
    0x31, 0xc0, 0x2c, 0xd4, 0xe, 0x3d, 0x23, 0x83,
    0xe0, 0xe0, 0x80, 0x2c, 0x50, 0x3, 0xd0, 0x0,
    /* U+0077 "w" */
    0x70, 0xd, 0x3, 0xc2, 0x68, 0xe, 0x29, 0xe1,
    0x74, 0xe2, 0xe4, 0xd3, 0x41, 0x3, 0x8e, 0x20,
    0x7, 0x9f, 0x0, 0x0,
    /* U+0078 "x" */
    0x1c, 0x24, 0xb, 0x48, 0x0, 0xf8, 0x4, 0xd,
    0x4, 0x7, 0xc1, 0x7, 0x76, 0x3, 0x4b, 0x0,
    /* U+0079 "y" */
    0x30, 0x70, 0xf0, 0xf0, 0xe0, 0xe1, 0xe0, 0xd8,
    0xd2, 0xf0, 0xe5, 0xd0, 0xb5, 0xc0, 0x6, 0xc0,
    0x18, 0xc0, 0x31, 0xc0, 0x61, 0xc0, 0xa2, 0x80,
    0x3a, 0x0,
    /* U+007A "z" */
    0xe0, 0x60, 0xbf, 0xd0, 0x3, 0x41, 0x9, 0x4,
    0x18, 0x8, 0xbf, 0xa0, 0xdb, 0xd0,
    /* U+007B "{" */
    0x2, 0x80, 0x70, 0xa, 0x0, 0xe0, 0xa, 0x0,
    0xa0, 0x2c, 0x1, 0xc0, 0xd, 0x0, 0xd0, 0xc,
    0x1, 0xc0, 0xd, 0x0, 0x70,
    /* U+007C "|" */
    0x22, 0x66, 0x65, 0x99, 0x99, 0xcc, 0xcc, 0x0,
    /* U+007D "}" */
    0x28, 0x3, 0x40, 0xe0, 0x38, 0xd, 0x3, 0x0,
    0xa0, 0x38, 0x1c, 0x7, 0x1, 0xc0, 0x70, 0x28,
    0x1c, 0x0,
    /* U+007E "~" */
    0xb, 0x92, 0xd, 0x7f, 0x80, 0x0, 0x0,
    /* U+00C0 "À" */
    0x0, 0x18, 0x0, 0x0, 0x70, 0x0, 0x0, 0x74,
    0x0, 0x3, 0x0, 0x0, 0x3c, 0x0, 0x1, 0x74,
    0x0, 0x8, 0xd0, 0x0, 0x53, 0x40, 0x2, 0xe,
    0x0, 0x14, 0x38, 0x7, 0xfa, 0xe0, 0x46, 0x3,
    0x81, 0x34, 0xe, 0x21, 0xc0, 0x3d, 0x4a, 0x0,
    0xb4, 0x0,
    /* U+00C2 "Â" */
    0x0, 0x9, 0x0, 0x0, 0x38, 0x0, 0x2, 0x28,
    0x0, 0x3, 0x0, 0x0, 0x3c, 0x0, 0x1, 0x74,
    0x0, 0x8, 0xd0, 0x0, 0x53, 0x40, 0x2, 0xe,
    0x0, 0x14, 0x38, 0x7, 0xfa, 0xe0, 0x46, 0x3,
    0x81, 0x34, 0xe, 0x21, 0xc0, 0x3d, 0x4a, 0x0,
    0xb8, 0x0,
    /* U+00C4 "Ä" */
    0x0, 0x10, 0x40, 0x1, 0xcb, 0x0, 0x0, 0xc0,
    0x0, 0xf, 0x0, 0x0, 0x5d, 0x0, 0x2, 0x34,
    0x0, 0x14, 0xd0, 0x0, 0x83, 0x80, 0x5, 0xe,
    0x1, 0xfe, 0xb8, 0x11, 0x80, 0xe0, 0x4d, 0x3,
    0x88, 0x70, 0xf, 0x52, 0x80, 0x2e, 0x0,
    /* U+00C6 "Æ" */
    0x0, 0xc, 0x0, 0x0, 0x0, 0x3c, 0x6a, 0x80,
    0x0, 0x5f, 0xd0, 0xc0, 0x0, 0x8f, 0x80, 0x0,
    0x2, 0xf, 0x80, 0x0, 0x2, 0xf, 0xeb, 0x0,
    0x5, 0xf, 0xaa, 0x0, 0x3f, 0xaf, 0x0, 0x1,
    0x18, 0xe, 0x0, 0x8, 0x34, 0xe, 0x0, 0x8,
    0x70, 0xf, 0x0, 0x20, 0xa0, 0x7, 0x80, 0x80,
    0x0, 0x1, 0xba, 0x0,
    /* U+00C7 "Ç" */
    0x1, 0xad, 0x0, 0xa0, 0x30, 0x1c, 0x3, 0x3,
    0x40, 0xb0, 0x70, 0x0, 0xa, 0x0, 0x0, 0xe0,
    0x0, 0xe, 0x0, 0x1, 0xf0, 0x0, 0x8b, 0x0,
    0x24, 0x3d, 0x9, 0x1, 0xfe, 0x0, 0x2, 0x40,
    0x0, 0x1c, 0x0, 0x6, 0x40, 0x0,
    /* U+00C8 "È" */
    0x0, 0x90, 0x0, 0xb, 0x0, 0x0, 0x1c, 0x0,
    0x1a, 0xd0, 0xb, 0x7, 0x0, 0xc0, 0x70, 0x1c,
    0x0, 0x1, 0xc0, 0x0, 0xf, 0xb4, 0x1, 0xda,
    0x40, 0x34, 0x0, 0x17, 0x0, 0x1, 0x74, 0x0,
    0x83, 0xc0, 0x20, 0xb, 0xe8, 0x0,
    /* U+00C9 "É" */
    0x0, 0x4, 0x0, 0x1, 0xc0, 0x0, 0x28, 0x0,
    0x4, 0x0, 0x1, 0xad, 0x0, 0xb0, 0x70, 0xc,
    0x7, 0x1, 0xc0, 0x0, 0x1c, 0x0, 0x0, 0xfb,
    0x40, 0x1d, 0xa4, 0x3, 0x40, 0x1, 0x70, 0x0,
    0x17, 0x40, 0x8, 0x3c, 0x2, 0x0, 0xbe, 0x80,
    /* U+00CA "Ê" */
    0x0, 0x24, 0x0, 0x7, 0xc0, 0x0, 0x4a, 0x0,
    0x1a, 0xd0, 0xb, 0x7, 0x0, 0xc0, 0x70, 0x1c,
    0x0, 0x1, 0xc0, 0x0, 0xf, 0xb4, 0x1, 0xda,
    0x40, 0x34, 0x0, 0x17, 0x0, 0x1, 0x74, 0x0,
    0x83, 0xc0, 0x20, 0xb, 0xe8, 0x0,
    /* U+00CB "Ë" */
    0x0, 0x41, 0x0, 0x1c, 0xb0, 0x0, 0x0, 0x0,
    0x1a, 0xd0, 0xb, 0x7, 0x0, 0xc0, 0x70, 0x1c,
    0x0, 0x1, 0xc0, 0x0, 0xf, 0xb4, 0x1, 0xda,
    0x40, 0x34, 0x0, 0x17, 0x0, 0x1, 0x74, 0x0,
    0x83, 0xc0, 0x20, 0xb, 0xe8, 0x0,
    /* U+00CE "Î" */
    0x0, 0xc, 0x0, 0xa, 0x80, 0x4, 0x14, 0x0,
    0xe, 0x0, 0xf, 0x40, 0x6b, 0x40, 0x70, 0xd0,
    0x34, 0x34, 0x4, 0xd, 0x0, 0x3, 0x40, 0x0,
    0xd0, 0x0, 0x30, 0x20, 0x2c, 0x1c, 0xd, 0x2,
    0xf8, 0x0,
    /* U+00CF "Ï" */
    0x0, 0x41, 0x0, 0xb2, 0xc0, 0x0, 0x0, 0x0,
    0xe, 0x0, 0xf, 0x40, 0x6b, 0x40, 0x70, 0xd0,
    0x34, 0x34, 0x4, 0xd, 0x0, 0x3, 0x40, 0x0,
    0xd0, 0x0, 0x30, 0x20, 0x2c, 0x1c, 0xd, 0x2,
    0xf8, 0x0,
    /* U+00D4 "Ô" */
    0x0, 0xc, 0x0, 0x0, 0x3, 0x80, 0x0, 0x2,
    0x34, 0x0, 0x2, 0xbd, 0x0, 0x3, 0x1, 0xe0,
    0x1, 0xa8, 0x2c, 0x0, 0xe0, 0x7, 0x40, 0xf4,
    0x0, 0xe0, 0x36, 0x0, 0x38, 0x1c, 0xd0, 0xe,
    0xb, 0xa, 0x3, 0x65, 0xc0, 0x2a, 0xe0, 0x38,
    0x0, 0xd0, 0xb, 0x80, 0xa0, 0x0, 0xbf, 0x90,
    0x0,
    /* U+00D6 "Ö" */
    0x0, 0x51, 0x40, 0x0, 0x38, 0xe0, 0x0, 0x0,
    0x0, 0x0, 0x2, 0xbd, 0x0, 0x3, 0x1, 0xe0,
    0x1, 0xa8, 0x2c, 0x0, 0xe0, 0x7, 0x40, 0xf4,
    0x0, 0xe0, 0x36, 0x0, 0x38, 0x1c, 0xd0, 0xe,
    0xb, 0xa, 0x3, 0x65, 0xc0, 0x2a, 0xe0, 0x38,
    0x0, 0xd0, 0xb, 0x80, 0xa0, 0x0, 0xbf, 0x90,
    0x0,
    /* U+00DB "Û" */
    0x0, 0x24, 0x0, 0x0, 0x38, 0x0, 0x0, 0x8a,
    0x0, 0x1d, 0x0, 0xc0, 0x1d, 0x2, 0xc0, 0x8d,
    0x3, 0xc0, 0x4d, 0x3, 0xc0, 0xc, 0x3, 0x80,
    0xc, 0x3, 0x40, 0x1c, 0x3, 0x40, 0x1c, 0x3,
    0x44, 0x1c, 0xb, 0x8, 0x1c, 0x1b, 0x14, 0xd,
    0x27, 0x60, 0xb, 0x87, 0xc0,
    /* U+00DC "Ü" */
    0x0, 0x45, 0x0, 0x2, 0xca, 0x0, 0x1d, 0x0,
    0xc0, 0x1d, 0x2, 0xc0, 0x8d, 0x3, 0xc0, 0x4d,
    0x3, 0xc0, 0xc, 0x3, 0x80, 0xc, 0x3, 0x40,
    0x1c, 0x3, 0x40, 0x1c, 0x3, 0x44, 0x1c, 0xb,
    0x8, 0x1c, 0x1b, 0x10, 0xd, 0x27, 0x60, 0xb,
    0x87, 0xc0,
    /* U+00E0 "à" */
    0x9, 0x0, 0x2, 0xc0, 0x0, 0x1c, 0x0, 0x0,
    0x0, 0x1f, 0x70, 0xc, 0x2c, 0xa, 0x7, 0x7,
    0x43, 0xc1, 0xd1, 0xf2, 0x3c, 0xad, 0x43, 0xcb,
    0x40,
    /* U+00E2 "â" */
    0x2, 0x40, 0x0, 0xf0, 0x0, 0x8a, 0x0, 0x0,
    0x0, 0x1f, 0x70, 0xc, 0x2c, 0xa, 0x7, 0x7,
    0x43, 0xc1, 0xd1, 0xf2, 0x3c, 0xad, 0x43, 0xcb,
    0x40,
    /* U+00E4 "ä" */
    0xd, 0x70, 0x2, 0x4, 0x0, 0x0, 0x0, 0x7d,
    0xc0, 0x30, 0xb0, 0x28, 0x1c, 0x1d, 0xf, 0x7,
    0x47, 0xc8, 0xf2, 0xb5, 0xf, 0x2d, 0x0,
    /* U+00E6 "æ" */
    0x1f, 0x9b, 0x0, 0xd1, 0xc9, 0xa, 0xa, 0x30,
    0x78, 0x3a, 0x41, 0xe0, 0xf8, 0x22, 0xc3, 0xc2,
    0x43, 0xe2, 0xf0, 0x0,
    /* U+00E7 "ç" */
    0x1b, 0x80, 0xc7, 0xa, 0x4, 0x74, 0x1, 0xe0,
    0x23, 0xc2, 0x3, 0xf4, 0x3, 0x0, 0x9, 0x0,
    0xa0, 0x0,
    /* U+00E8 "è" */
    0xc, 0x0, 0x38, 0x0, 0x28, 0x0, 0x0, 0x1b,
    0x41, 0xc7, 0xe, 0x28, 0x7a, 0x41, 0xe0, 0x22,
    0xc2, 0x43, 0xf4, 0x0,
    /* U+00E9 "é" */
    0x1, 0x80, 0xa, 0x0, 0x60, 0x0, 0x0, 0x1b,
    0x41, 0xc7, 0xe, 0x28, 0x7a, 0x41, 0xe0, 0x22,
    0xc2, 0x43, 0xf4, 0x0,
    /* U+00EA "ê" */
    0x3, 0x0, 0x2e, 0x0, 0xd, 0x0, 0x0, 0x1b,
    0x41, 0xc7, 0xe, 0x28, 0x7a, 0x41, 0xe0, 0x22,
    0xc2, 0x43, 0xf4, 0x0,
    /* U+00EB "ë" */
    0x28, 0xe0, 0x51, 0x0, 0x0, 0x6, 0xd0, 0x71,
    0xc3, 0x8a, 0x1e, 0x90, 0x78, 0x8, 0xb0, 0x90,
    0xfd, 0x0,
    /* U+00EE "î" */
    0xc, 0x1, 0xe0, 0x3, 0x40, 0x0, 0xc, 0x2,
    0xc0, 0x38, 0x13, 0x84, 0x34, 0x83, 0x60, 0x3d,
    0x0,
    /* U+00EF "ï" */
    0x72, 0x81, 0x14, 0x0, 0x0, 0xc0, 0x2c, 0x3,
    0x81, 0x38, 0x43, 0x48, 0x36, 0x3, 0xd0,
    /* U+00F4 "ô" */
    0x2, 0x40, 0x1, 0xf0, 0x0, 0x4a, 0x0, 0x0,
    0x0, 0x2f, 0xd0, 0x1f, 0x1c, 0xe, 0xd3, 0x63,
    0x4b, 0xd0, 0xe0, 0x30, 0x2c, 0x28, 0x2, 0xf4,
    0x0,
    /* U+00F6 "ö" */
    0x1c, 0x70, 0x2, 0x4, 0x0, 0x0, 0x0, 0xbf,
    0x40, 0x7c, 0x70, 0x3b, 0x4d, 0x8d, 0x2f, 0x43,
    0x80, 0xc0, 0xb0, 0xa0, 0xb, 0xd0, 0x0,
    /* U+00FB "û" */
    0x2, 0x40, 0x1, 0xe0, 0x0, 0x4a, 0x0, 0x0,
    0x0, 0x30, 0x30, 0x3c, 0x2c, 0xe, 0xe, 0x7,
    0x83, 0x44, 0xd2, 0xd2, 0x39, 0x76, 0xb, 0x4f,
    0x0,
    /* U+00FC "ü" */
    0x2c, 0xa0, 0x5, 0x14, 0x0, 0x0, 0x0, 0xc0,
    0xc0, 0xf0, 0xb0, 0x38, 0x38, 0x1e, 0xd, 0x13,
    0x4b, 0x48, 0xe5, 0xd8, 0x2d, 0x3c, 0x0,
    /* U+00FF "ÿ" */
    0x14, 0x50, 0x2c, 0xe0, 0x0, 0x0, 0x0, 0x0,
    0x30, 0x70, 0xf0, 0xf0, 0xe0, 0xe1, 0xe0, 0xd8,
    0xd2, 0xf0, 0xe5, 0xd0, 0xb5, 0xc0, 0x6, 0xc0,
    0x18, 0xc0, 0x31, 0xc0, 0x61, 0xc0, 0xa2, 0x80,
    0x3a, 0x0,
    /* U+0152 "Œ" */
    0x0, 0xae, 0x0, 0x6b, 0x0, 0xc, 0x7, 0x7,
    0xc, 0x0, 0x7a, 0xb, 0x34, 0x60, 0x3, 0xc0,
    0x1f, 0xda, 0x0, 0x2f, 0x80, 0x3f, 0x80, 0x0,
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    0x80,
    /* U+0153 "œ" */
    0xf, 0xb2, 0xb0, 0xe, 0x8f, 0x8d, 0x3, 0x72,
    0xc3, 0x5, 0xcd, 0xb6, 0x4, 0x70, 0xbd, 0x2,
    0xe, 0xf, 0x82, 0x1, 0xf8, 0x7e, 0x0,
    /* U+0178 "Ÿ" */
    0x0, 0xd7, 0x0, 0x2, 0x4, 0x1, 0xd0, 0x6,
    0x7, 0x80, 0x3c, 0x8d, 0x0, 0xe1, 0x34, 0x7,
    0x40, 0xd0, 0x1c, 0x3, 0x0, 0x70, 0xc, 0x2,
    0xc0, 0x70, 0xe, 0x1, 0xc0, 0x78, 0x7, 0x1,
    0xe4, 0xe, 0x23, 0xc0, 0x1e, 0x2e, 0x0, 0x2,
    0x38, 0x0, 0x24, 0xd0, 0x1, 0xc3, 0x40, 0xa,
    0x1c, 0x0, 0x38, 0xb0, 0x0, 0x7b, 0x0
};
/*---------------------
 *  GLYPH DESCRIPTION
 *--------------------*/
static const lv_font_fmt_txt_glyph_dsc_t cursive_20_glyph_dsc[] = {
    {.bitmap_index = 0, .adv_w = 0, .box_w = 0, .box_h = 0, .ofs_x = 0, .ofs_y = 0} /* id = 0 reserved */,
    {.bitmap_index = 0, .adv_w = 64, .box_w = 0, .box_h = 0, .ofs_x = 0, .ofs_y = 0},
    {.bitmap_index = 0, .adv_w = 81, .box_w = 4, .box_h = 12, .ofs_x = 1, .ofs_y = 0},
    {.bitmap_index = 12, .adv_w = 79, .box_w = 4, .box_h = 4, .ofs_x = 0, .ofs_y = 8},
    {.bitmap_index = 16, .adv_w = 183, .box_w = 11, .box_h = 12, .ofs_x = 0, .ofs_y = 0},
    {.bitmap_index = 49, .adv_w = 154, .box_w = 9, .box_h = 13, .ofs_x = 0, .ofs_y = -1},
    {.bitmap_index = 79, .adv_w = 167, .box_w = 10, .box_h = 11, .ofs_x = 0, .ofs_y = 0},
    {.bitmap_index = 107, .adv_w = 170, .box_w = 12, .box_h = 13, .ofs_x = 0, .ofs_y = -1},
    {.bitmap_index = 146, .adv_w = 42, .box_w = 2, .box_h = 4, .ofs_x = 0, .ofs_y = 8},
    {.bitmap_index = 148, .adv_w = 88, .box_w = 5, .box_h = 14, .ofs_x = 1, .ofs_y = -2},
    {.bitmap_index = 166, .adv_w = 83, .box_w = 5, .box_h = 14, .ofs_x = 0, .ofs_y = -2},
    {.bitmap_index = 184, .adv_w = 119, .box_w = 7, .box_h = 7, .ofs_x = 0, .ofs_y = 6},
    {.bitmap_index = 197, .adv_w = 129, .box_w = 7, .box_h = 7, .ofs_x = 1, .ofs_y = 1},
    {.bitmap_index = 210, .adv_w = 49, .box_w = 3, .box_h = 4, .ofs_x = 0, .ofs_y = -2},
    {.bitmap_index = 213, .adv_w = 92, .box_w = 6, .box_h = 3, .ofs_x = -1, .ofs_y = 3},
    {.bitmap_index = 218, .adv_w = 57, .box_w = 3, .box_h = 2, .ofs_x = 0, .ofs_y = 0},
    {.bitmap_index = 220, .adv_w = 88, .box_w = 7, .box_h = 14, .ofs_x = -1, .ofs_y = -2},
    {.bitmap_index = 245, .adv_w = 149, .box_w = 9, .box_h = 11, .ofs_x = 0, .ofs_y = 0},
    {.bitmap_index = 270, .adv_w = 100, .box_w = 6, .box_h = 11, .ofs_x = 0, .ofs_y = 0},
    {.bitmap_index = 287, .adv_w = 133, .box_w = 9, .box_h = 11, .ofs_x = 0, .ofs_y = 0},
    {.bitmap_index = 312, .adv_w = 129, .box_w = 8, .box_h = 12, .ofs_x = 0, .ofs_y = 0},
    {.bitmap_index = 336, .adv_w = 141, .box_w = 9, .box_h = 12, .ofs_x = 0, .ofs_y = 0},
    {.bitmap_index = 363, .adv_w = 125, .box_w = 8, .box_h = 12, .ofs_x = 0, .ofs_y = 0},
    {.bitmap_index = 387, .adv_w = 143, .box_w = 8, .box_h = 11, .ofs_x = 0, .ofs_y = 0},
    {.bitmap_index = 409, .adv_w = 113, .box_w = 8, .box_h = 11, .ofs_x = 0, .ofs_y = 0},
    {.bitmap_index = 431, .adv_w = 130, .box_w = 8, .box_h = 11, .ofs_x = 0, .ofs_y = 0},
    {.bitmap_index = 453, .adv_w = 137, .box_w = 8, .box_h = 11, .ofs_x = 0, .ofs_y = 0},
    {.bitmap_index = 475, .adv_w = 66, .box_w = 3, .box_h = 7, .ofs_x = 1, .ofs_y = 0},
    {.bitmap_index = 481, .adv_w = 65, .box_w = 3, .box_h = 10, .ofs_x = 1, .ofs_y = -3},
    {.bitmap_index = 489, .adv_w = 142, .box_w = 9, .box_h = 7, .ofs_x = 0, .ofs_y = 2},
    {.bitmap_index = 505, .adv_w = 164, .box_w = 8, .box_h = 5, .ofs_x = 1, .ofs_y = 2},
    {.bitmap_index = 515, .adv_w = 145, .box_w = 9, .box_h = 7, .ofs_x = 0, .ofs_y = 2},
    {.bitmap_index = 531, .adv_w = 124, .box_w = 7, .box_h = 11, .ofs_x = 0, .ofs_y = 0},
    {.bitmap_index = 551, .adv_w = 233, .box_w = 14, .box_h = 14, .ofs_x = 0, .ofs_y = -4},
    {.bitmap_index = 600, .adv_w = 160, .box_w = 11, .box_h = 12, .ofs_x = 0, .ofs_y = 0},
    {.bitmap_index = 633, .adv_w = 162, .box_w = 10, .box_h = 12, .ofs_x = 0, .ofs_y = 0},
    {.bitmap_index = 663, .adv_w = 132, .box_w = 10, .box_h = 12, .ofs_x = 0, .ofs_y = 0},
    {.bitmap_index = 693, .adv_w = 209, .box_w = 13, .box_h = 13, .ofs_x = 0, .ofs_y = 0},
    {.bitmap_index = 736, .adv_w = 140, .box_w = 10, .box_h = 12, .ofs_x = 0, .ofs_y = 0},
    {.bitmap_index = 766, .adv_w = 131, .box_w = 10, .box_h = 12, .ofs_x = 0, .ofs_y = 0},
    {.bitmap_index = 796, .adv_w = 176, .box_w = 13, .box_h = 12, .ofs_x = 0, .ofs_y = 0},
    {.bitmap_index = 835, .adv_w = 176, .box_w = 12, .box_h = 13, .ofs_x = 0, .ofs_y = 0},
    {.bitmap_index = 874, .adv_w = 137, .box_w = 9, .box_h = 12, .ofs_x = 0, .ofs_y = 0},
    {.bitmap_index = 901, .adv_w = 133, .box_w = 10, .box_h = 18, .ofs_x = 0, .ofs_y = -6},
    {.bitmap_index = 946, .adv_w = 209, .box_w = 14, .box_h = 14, .ofs_x = 0, .ofs_y = -2},
    {.bitmap_index = 995, .adv_w = 154, .box_w = 10, .box_h = 12, .ofs_x = 0, .ofs_y = 0},
    {.bitmap_index = 1025, .adv_w = 208, .box_w = 14, .box_h = 13, .ofs_x = 0, .ofs_y = 0},
    {.bitmap_index = 1071, .adv_w = 159, .box_w = 12, .box_h = 12, .ofs_x = 0, .ofs_y = 0},
    {.bitmap_index = 1107, .adv_w = 188, .box_w = 13, .box_h = 12, .ofs_x = 0, .ofs_y = 0},
    {.bitmap_index = 1146, .adv_w = 177, .box_w = 11, .box_h = 14, .ofs_x = 0, .ofs_y = 0},
    {.bitmap_index = 1185, .adv_w = 192, .box_w = 12, .box_h = 14, .ofs_x = 0, .ofs_y = -2},
    {.bitmap_index = 1227, .adv_w = 187, .box_w = 12, .box_h = 16, .ofs_x = 0, .ofs_y = -2},
    {.bitmap_index = 1275, .adv_w = 153, .box_w = 9, .box_h = 12, .ofs_x = 0, .ofs_y = 0},
    {.bitmap_index = 1302, .adv_w = 134, .box_w = 13, .box_h = 12, .ofs_x = 0, .ofs_y = 0},
    {.bitmap_index = 1341, .adv_w = 163, .box_w = 12, .box_h = 12, .ofs_x = 0, .ofs_y = 0},
    {.bitmap_index = 1377, .adv_w = 162, .box_w = 10, .box_h = 14, .ofs_x = 0, .ofs_y = 0},
    {.bitmap_index = 1412, .adv_w = 220, .box_w = 14, .box_h = 12, .ofs_x = 0, .ofs_y = 0},
    {.bitmap_index = 1454, .adv_w = 168, .box_w = 12, .box_h = 12, .ofs_x = 0, .ofs_y = 0},
    {.bitmap_index = 1490, .adv_w = 166, .box_w = 11, .box_h = 18, .ofs_x = 0, .ofs_y = -6},
    {.bitmap_index = 1540, .adv_w = 160, .box_w = 12, .box_h = 12, .ofs_x = 0, .ofs_y = 0},
    {.bitmap_index = 1576, .adv_w = 119, .box_w = 7, .box_h = 14, .ofs_x = 1, .ofs_y = -2},
    {.bitmap_index = 1601, .adv_w = 88, .box_w = 6, .box_h = 14, .ofs_x = 0, .ofs_y = -2},
    {.bitmap_index = 1622, .adv_w = 108, .box_w = 6, .box_h = 14, .ofs_x = 0, .ofs_y = -2},
    {.bitmap_index = 1643, .adv_w = 172, .box_w = 8, .box_h = 5, .ofs_x = 1, .ofs_y = 8},
    {.bitmap_index = 1653, .adv_w = 147, .box_w = 10, .box_h = 2, .ofs_x = -1, .ofs_y = -2},
    {.bitmap_index = 1658, .adv_w = 123, .box_w = 9, .box_h = 7, .ofs_x = 0, .ofs_y = 0},
    {.bitmap_index = 1674, .adv_w = 115, .box_w = 9, .box_h = 12, .ofs_x = 0, .ofs_y = 0},
    {.bitmap_index = 1701, .adv_w = 92, .box_w = 7, .box_h = 7, .ofs_x = 0, .ofs_y = 0},
    {.bitmap_index = 1714, .adv_w = 126, .box_w = 9, .box_h = 12, .ofs_x = 0, .ofs_y = 0},
    {.bitmap_index = 1741, .adv_w = 94, .box_w = 7, .box_h = 7, .ofs_x = 0, .ofs_y = 0},
    {.bitmap_index = 1754, .adv_w = 73, .box_w = 7, .box_h = 18, .ofs_x = -1, .ofs_y = -6},
    {.bitmap_index = 1786, .adv_w = 119, .box_w = 9, .box_h = 13, .ofs_x = 0, .ofs_y = -6},
    {.bitmap_index = 1816, .adv_w = 119, .box_w = 9, .box_h = 12, .ofs_x = 0, .ofs_y = 0},
    {.bitmap_index = 1843, .adv_w = 56, .box_w = 5, .box_h = 11, .ofs_x = 0, .ofs_y = 0},
    {.bitmap_index = 1857, .adv_w = 54, .box_w = 9, .box_h = 17, .ofs_x = -4, .ofs_y = -6},
    {.bitmap_index = 1896, .adv_w = 110, .box_w = 8, .box_h = 13, .ofs_x = 0, .ofs_y = -1},
    {.bitmap_index = 1922, .adv_w = 56, .box_w = 5, .box_h = 12, .ofs_x = 0, .ofs_y = 0},
    {.bitmap_index = 1937, .adv_w = 173, .box_w = 13, .box_h = 7, .ofs_x = 0, .ofs_y = 0},
    {.bitmap_index = 1960, .adv_w = 119, .box_w = 10, .box_h = 7, .ofs_x = -1, .ofs_y = 0},
    {.bitmap_index = 1978, .adv_w = 116, .box_w = 9, .box_h = 7, .ofs_x = 0, .ofs_y = 0},
    {.bitmap_index = 1994, .adv_w = 115, .box_w = 8, .box_h = 13, .ofs_x = -1, .ofs_y = -6},
    {.bitmap_index = 2020, .adv_w = 121, .box_w = 9, .box_h = 13, .ofs_x = 0, .ofs_y = -6},
    {.bitmap_index = 2050, .adv_w = 82, .box_w = 7, .box_h = 7, .ofs_x = 0, .ofs_y = 0},
    {.bitmap_index = 2063, .adv_w = 67, .box_w = 6, .box_h = 7, .ofs_x = 0, .ofs_y = 0},
    {.bitmap_index = 2074, .adv_w = 64, .box_w = 7, .box_h = 11, .ofs_x = -1, .ofs_y = 0},
    {.bitmap_index = 2094, .adv_w = 117, .box_w = 9, .box_h = 7, .ofs_x = 0, .ofs_y = 0},
    {.bitmap_index = 2110, .adv_w = 112, .box_w = 9, .box_h = 7, .ofs_x = 0, .ofs_y = 0},
    {.bitmap_index = 2126, .adv_w = 149, .box_w = 11, .box_h = 7, .ofs_x = 0, .ofs_y = 0},
    {.bitmap_index = 2146, .adv_w = 101, .box_w = 9, .box_h = 7, .ofs_x = -1, .ofs_y = 0},
    {.bitmap_index = 2162, .adv_w = 112, .box_w = 8, .box_h = 13, .ofs_x = 0, .ofs_y = -6},
    {.bitmap_index = 2188, .adv_w = 109, .box_w = 8, .box_h = 7, .ofs_x = 0, .ofs_y = 0},
    {.bitmap_index = 2202, .adv_w = 94, .box_w = 6, .box_h = 14, .ofs_x = 0, .ofs_y = -2},
    {.bitmap_index = 2223, .adv_w = 61, .box_w = 2, .box_h = 15, .ofs_x = 1, .ofs_y = -3},
    {.bitmap_index = 2231, .adv_w = 88, .box_w = 5, .box_h = 14, .ofs_x = 0, .ofs_y = -2},
    {.bitmap_index = 2249, .adv_w = 146, .box_w = 9, .box_h = 3, .ofs_x = 0, .ofs_y = 3},
    {.bitmap_index = 2256, .adv_w = 160, .box_w = 11, .box_h = 15, .ofs_x = 0, .ofs_y = 0},
    {.bitmap_index = 2298, .adv_w = 160, .box_w = 11, .box_h = 15, .ofs_x = 0, .ofs_y = 0},
    {.bitmap_index = 2340, .adv_w = 160, .box_w = 11, .box_h = 14, .ofs_x = 0, .ofs_y = 0},
    {.bitmap_index = 2379, .adv_w = 234, .box_w = 16, .box_h = 13, .ofs_x = 0, .ofs_y = -1},
    {.bitmap_index = 2431, .adv_w = 132, .box_w = 10, .box_h = 15, .ofs_x = 0, .ofs_y = -3},
    {.bitmap_index = 2469, .adv_w = 141, .box_w = 10, .box_h = 15, .ofs_x = 0, .ofs_y = 0},
    {.bitmap_index = 2507, .adv_w = 141, .box_w = 10, .box_h = 16, .ofs_x = 0, .ofs_y = 0},
    {.bitmap_index = 2547, .adv_w = 141, .box_w = 10, .box_h = 15, .ofs_x = 0, .ofs_y = 0},
    {.bitmap_index = 2585, .adv_w = 141, .box_w = 10, .box_h = 15, .ofs_x = 0, .ofs_y = 0},
    {.bitmap_index = 2623, .adv_w = 137, .box_w = 9, .box_h = 15, .ofs_x = 0, .ofs_y = 0},
    {.bitmap_index = 2657, .adv_w = 137, .box_w = 9, .box_h = 15, .ofs_x = 0, .ofs_y = 0},
    {.bitmap_index = 2691, .adv_w = 188, .box_w = 13, .box_h = 15, .ofs_x = 0, .ofs_y = 0},
    {.bitmap_index = 2740, .adv_w = 189, .box_w = 13, .box_h = 15, .ofs_x = 0, .ofs_y = 0},
    {.bitmap_index = 2789, .adv_w = 166, .box_w = 12, .box_h = 15, .ofs_x = 0, .ofs_y = 0},
    {.bitmap_index = 2834, .adv_w = 166, .box_w = 12, .box_h = 14, .ofs_x = 0, .ofs_y = 0},
    {.bitmap_index = 2876, .adv_w = 123, .box_w = 9, .box_h = 11, .ofs_x = 0, .ofs_y = 0},
    {.bitmap_index = 2901, .adv_w = 123, .box_w = 9, .box_h = 11, .ofs_x = 0, .ofs_y = 0},
    {.bitmap_index = 2926, .adv_w = 123, .box_w = 9, .box_h = 10, .ofs_x = 0, .ofs_y = 0},
    {.bitmap_index = 2949, .adv_w = 153, .box_w = 11, .box_h = 7, .ofs_x = 0, .ofs_y = 0},
    {.bitmap_index = 2969, .adv_w = 92, .box_w = 7, .box_h = 10, .ofs_x = 0, .ofs_y = -3},
    {.bitmap_index = 2987, .adv_w = 94, .box_w = 7, .box_h = 11, .ofs_x = 0, .ofs_y = 0},
    {.bitmap_index = 3007, .adv_w = 94, .box_w = 7, .box_h = 11, .ofs_x = 0, .ofs_y = 0},
    {.bitmap_index = 3027, .adv_w = 94, .box_w = 7, .box_h = 11, .ofs_x = 0, .ofs_y = 0},
    {.bitmap_index = 3047, .adv_w = 94, .box_w = 7, .box_h = 10, .ofs_x = 0, .ofs_y = 0},
    {.bitmap_index = 3065, .adv_w = 56, .box_w = 6, .box_h = 11, .ofs_x = -1, .ofs_y = 0},
    {.bitmap_index = 3082, .adv_w = 56, .box_w = 6, .box_h = 10, .ofs_x = -1, .ofs_y = 0},
    {.bitmap_index = 3097, .adv_w = 116, .box_w = 9, .box_h = 11, .ofs_x = 0, .ofs_y = 0},
    {.bitmap_index = 3122, .adv_w = 116, .box_w = 9, .box_h = 10, .ofs_x = 0, .ofs_y = 0},
    {.bitmap_index = 3145, .adv_w = 117, .box_w = 9, .box_h = 11, .ofs_x = 0, .ofs_y = 0},
    {.bitmap_index = 3170, .adv_w = 117, .box_w = 9, .box_h = 10, .ofs_x = 0, .ofs_y = 0},
    {.bitmap_index = 3193, .adv_w = 112, .box_w = 8, .box_h = 17, .ofs_x = 0, .ofs_y = -6},
    {.bitmap_index = 3227, .adv_w = 287, .box_w = 19, .box_h = 12, .ofs_x = 0, .ofs_y = 0},
    {.bitmap_index = 3284, .adv_w = 165, .box_w = 13, .box_h = 7, .ofs_x = -1, .ofs_y = 0},
    {.bitmap_index = 3307, .adv_w = 166, .box_w = 11, .box_h = 20, .ofs_x = 0, .ofs_y = -6}
};
/*---------------------
 *  CHARACTER MAPPING
 *--------------------*/
static const uint16_t cursive_20_unicode_list_2[] = {
    0x0, 0x2, 0x4, 0x6, 0x7, 0x8, 0x9, 0xa,
    0xb, 0xe, 0xf, 0x14, 0x16, 0x1b, 0x1c, 0x20,
    0x22, 0x24, 0x26, 0x27, 0x28, 0x29, 0x2a, 0x2b,
    0x2e, 0x2f, 0x34, 0x36, 0x3b, 0x3c, 0x3f, 0x92,
    0x93, 0xb8
};
/*Collect the unicode lists and glyph_id offsets*/
static const lv_font_fmt_txt_cmap_t cursive_20_cmaps[] =
{
    {
        .range_start = 32, .range_length = 64, .glyph_id_start = 1,
        .unicode_list = NULL, .glyph_id_ofs_list = NULL, .list_length = 0, .type = LV_FONT_FMT_TXT_CMAP_FORMAT0_TINY
    },
    {
        .range_start = 97, .range_length = 30, .glyph_id_start = 65,
        .unicode_list = NULL, .glyph_id_ofs_list = NULL, .list_length = 0, .type = LV_FONT_FMT_TXT_CMAP_FORMAT0_TINY
    },
    {
        .range_start = 192, .range_length = 185, .glyph_id_start = 95,
        .unicode_list = cursive_20_unicode_list_2, .glyph_id_ofs_list = NULL, .list_length = 34, .type = LV_FONT_FMT_TXT_CMAP_SPARSE_TINY
    }
};
/*--------------------
 *  ALL CUSTOM DATA
 *--------------------*/
/*Store all the custom data of the font*/
static lv_font_fmt_txt_glyph_cache_t cursive_20_cache;
static const lv_font_fmt_txt_dsc_t cursive_20_font_dsc = {
    .glyph_bitmap = cursive_20_glyph_bitmap,
    .glyph_dsc = cursive_20_glyph_dsc,
    .cmaps = cursive_20_cmaps,
    .kern_dsc = NULL,
    .kern_scale = 0,
    .cmap_num = 3,
    .bpp = 2,
    .kern_classes = 0,
    .bitmap_format = 0,
    .cache = &cursive_20_cache
};
/*-----------------
 *  PUBLIC FONT
 *----------------*/
/*Initialize a public general font descriptor*/
const lv_font_t cursive_20 = {
    .get_glyph_dsc = lv_font_get_glyph_dsc_fmt_txt,    /*Function pointer to get glyph's data*/
    .get_glyph_bitmap = lv_font_get_bitmap_fmt_txt,    /*Function pointer to get glyph's bitmap*/
    .line_height = 22,          /*The maximum line height required by the font*/
    .base_line = 6,             /*Baseline measured from the bottom of the line*/

    .subpx = LV_FONT_SUBPX_NONE,
    .underline_position = -1,
    .underline_thickness = 1,
    .dsc = &cursive_20_font_dsc,          /*The custom font data. Will be accessed by `get_glyph_bitmap/dsc` */
};
#endif

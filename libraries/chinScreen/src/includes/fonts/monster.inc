/*******************************************************************************
 * Size: 18 px
 * Bpp: 2
 ******************************************************************************/


#ifdef __has_include

    #if __has_include("lvgl.h")
         #ifndef LV_LVGL_H_INCLUDE_SIMPLE
             #define LV_LVGL_H_INCLUDE_SIMPLE
         #endif
     #endif
 #endif

 #ifdef LV_LVGL_H_INCLUDE_SIMPLE
     #include "lvgl.h"
 #else
     #include "../lvgl-8.3.11/lvgl.h"
 #endif

 #ifndef MONSTER
 #define MONSTER 1
 #endif

 #if MONSTER

/*-----------------
 *    BITMAPS
 *----------------*/
/*Store the image of the glyphs*/
static LV_ATTRIBUTE_LARGE_CONST const uint8_t monster_glyph_bitmap[] = {
    /* U+0020 " " */
    /* U+0021 "!" */
    0x0, 0x0, 0xbe, 0xf, 0xd0, 0xfc, 0x1f, 0xc2,
    0xf8, 0x3f, 0x43, 0xf0, 0x3f, 0x1, 0x90, 0x7c,
    0xb, 0xc0, 0x7c, 0x0, 0x0,
    /* U+0030 "0" */
    0x0, 0x2f, 0x80, 0x2, 0xff, 0xf0, 0xf, 0xff,
    0xf8, 0x1f, 0xf3, 0xfc, 0x3f, 0x81, 0xfc, 0x7e,
    0x2, 0xfc, 0xbd, 0x3, 0xf8, 0xbc, 0x7, 0xf0,
    0xbe, 0xf, 0xe0, 0x7f, 0xff, 0xc0, 0x3f, 0xff,
    0x0, 0xb, 0xf4, 0x0,
    /* U+0031 "1" */
    0x1, 0x50, 0xbe, 0x2f, 0xcb, 0xfd, 0x3f, 0xc2,
    0xfc, 0x3f, 0x83, 0xf4, 0x3f, 0x7, 0xf0, 0x7e,
    0x7, 0xd0, 0x6c, 0x0, 0x0,
    /* U+0032 "2" */
    0x0, 0x0, 0x7f, 0x41, 0xff, 0x7, 0xfe, 0x2,
    0xfc, 0x3, 0xf0, 0x2f, 0x80, 0xfc, 0xf, 0xd0,
    0xbd, 0x7, 0xff, 0x9f, 0xfd, 0xbf, 0xf4,
    /* U+0033 "3" */
    0x1, 0x40, 0x2f, 0xc0, 0xff, 0xc1, 0xff, 0x1,
    0xf8, 0xf, 0xc1, 0xfd, 0xb, 0xf4, 0x7, 0xf0,
    0x1f, 0xc7, 0xfd, 0x2f, 0xe0, 0x79, 0x0,
    /* U+0034 "4" */
    0x0, 0x0, 0x0, 0x1, 0xef, 0xc0, 0x1f, 0xff,
    0x0, 0xff, 0xf8, 0xf, 0xff, 0xd0, 0xbf, 0x7f,
    0x3, 0xf6, 0xf8, 0x2f, 0xff, 0xd0, 0x7f, 0xff,
    0x0, 0x55, 0xfc, 0x0, 0x3, 0xe0, 0x0, 0x1f,
    0x80, 0x0, 0x7d, 0x0, 0x0, 0x0, 0x0,
    /* U+0035 "5" */
    0x0, 0x0, 0x3, 0xff, 0xe0, 0xff, 0xf0, 0x3f,
    0xfc, 0x1f, 0xc0, 0x7, 0xe0, 0x1, 0xfd, 0x0,
    0x7f, 0xd0, 0x6, 0xfc, 0x0, 0x3f, 0x1, 0x6f,
    0x81, 0xff, 0xc0, 0x7f, 0xc0, 0x5, 0x0, 0x0,
    /* U+0036 "6" */
    0x0, 0x0, 0x0, 0xfc, 0x2, 0xfd, 0xb, 0xf4,
    0xf, 0xd0, 0x3f, 0x80, 0x3f, 0xf8, 0x7d, 0xbd,
    0xbc, 0x3e, 0xbc, 0x3e, 0x7f, 0xbd, 0x3f, 0xf8,
    0xb, 0xd0,
    /* U+0037 "7" */
    0x0, 0x0, 0x3f, 0xff, 0x7f, 0xfe, 0xbf, 0xfe,
    0x3, 0xfc, 0x3, 0xf4, 0xb, 0xf0, 0xf, 0xd0,
    0xf, 0xc0, 0x2f, 0x40, 0x3f, 0x0, 0x3f, 0x0,
    0x7d, 0x0, 0x4, 0x0,
    /* U+0038 "8" */
    0x0, 0xbe, 0x0, 0xff, 0xe0, 0xff, 0xfc, 0x7e,
    0x7f, 0x1f, 0xff, 0x43, 0xff, 0xc0, 0xff, 0xc0,
    0xff, 0xf0, 0xbd, 0x7c, 0x2f, 0xbf, 0x7, 0xff,
    0x40, 0x7f, 0x40,
    /* U+0039 "9" */
    0x0, 0x54, 0x2, 0xff, 0x82, 0xff, 0xf5, 0xfe,
    0xfe, 0xbd, 0x1f, 0xef, 0x87, 0xf7, 0xfa, 0xf8,
    0xbd, 0xfd, 0x5, 0xbf, 0x0, 0x3f, 0x0, 0x3f,
    0x40, 0x3f, 0x80, 0x2b, 0x80, 0x0,
    /* U+003F "?" */
    0x7f, 0x81, 0xff, 0xc7, 0xff, 0x41, 0xfe, 0x3,
    0xf4, 0x2f, 0xc1, 0xfc, 0xf, 0xc0, 0x29, 0x1,
    0xe4, 0xb, 0xd0, 0x2f, 0x0,
    /* U+0041 "A" */
    0x0, 0x0, 0x0, 0x0, 0xbe, 0x0, 0xf, 0xe0,
    0x3, 0xff, 0x0, 0x7f, 0xf0, 0xf, 0xff, 0x2,
    0xff, 0xf0, 0x3f, 0x7f, 0xb, 0xd7, 0xf0, 0xff,
    0xff, 0x2f, 0xff, 0xf3, 0xe4, 0x3e, 0xbc, 0x3,
    0xe0, 0x0, 0x0,
    /* U+0042 "B" */
    0x0, 0x0, 0x0, 0xff, 0xe0, 0xf, 0xff, 0xc1,
    0xff, 0xfd, 0xf, 0xcf, 0xd2, 0xf8, 0xfc, 0x3f,
    0xff, 0x3, 0xff, 0xf0, 0x3f, 0x2f, 0x87, 0xe3,
    0xf8, 0x7f, 0xff, 0x4b, 0xff, 0xe0, 0xbe, 0xf4,
    0x0, 0x0, 0x0,
    /* U+0043 "C" */
    0x0, 0x0, 0x0, 0x1b, 0xd0, 0x2f, 0xf0, 0x2f,
    0xfc, 0x1f, 0xf4, 0xf, 0xf0, 0x7, 0xf0, 0x2,
    0xf4, 0x0, 0xbd, 0x0, 0x2f, 0x80, 0x7, 0xfa,
    0x0, 0xbf, 0xd0, 0x7, 0xf0, 0x0,
    /* U+0044 "D" */
    0x0, 0x0, 0x0, 0x7f, 0xf8, 0x2, 0xff, 0xfc,
    0xb, 0xff, 0xfc, 0x1f, 0x8b, 0xf0, 0xbd, 0xf,
    0xc3, 0xf4, 0x3f, 0xf, 0xc1, 0xfc, 0x3f, 0xb,
    0xe1, 0xf8, 0x7f, 0x7, 0xeb, 0xf4, 0x2f, 0xff,
    0x80, 0xbe, 0xf4, 0x0, 0x0, 0x0, 0x0,
    /* U+0045 "E" */
    0x0, 0x0, 0x7, 0xff, 0xd2, 0xff, 0xf0, 0xbf,
    0xfc, 0xf, 0xc0, 0x7, 0xf0, 0x3, 0xff, 0x80,
    0xff, 0xe0, 0x3f, 0x40, 0x1f, 0x80, 0x7, 0xff,
    0x42, 0xff, 0xd0, 0xbf, 0xf0, 0x0, 0x0, 0x0,
    /* U+0046 "F" */
    0x0, 0x0, 0x7, 0xff, 0xf2, 0xff, 0xf8, 0xff,
    0xfd, 0x1b, 0xc0, 0xb, 0xe0, 0x3, 0xff, 0x80,
    0xff, 0xe0, 0x3f, 0x50, 0x1f, 0x80, 0xb, 0xd0,
    0x2, 0xf0, 0x0, 0xbc, 0x0, 0x0, 0x0, 0x0,
    /* U+0047 "G" */
    0x0, 0x0, 0x0, 0x7, 0xf0, 0x3, 0xff, 0x0,
    0xff, 0xe0, 0x2f, 0xd0, 0x3, 0xf4, 0x0, 0xbe,
    0x2f, 0xdb, 0xd3, 0xfc, 0xbc, 0xf, 0x8b, 0xc1,
    0xf4, 0x7f, 0xbf, 0x3, 0xff, 0xc0, 0xb, 0xe0,
    0x0,
    /* U+0048 "H" */
    0x0, 0x0, 0x0, 0xf, 0xd0, 0xfc, 0xf, 0xc2,
    0xfc, 0x1f, 0xc3, 0xf4, 0x2f, 0x83, 0xf0, 0x3f,
    0x47, 0xf0, 0x3f, 0xff, 0xe0, 0x3f, 0xff, 0xd0,
    0x3e, 0x1f, 0xc0, 0x7e, 0xf, 0xc0, 0x7d, 0xf,
    0x80, 0xbc, 0x1f, 0x40, 0xbc, 0x1f, 0x40, 0x0,
    0x0, 0x0,
    /* U+0049 "I" */
    0x0, 0x0, 0xed, 0xf, 0xc1, 0xfc, 0x2f, 0xc3,
    0xf8, 0x3f, 0x43, 0xf0, 0x7f, 0x7, 0xf0, 0x7e,
    0xb, 0xd0, 0xbc, 0x1, 0x40,
    /* U+004A "J" */
    0x0, 0x0, 0x1, 0xfd, 0x2, 0xfc, 0x2, 0xfc,
    0x3, 0xf8, 0x3, 0xf4, 0x3, 0xf0, 0x7, 0xf0,
    0x7, 0xf0, 0xb, 0xe0, 0x1f, 0xe0, 0x7f, 0xc0,
    0xbe, 0x0,
    /* U+004B "K" */
    0x0, 0x0, 0x0, 0x3f, 0xb, 0x41, 0xfc, 0x7f,
    0xb, 0xf3, 0xf0, 0x2f, 0xbf, 0x40, 0xff, 0xf8,
    0x3, 0xff, 0xc0, 0xf, 0xff, 0x0, 0x7e, 0xbe,
    0x1, 0xf4, 0xfc, 0xb, 0xd3, 0xf8, 0x2f, 0x7,
    0xf0, 0xbc, 0xe, 0x40, 0x0, 0x0, 0x0,
    /* U+004C "L" */
    0x0, 0x0, 0xf, 0xd0, 0xf, 0xd0, 0x1f, 0xc0,
    0x2f, 0xc0, 0x3f, 0x80, 0x3f, 0x40, 0x3f, 0x0,
    0x3f, 0x0, 0x3e, 0x0, 0x7f, 0xa8, 0xbf, 0xfc,
    0xbf, 0xfc, 0x0, 0x0,
    /* U+004D "M" */
    0x0, 0x0, 0x0, 0x0, 0x1, 0xf4, 0xe, 0x40,
    0xf, 0xe0, 0xbe, 0x0, 0x7f, 0x83, 0xfc, 0x3,
    0xff, 0x2f, 0xf0, 0xf, 0xfc, 0xff, 0xc0, 0xbf,
    0xff, 0xff, 0x3, 0xff, 0xff, 0xfd, 0x1f, 0xaf,
    0xf7, 0xf4, 0xbc, 0x7f, 0xcf, 0xd3, 0xf0, 0xfd,
    0x2f, 0x5f, 0x43, 0xf0, 0xbd, 0xbc, 0xb, 0x41,
    0xf4, 0x0, 0x0, 0x0, 0x0,
    /* U+004E "N" */
    0xb, 0xc0, 0x2f, 0x3, 0xf8, 0x1f, 0x81, 0xff,
    0xb, 0xd0, 0x7f, 0xe3, 0xf0, 0x2f, 0xfc, 0xfc,
    0xf, 0xff, 0xfe, 0x3, 0xfb, 0xff, 0x80, 0xfc,
    0xff, 0xd0, 0x7e, 0x1f, 0xf0, 0x2f, 0x43, 0xfc,
    0xb, 0xc0, 0x3f, 0x2, 0xf0, 0xb, 0x80, 0x0,
    0x0, 0x0, 0x0,
    /* U+004F "O" */
    0x0, 0x2f, 0xc0, 0x2, 0xff, 0xf0, 0xf, 0xff,
    0xf8, 0x1f, 0xf3, 0xfc, 0x3f, 0x81, 0xfc, 0x3f,
    0x2, 0xfc, 0x7d, 0x3, 0xf8, 0xbc, 0x7, 0xf0,
    0xbe, 0xf, 0xe0, 0x7f, 0xff, 0xc0, 0x3f, 0xff,
    0x0, 0xb, 0xf4, 0x0,
    /* U+0050 "P" */
    0x0, 0x0, 0x3, 0xff, 0xe0, 0x3f, 0xff, 0xc3,
    0xff, 0xfd, 0x1f, 0x8f, 0xd3, 0xf4, 0xfd, 0x3f,
    0x6f, 0xc3, 0xff, 0xf0, 0x7f, 0xb8, 0x7, 0xd0,
    0x0, 0xbd, 0x0, 0xb, 0xc0, 0x0, 0xac, 0x0,
    0x0, 0x0, 0x0,
    /* U+0051 "Q" */
    0x0, 0x2f, 0x40, 0xb, 0xbf, 0x80, 0xff, 0xff,
    0x7, 0xf9, 0xfd, 0x3f, 0x82, 0xf9, 0xfc, 0x7,
    0xeb, 0xd0, 0x2f, 0x2f, 0x3, 0xfc, 0xbd, 0x3f,
    0xd1, 0xfe, 0xff, 0x2, 0xff, 0xff, 0x2, 0xfd,
    0xfc, 0x0, 0x0, 0x0,
    /* U+0052 "R" */
    0x0, 0x0, 0x3, 0xff, 0xe0, 0x3f, 0xff, 0xc3,
    0xff, 0xfc, 0x1f, 0x8f, 0xd3, 0xf8, 0xfc, 0x3f,
    0x6f, 0x83, 0xff, 0xe0, 0x3f, 0xfd, 0x7, 0xeb,
    0xe0, 0x7d, 0x3f, 0xb, 0xc2, 0xf4, 0xbc, 0xf,
    0x80, 0x0, 0xa4,
    /* U+0053 "S" */
    0x0, 0x0, 0x2, 0xfe, 0xf, 0xfe, 0x2f, 0xfc,
    0x3f, 0xc0, 0x3f, 0xc0, 0x1f, 0xf0, 0xb, 0xf4,
    0x2, 0xfc, 0x1, 0xf8, 0x3f, 0xf4, 0xbf, 0xe0,
    0xbf, 0x40, 0x0, 0x0,
    /* U+0054 "T" */
    0x0, 0x0, 0x1f, 0xff, 0xc7, 0xff, 0xf2, 0xff,
    0xf8, 0xf, 0xd0, 0x3, 0xf4, 0x0, 0xfc, 0x0,
    0x7f, 0x0, 0x1f, 0x80, 0xb, 0xe0, 0x2, 0xf4,
    0x0, 0xfc, 0x0, 0x3b, 0x0, 0x0, 0x0, 0x0,
    /* U+0055 "U" */
    0x0, 0x0, 0x0, 0x3f, 0xb, 0xf1, 0xfc, 0x3f,
    0x8b, 0xf0, 0xfc, 0x3f, 0x87, 0xf0, 0xfd, 0x2f,
    0x83, 0xf0, 0xfd, 0x1f, 0xc3, 0xf0, 0xbe, 0xf,
    0xc2, 0xf4, 0x7e, 0xb, 0xe7, 0xf4, 0x1f, 0xff,
    0xc0, 0x2f, 0xbb, 0x0, 0x0, 0x0, 0x0,
    /* U+0056 "V" */
    0x0, 0x0, 0xb, 0xb0, 0xfc, 0xbf, 0xf, 0xc7,
    0xf2, 0xf8, 0x7f, 0x3f, 0x3, 0xf3, 0xe0, 0x3f,
    0xbd, 0x3, 0xff, 0xc0, 0x2f, 0xf8, 0x1, 0xff,
    0x0, 0x1f, 0xf0, 0x0, 0xfd, 0x0, 0xb, 0xc0,
    0x0, 0x0, 0x0,
    /* U+0057 "W" */
    0x0, 0x0, 0x0, 0x0, 0xbf, 0xb, 0xd0, 0xee,
    0xbf, 0xf, 0xe1, 0xfc, 0xbf, 0x2f, 0xe2, 0xf8,
    0x7f, 0x3f, 0xe3, 0xf0, 0x7f, 0x7f, 0xf7, 0xe0,
    0x7f, 0xff, 0xff, 0xc0, 0x3f, 0xfb, 0xff, 0xc0,
    0x3f, 0xf3, 0xff, 0x40, 0x3f, 0xe2, 0xff, 0x0,
    0x2f, 0xc1, 0xfe, 0x0, 0x1f, 0x80, 0xfc, 0x0,
    0x1b, 0x0, 0xf8, 0x0, 0x0, 0x0, 0x0, 0x0,
    /* U+0058 "X" */
    0x0, 0x0, 0x0, 0x7f, 0x7, 0xe0, 0xfd, 0x7f,
    0x2, 0xff, 0xf4, 0x7, 0xff, 0x40, 0xf, 0xf8,
    0x0, 0x3f, 0xc0, 0x0, 0xfe, 0x0, 0x7, 0xfc,
    0x0, 0x3f, 0xf0, 0x2, 0xfb, 0xd0, 0xf, 0x8f,
    0xc0, 0xbc, 0x2b, 0x0, 0x0, 0x0, 0x0,
    /* U+0059 "Y" */
    0x0, 0x0, 0x0, 0x6e, 0xf, 0xd1, 0xfc, 0xbe,
    0x3, 0xfb, 0xf0, 0xb, 0xff, 0x0, 0x1f, 0xf4,
    0x0, 0x3f, 0x80, 0x0, 0xfc, 0x0, 0x7, 0xd0,
    0x0, 0x3f, 0x0, 0x2, 0xf0, 0x0, 0xf, 0x80,
    0x0, 0xbc, 0x0, 0x0,
    /* U+005A "Z" */
    0x0, 0x0, 0x3, 0xff, 0xf0, 0xff, 0xf8, 0xbf,
    0xfd, 0x1, 0xfe, 0x0, 0xff, 0x0, 0x7f, 0x40,
    0x3f, 0x80, 0x1f, 0xc0, 0xf, 0xd0, 0x7, 0xff,
    0x82, 0xff, 0xf4, 0xbf, 0xfc, 0x0, 0x0, 0x0,
    /* U+0061 "a" */
    0x0, 0x0, 0x0, 0x3f, 0x0, 0x7f, 0x0, 0xff,
    0x2, 0xff, 0x3, 0xff, 0xb, 0xaf, 0xf, 0xaf,
    0x2f, 0xff, 0x3e, 0xaf, 0xb4, 0x1e, 0x0, 0x0,
    /* U+0062 "b" */
    0x0, 0x0, 0x1f, 0xf4, 0x2f, 0xfd, 0x2f, 0xbe,
    0x2e, 0x3d, 0x3f, 0xf8, 0x3f, 0xf8, 0x7c, 0xbc,
    0xbc, 0xfc, 0xbf, 0xf4, 0xbb, 0xd0, 0x0, 0x0,
    /* U+0063 "c" */
    0x0, 0x0, 0x6, 0xe0, 0x7f, 0x87, 0xf8, 0x3f,
    0x41, 0xf4, 0xb, 0xc0, 0x2e, 0x0, 0xbd, 0x0,
    0xff, 0x0, 0xb8, 0x0,
    /* U+0064 "d" */
    0x0, 0x0, 0xb, 0xfd, 0x2, 0xff, 0xe0, 0xbe,
    0xfc, 0x3e, 0x2f, 0xf, 0x87, 0xc3, 0xd2, 0xf1,
    0xf0, 0xf8, 0x7c, 0xfc, 0x2f, 0xfd, 0xb, 0xbc,
    0x0, 0x0, 0x0,
    /* U+0065 "e" */
    0x0, 0x0, 0xbf, 0xf2, 0xff, 0x4b, 0xe9, 0x2f,
    0x0, 0xfe, 0x43, 0xfd, 0x1f, 0x40, 0x7c, 0x2,
    0xff, 0x4b, 0xfc, 0x0, 0x0,
    /* U+0066 "f" */
    0x2f, 0xfc, 0x3f, 0xfc, 0x2f, 0x94, 0x3f, 0x0,
    0x3f, 0xd0, 0x3f, 0xc0, 0x7c, 0x0, 0xb8, 0x0,
    0xb8, 0x0, 0x60, 0x0,
    /* U+0067 "g" */
    0x0, 0x0, 0x1, 0xf8, 0xb, 0xf8, 0x2f, 0xe0,
    0x3f, 0x0, 0xbc, 0x7d, 0xb8, 0xfd, 0xb4, 0x7c,
    0xb8, 0xb8, 0x3f, 0xf0, 0x1f, 0x80,
    /* U+0068 "h" */
    0x0, 0x0, 0x7, 0xd2, 0xe2, 0xf0, 0xf8, 0xfc,
    0x7d, 0x3e, 0x2f, 0xf, 0xff, 0x87, 0xef, 0xd1,
    0xf0, 0xf0, 0x78, 0x7c, 0x2e, 0x1f, 0xb, 0x4b,
    0x80, 0x0, 0x0,
    /* U+0069 "i" */
    0x0, 0x7, 0xd2, 0xf0, 0xfc, 0x3f, 0xf, 0x87,
    0xd1, 0xf0, 0xbc, 0x2e, 0xb, 0x40,
    /* U+006A "j" */
    0x0, 0x0, 0xf, 0xc0, 0x3e, 0x1, 0xf8, 0xb,
    0xc0, 0x2f, 0x0, 0xfc, 0x3, 0xe0, 0xf, 0x41,
    0xfc, 0xb, 0xd0, 0x0,
    /* U+006B "k" */
    0x0, 0x0, 0x7, 0xc3, 0x82, 0xf3, 0xf0, 0xfe,
    0xf0, 0x3f, 0xf4, 0xf, 0xf8, 0x7, 0xff, 0x1,
    0xf7, 0xd0, 0xb8, 0xf8, 0x2e, 0x2f, 0xb, 0x47,
    0x80, 0x0, 0x0,
    /* U+006C "l" */
    0x0, 0x1, 0xf4, 0x2f, 0x3, 0xf0, 0x3e, 0x3,
    0xd0, 0x7d, 0x7, 0xc0, 0x7c, 0xb, 0xfe, 0xbf,
    0xd0, 0x0,
    /* U+006D "m" */
    0x0, 0x60, 0x24, 0x2, 0xf0, 0xbc, 0x3, 0xf4,
    0xfc, 0x7, 0xf6, 0xfd, 0xf, 0xfb, 0xfd, 0x1f,
    0xff, 0xfe, 0x2e, 0xbf, 0x7e, 0x3d, 0x7f, 0x3e,
    0x7c, 0x3d, 0x3e, 0xb8, 0x3c, 0x2e, 0x0, 0x0,
    0x0,
    /* U+006E "n" */
    0xf, 0x3, 0xe1, 0xfc, 0x3d, 0x2f, 0xd7, 0xc3,
    0xfe, 0x7c, 0x3f, 0xff, 0x83, 0xef, 0xf4, 0x7c,
    0xff, 0x47, 0xc7, 0xf0, 0xb8, 0x2f, 0xb, 0x40,
    0xf0, 0x0, 0x0, 0x0,
    /* U+006F "o" */
    0x0, 0xbd, 0x2, 0xff, 0xc2, 0xfe, 0xf8, 0xfc,
    0x3f, 0x7c, 0xf, 0xae, 0x7, 0xdb, 0x82, 0xf2,
    0xf6, 0xf4, 0x3f, 0xf8, 0x7, 0xf4, 0x0,
    /* U+0070 "p" */
    0x0, 0x0, 0x3f, 0xf4, 0x3f, 0xfd, 0x3f, 0x7e,
    0x3e, 0x3d, 0x3e, 0xbc, 0x3f, 0xf4, 0x7d, 0x80,
    0xb8, 0x0, 0xb8, 0x0, 0xb4, 0x0,
    /* U+0071 "q" */
    0x0, 0xb8, 0x2, 0xff, 0xc2, 0xff, 0xf0, 0xfc,
    0x3d, 0x7c, 0xf, 0x6e, 0x3, 0xcb, 0x87, 0xe2,
    0xf3, 0xf4, 0x3f, 0xfe, 0x7, 0xfb, 0xc0, 0x0,
    0x0,
    /* U+0072 "r" */
    0x0, 0x0, 0x3f, 0xf4, 0x3f, 0xfc, 0x3f, 0xfd,
    0x3e, 0x3c, 0x3e, 0xb8, 0x7f, 0xf0, 0x7f, 0xf0,
    0xb9, 0xf0, 0xb4, 0xf8, 0xa0, 0x78, 0x0, 0x0,
    /* U+0073 "s" */
    0x0, 0x0, 0x1f, 0xc2, 0xff, 0xf, 0xe4, 0x3f,
    0x0, 0xfe, 0x0, 0xfc, 0x0, 0xf4, 0x1b, 0xc2,
    0xfe, 0xb, 0xe0, 0x0, 0x0,
    /* U+0074 "t" */
    0x7f, 0xf5, 0xff, 0xd6, 0xfa, 0x7, 0xd0, 0x1f,
    0x0, 0xbc, 0x2, 0xf0, 0xf, 0x80, 0x3d, 0x0,
    0xf0, 0x0, 0x0, 0x0,
    /* U+0075 "u" */
    0x0, 0x0, 0x7, 0xc3, 0xe2, 0xf1, 0xf4, 0xfc,
    0xbc, 0x3e, 0x3f, 0x1f, 0x4f, 0x87, 0xc3, 0xd2,
    0xf1, 0xf0, 0xbd, 0xfc, 0x2f, 0xfe, 0x3, 0xef,
    0x40, 0x0, 0x0,
    /* U+0076 "v" */
    0x0, 0x0, 0xbc, 0x3c, 0xbc, 0x7c, 0x7c, 0xb8,
    0x7d, 0xf4, 0x3e, 0xf0, 0x3f, 0xe0, 0x3f, 0xc0,
    0x2f, 0xc0, 0x1f, 0x40, 0xf, 0x0, 0x0, 0x0,
    /* U+0077 "w" */
    0x0, 0x0, 0x0, 0x2f, 0xf, 0x83, 0xdb, 0xc7,
    0xe2, 0xf2, 0xf2, 0xfc, 0xf8, 0x7d, 0xff, 0x7c,
    0x1f, 0xbf, 0xfe, 0x7, 0xff, 0xff, 0x40, 0xff,
    0x7f, 0xc0, 0x3f, 0x4f, 0xd0, 0xf, 0xc3, 0xf0,
    0x2, 0xd0, 0xb8, 0x0, 0x0, 0x0, 0x0,
    /* U+0078 "x" */
    0x1f, 0xf, 0x87, 0xdb, 0xc0, 0xff, 0xc0, 0x3f,
    0xd0, 0x7, 0xe0, 0x1, 0xf4, 0x0, 0xfe, 0x0,
    0x7f, 0xc0, 0x3c, 0xf4, 0x2d, 0x2e, 0x0, 0x0,
    0x0,
    /* U+0079 "y" */
    0x0, 0x0, 0xb, 0xc7, 0xd2, 0xf3, 0xe0, 0x3f,
    0xf0, 0xf, 0xf0, 0x2, 0xf4, 0x0, 0xbc, 0x0,
    0x3c, 0x0, 0x2e, 0x0, 0xf, 0x0, 0xb, 0x40,
    0x0,
    /* U+007A "z" */
    0x0, 0x0, 0x2f, 0xfc, 0x2f, 0xfc, 0x17, 0xf4,
    0x7, 0xf0, 0xf, 0xc0, 0x1f, 0x40, 0x2f, 0x0,
    0x3d, 0x0, 0xbf, 0xf0, 0xbf, 0xf0, 0x0, 0x0
};
/*---------------------
 *  GLYPH DESCRIPTION
 *--------------------*/
static const lv_font_fmt_txt_glyph_dsc_t monster_glyph_dsc[] = {
    {.bitmap_index = 0, .adv_w = 0, .box_w = 0, .box_h = 0, .ofs_x = 0, .ofs_y = 0} /* id = 0 reserved */,
    {.bitmap_index = 0, .adv_w = 115, .box_w = 0, .box_h = 0, .ofs_x = 0, .ofs_y = 0},
    {.bitmap_index = 0, .adv_w = 97, .box_w = 6, .box_h = 14, .ofs_x = 0, .ofs_y = -1},
    {.bitmap_index = 21, .adv_w = 181, .box_w = 12, .box_h = 12, .ofs_x = 0, .ofs_y = 0},
    {.bitmap_index = 57, .adv_w = 96, .box_w = 6, .box_h = 14, .ofs_x = 0, .ofs_y = -1},
    {.bitmap_index = 78, .adv_w = 116, .box_w = 7, .box_h = 13, .ofs_x = 0, .ofs_y = 0},
    {.bitmap_index = 101, .adv_w = 116, .box_w = 7, .box_h = 13, .ofs_x = 0, .ofs_y = 0},
    {.bitmap_index = 124, .adv_w = 169, .box_w = 11, .box_h = 14, .ofs_x = 0, .ofs_y = -1},
    {.bitmap_index = 163, .adv_w = 142, .box_w = 9, .box_h = 14, .ofs_x = 0, .ofs_y = -1},
    {.bitmap_index = 195, .adv_w = 129, .box_w = 8, .box_h = 13, .ofs_x = 0, .ofs_y = 0},
    {.bitmap_index = 221, .adv_w = 131, .box_w = 8, .box_h = 14, .ofs_x = 0, .ofs_y = -1},
    {.bitmap_index = 249, .adv_w = 147, .box_w = 9, .box_h = 12, .ofs_x = 0, .ofs_y = 0},
    {.bitmap_index = 276, .adv_w = 147, .box_w = 9, .box_h = 13, .ofs_x = 0, .ofs_y = 0},
    {.bitmap_index = 306, .adv_w = 110, .box_w = 7, .box_h = 12, .ofs_x = 0, .ofs_y = 0},
    {.bitmap_index = 327, .adv_w = 162, .box_w = 10, .box_h = 14, .ofs_x = 0, .ofs_y = -1},
    {.bitmap_index = 362, .adv_w = 156, .box_w = 10, .box_h = 14, .ofs_x = 0, .ofs_y = -1},
    {.bitmap_index = 397, .adv_w = 141, .box_w = 9, .box_h = 13, .ofs_x = 0, .ofs_y = 0},
    {.bitmap_index = 427, .adv_w = 168, .box_w = 11, .box_h = 14, .ofs_x = 0, .ofs_y = -1},
    {.bitmap_index = 466, .adv_w = 139, .box_w = 9, .box_h = 14, .ofs_x = 0, .ofs_y = -1},
    {.bitmap_index = 498, .adv_w = 146, .box_w = 9, .box_h = 14, .ofs_x = 0, .ofs_y = -1},
    {.bitmap_index = 530, .adv_w = 155, .box_w = 10, .box_h = 13, .ofs_x = 0, .ofs_y = 0},
    {.bitmap_index = 563, .adv_w = 183, .box_w = 12, .box_h = 14, .ofs_x = 0, .ofs_y = -1},
    {.bitmap_index = 605, .adv_w = 93, .box_w = 6, .box_h = 14, .ofs_x = 0, .ofs_y = -1},
    {.bitmap_index = 626, .adv_w = 125, .box_w = 8, .box_h = 13, .ofs_x = 0, .ofs_y = 0},
    {.bitmap_index = 652, .adv_w = 167, .box_w = 11, .box_h = 14, .ofs_x = 0, .ofs_y = -1},
    {.bitmap_index = 691, .adv_w = 118, .box_w = 8, .box_h = 14, .ofs_x = 0, .ofs_y = -1},
    {.bitmap_index = 719, .adv_w = 237, .box_w = 15, .box_h = 14, .ofs_x = 0, .ofs_y = -1},
    {.bitmap_index = 772, .adv_w = 197, .box_w = 13, .box_h = 13, .ofs_x = 0, .ofs_y = -1},
    {.bitmap_index = 815, .adv_w = 181, .box_w = 12, .box_h = 12, .ofs_x = 0, .ofs_y = 0},
    {.bitmap_index = 851, .adv_w = 157, .box_w = 10, .box_h = 14, .ofs_x = 0, .ofs_y = -1},
    {.bitmap_index = 886, .adv_w = 175, .box_w = 11, .box_h = 13, .ofs_x = 0, .ofs_y = -1},
    {.bitmap_index = 922, .adv_w = 154, .box_w = 10, .box_h = 14, .ofs_x = 0, .ofs_y = -1},
    {.bitmap_index = 957, .adv_w = 130, .box_w = 8, .box_h = 14, .ofs_x = 0, .ofs_y = -1},
    {.bitmap_index = 985, .adv_w = 134, .box_w = 9, .box_h = 14, .ofs_x = 0, .ofs_y = -1},
    {.bitmap_index = 1017, .adv_w = 179, .box_w = 11, .box_h = 14, .ofs_x = 0, .ofs_y = -1},
    {.bitmap_index = 1056, .adv_w = 149, .box_w = 10, .box_h = 14, .ofs_x = 0, .ofs_y = -1},
    {.bitmap_index = 1091, .adv_w = 255, .box_w = 16, .box_h = 14, .ofs_x = 0, .ofs_y = -1},
    {.bitmap_index = 1147, .adv_w = 180, .box_w = 11, .box_h = 14, .ofs_x = 0, .ofs_y = -1},
    {.bitmap_index = 1186, .adv_w = 174, .box_w = 11, .box_h = 13, .ofs_x = 0, .ofs_y = 0},
    {.bitmap_index = 1222, .adv_w = 146, .box_w = 9, .box_h = 14, .ofs_x = 0, .ofs_y = -1},
    {.bitmap_index = 1254, .adv_w = 132, .box_w = 8, .box_h = 12, .ofs_x = 0, .ofs_y = -1},
    {.bitmap_index = 1278, .adv_w = 126, .box_w = 8, .box_h = 12, .ofs_x = 0, .ofs_y = -1},
    {.bitmap_index = 1302, .adv_w = 114, .box_w = 7, .box_h = 11, .ofs_x = 0, .ofs_y = 0},
    {.bitmap_index = 1322, .adv_w = 137, .box_w = 9, .box_h = 12, .ofs_x = 0, .ofs_y = -1},
    {.bitmap_index = 1349, .adv_w = 114, .box_w = 7, .box_h = 12, .ofs_x = 0, .ofs_y = -1},
    {.bitmap_index = 1370, .adv_w = 118, .box_w = 8, .box_h = 10, .ofs_x = 0, .ofs_y = 0},
    {.bitmap_index = 1390, .adv_w = 126, .box_w = 8, .box_h = 11, .ofs_x = 0, .ofs_y = 0},
    {.bitmap_index = 1412, .adv_w = 147, .box_w = 9, .box_h = 12, .ofs_x = 0, .ofs_y = -1},
    {.bitmap_index = 1439, .adv_w = 75, .box_w = 5, .box_h = 11, .ofs_x = 0, .ofs_y = 0},
    {.bitmap_index = 1453, .adv_w = 101, .box_w = 7, .box_h = 11, .ofs_x = 0, .ofs_y = 0},
    {.bitmap_index = 1473, .adv_w = 134, .box_w = 9, .box_h = 12, .ofs_x = 0, .ofs_y = -1},
    {.bitmap_index = 1500, .adv_w = 96, .box_w = 6, .box_h = 12, .ofs_x = 0, .ofs_y = -1},
    {.bitmap_index = 1518, .adv_w = 192, .box_w = 12, .box_h = 11, .ofs_x = 0, .ofs_y = -1},
    {.bitmap_index = 1551, .adv_w = 160, .box_w = 10, .box_h = 11, .ofs_x = 0, .ofs_y = -1},
    {.bitmap_index = 1579, .adv_w = 145, .box_w = 9, .box_h = 10, .ofs_x = 0, .ofs_y = 0},
    {.bitmap_index = 1602, .adv_w = 126, .box_w = 8, .box_h = 11, .ofs_x = 0, .ofs_y = 0},
    {.bitmap_index = 1624, .adv_w = 140, .box_w = 9, .box_h = 11, .ofs_x = 0, .ofs_y = -1},
    {.bitmap_index = 1649, .adv_w = 121, .box_w = 8, .box_h = 12, .ofs_x = 0, .ofs_y = -1},
    {.bitmap_index = 1673, .adv_w = 104, .box_w = 7, .box_h = 12, .ofs_x = 0, .ofs_y = -1},
    {.bitmap_index = 1694, .adv_w = 108, .box_w = 7, .box_h = 11, .ofs_x = 0, .ofs_y = -1},
    {.bitmap_index = 1714, .adv_w = 145, .box_w = 9, .box_h = 12, .ofs_x = 0, .ofs_y = -1},
    {.bitmap_index = 1741, .adv_w = 121, .box_w = 8, .box_h = 12, .ofs_x = 0, .ofs_y = -1},
    {.bitmap_index = 1765, .adv_w = 205, .box_w = 13, .box_h = 12, .ofs_x = 0, .ofs_y = -1},
    {.bitmap_index = 1804, .adv_w = 146, .box_w = 9, .box_h = 11, .ofs_x = 0, .ofs_y = -1},
    {.bitmap_index = 1829, .adv_w = 141, .box_w = 9, .box_h = 11, .ofs_x = 0, .ofs_y = 0},
    {.bitmap_index = 1854, .adv_w = 120, .box_w = 8, .box_h = 12, .ofs_x = 0, .ofs_y = -1}
};
/*---------------------
 *  CHARACTER MAPPING
 *--------------------*/
static const uint16_t monster_unicode_list_0[] = {
    0x0, 0x1, 0x10, 0x11, 0x12, 0x13, 0x14, 0x15,
    0x16, 0x17, 0x18, 0x19, 0x1f
};
/*Collect the unicode lists and glyph_id offsets*/
static const lv_font_fmt_txt_cmap_t monster_cmaps[] =
{
    {
        .range_start = 32, .range_length = 32, .glyph_id_start = 1,
        .unicode_list = monster_unicode_list_0, .glyph_id_ofs_list = NULL, .list_length = 13, .type = LV_FONT_FMT_TXT_CMAP_SPARSE_TINY
    },
    {
        .range_start = 65, .range_length = 26, .glyph_id_start = 14,
        .unicode_list = NULL, .glyph_id_ofs_list = NULL, .list_length = 0, .type = LV_FONT_FMT_TXT_CMAP_FORMAT0_TINY
    },
    {
        .range_start = 97, .range_length = 26, .glyph_id_start = 40,
        .unicode_list = NULL, .glyph_id_ofs_list = NULL, .list_length = 0, .type = LV_FONT_FMT_TXT_CMAP_FORMAT0_TINY
    }
};
/*--------------------
 *  ALL CUSTOM DATA
 *--------------------*/
/*Store all the custom data of the font*/
static lv_font_fmt_txt_glyph_cache_t monster_cache;
static const lv_font_fmt_txt_dsc_t monster_font_dsc = {
    .glyph_bitmap = monster_glyph_bitmap,
    .glyph_dsc = monster_glyph_dsc,
    .cmaps = monster_cmaps,
    .kern_dsc = NULL,
    .kern_scale = 0,
    .cmap_num = 3,
    .bpp = 2,
    .kern_classes = 0,
    .bitmap_format = 0,
    .cache = &monster_cache
};
/*-----------------
 *  PUBLIC FONT
 *----------------*/
/*Initialize a public general font descriptor*/
const lv_font_t monster = {
    .get_glyph_dsc = lv_font_get_glyph_dsc_fmt_txt,    /*Function pointer to get glyph's data*/
    .get_glyph_bitmap = lv_font_get_bitmap_fmt_txt,    /*Function pointer to get glyph's bitmap*/
    .line_height = 14,          /*The maximum line height required by the font*/
    .base_line = 1,             /*Baseline measured from the bottom of the line*/

    .subpx = LV_FONT_SUBPX_NONE,
    .underline_position = -1,
    .underline_thickness = 1,
    .dsc = &monster_font_dsc,          /*The custom font data. Will be accessed by `get_glyph_bitmap/dsc` */
};
#endif

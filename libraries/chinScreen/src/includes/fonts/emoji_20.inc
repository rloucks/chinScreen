/*******************************************************************************
 * Size: 20 px
 * Bpp: 2
 ******************************************************************************/


#ifdef __has_include

    #if __has_include("lvgl.h")
         #ifndef LV_LVGL_H_INCLUDE_SIMPLE
             #define LV_LVGL_H_INCLUDE_SIMPLE
         #endif
     #endif
 #endif

 #ifdef LV_LVGL_H_INCLUDE_SIMPLE
     #include "lvgl.h"
 #else
     #include "../lvgl-8.3.11/lvgl.h"
 #endif

 #ifndef EMOJI_20
 #define EMOJI_20 1
 #endif

 #if EMOJI_20

/*-----------------
 *    BITMAPS
 *----------------*/
/*Store the image of the glyphs*/
static LV_ATTRIBUTE_LARGE_CONST const uint8_t emoji_20_glyph_bitmap[] = {
    /* U+0020 " " */
    /* U+0030 "0" */
    0x0, 0x6a, 0x94, 0x0, 0x14, 0x0, 0x8, 0x1,
    0x40, 0x0, 0x8, 0x8, 0x0, 0x0, 0x4, 0x40,
    0x0, 0x0, 0x12, 0x2, 0x80, 0xc0, 0x4, 0xf,
    0x7, 0x40, 0x50, 0x0, 0x4, 0x1, 0x80, 0x0,
    0x0, 0x12, 0x3, 0xff, 0xe0, 0x82, 0x0, 0x0,
    0x2, 0x5, 0x0, 0x0, 0x20, 0x2, 0x0, 0x6,
    0x0, 0x1, 0xaa, 0x90, 0x0,
    /* U+0031 "1" */
    0x1a, 0xff, 0xfe, 0x82, 0xd1, 0x55, 0x56, 0xd3,
    0xe5, 0x55, 0xad, 0x4, 0x0, 0x0, 0x4, 0x0,
    0xf0, 0x78, 0x20, 0x2, 0x52, 0x60, 0x14, 0x0,
    0x0, 0x0, 0x63, 0x0, 0x0, 0x62, 0x8a, 0x0,
    0x3, 0x6, 0xb, 0x40, 0x74, 0x42, 0x7, 0xff,
    0x42, 0x5, 0x0, 0x0, 0x20, 0x6, 0x0, 0x2,
    0x0, 0x2, 0xaa, 0x90, 0x0,
    /* U+0032 "2" */
    0x0, 0x6a, 0xa4, 0x0, 0x18, 0x0, 0x8, 0x1,
    0x40, 0x0, 0x8, 0x8, 0x0, 0x0, 0x4, 0x40,
    0x0, 0x0, 0x12, 0x0, 0x0, 0x0, 0x18, 0x8,
    0x1, 0x40, 0x60, 0x2d, 0x2d, 0x1, 0x80, 0x74,
    0xb0, 0x5, 0x0, 0x40, 0x40, 0x42, 0x1, 0xfc,
    0x1, 0x5, 0x8, 0x18, 0x20, 0x2, 0x0, 0x2,
    0x0, 0x1, 0xaa, 0x90, 0x0,
    /* U+0033 "3" */
    0x0, 0x6a, 0xa4, 0x0, 0x8, 0x0, 0x18, 0x0,
    0x80, 0x0, 0x8, 0x8, 0x0, 0x0, 0x8, 0x50,
    0x0, 0x0, 0x22, 0x0, 0x0, 0x0, 0x18, 0x2c,
    0x1, 0xe0, 0x60, 0x3e, 0x3f, 0x1, 0x83, 0xe0,
    0x2d, 0x5, 0x0, 0x0, 0x10, 0x41, 0x1f, 0xff,
    0xc1, 0x1, 0x0, 0x40, 0x20, 0x6, 0x0, 0x6,
    0x0, 0x2, 0xaa, 0x80, 0x0,
    /* U+0034 "4" */
    0x0, 0x6a, 0x50, 0x0, 0x14, 0x0, 0x18, 0x1,
    0x40, 0x0, 0x8, 0x4, 0x0, 0x0, 0x8, 0x40,
    0x0, 0x0, 0x22, 0x3, 0xc1, 0xd0, 0x14, 0xb,
    0x7, 0x40, 0x50, 0x0, 0x0, 0x1, 0x80, 0x0,
    0x0, 0x11, 0x1, 0x41, 0x40, 0x82, 0x3, 0xfe,
    0x1, 0x5, 0x0, 0x40, 0x20, 0x6, 0x0, 0x6,
    0x0, 0x1, 0xaa, 0x90, 0x0,
    /* U+0035 "5" */
    0x0, 0x5a, 0xa0, 0x0, 0x14, 0x0, 0x18, 0x1,
    0x0, 0x0, 0x8, 0x4, 0x0, 0x0, 0x4, 0x46,
    0x0, 0xa, 0x21, 0x0, 0x0, 0x0, 0x44, 0x2d,
    0x3, 0xc1, 0x10, 0x24, 0x2, 0x4, 0x80, 0x0,
    0x0, 0x11, 0x0, 0x1, 0xc0, 0x82, 0x3, 0xfd,
    0x1, 0x6, 0x0, 0x0, 0x10, 0x6, 0x40, 0x9,
    0x0, 0x1, 0xaa, 0x80, 0x0,
    /* U+0036 "6" */
    0x0, 0x6a, 0x90, 0x0, 0x8, 0x0, 0x18, 0x0,
    0x40, 0x0, 0x8, 0x8, 0x0, 0x0, 0x4, 0x40,
    0x90, 0x20, 0x22, 0x3, 0xc0, 0xe0, 0x58, 0xa,
    0x3, 0x40, 0x60, 0x0, 0x0, 0x1, 0x86, 0x62,
    0x22, 0x5, 0x1f, 0xff, 0xfe, 0x82, 0x1d, 0x9d,
    0x8f, 0x1, 0x0, 0x0, 0x3c, 0x2, 0x0, 0x6,
    0x0, 0x1, 0xaa, 0x90, 0x0,
    /* U+0037 "7" */
    0x0, 0x6a, 0xa4, 0x0, 0x18, 0x0, 0x18, 0x1,
    0x40, 0x0, 0x8, 0x4, 0x0, 0x0, 0x4, 0x80,
    0xf0, 0xb8, 0x12, 0x5, 0x41, 0x50, 0x14, 0x5,
    0x4, 0x0, 0x50, 0x19, 0x4d, 0x1, 0x81, 0x11,
    0x5c, 0x11, 0x4, 0x2, 0x60, 0x82, 0x40, 0x2,
    0x82, 0x3, 0x0, 0x19, 0x20, 0x2, 0x1, 0x8a,
    0x0, 0x2, 0x7e, 0x80, 0x0,
    /* U+0038 "8" */
    0x0, 0x6a, 0xa4, 0x0, 0x14, 0x0, 0x8, 0x1,
    0x40, 0x0, 0x8, 0x8, 0x60, 0x6, 0x8, 0x40,
    0x0, 0x1, 0x12, 0x0, 0x0, 0x0, 0x14, 0x2f,
    0x7, 0xd0, 0x50, 0x0, 0x0, 0x1, 0x40, 0x0,
    0x0, 0x5, 0x0, 0x0, 0x0, 0x82, 0x2, 0xfc,
    0x2, 0x5, 0x1, 0x80, 0x20, 0x6, 0x0, 0x6,
    0x0, 0x1, 0xaa, 0x90, 0x0,
    /* U+0039 "9" */
    0x0, 0x5, 0x84, 0x0, 0x1, 0xa5, 0x0, 0x40,
    0xa, 0x40, 0xbe, 0xa0, 0x25, 0x50, 0x0, 0x4,
    0x10, 0x0, 0x16, 0x8, 0x95, 0x5a, 0x1, 0x8,
    0x40, 0x7c, 0x2c, 0x4, 0x41, 0x7c, 0x2d, 0x4,
    0x50, 0x10, 0x4, 0x8, 0x20, 0x7, 0xe0, 0x8,
    0x14, 0x0, 0x18, 0x10, 0x9, 0x0, 0x0, 0x50,
    0x1, 0x40, 0x2, 0x40, 0x0, 0x2a, 0x94, 0x0,
    /* U+0041 "A" */
    0x0, 0x6a, 0xa4, 0x0, 0x4, 0x0, 0x18, 0x0,
    0x40, 0x0, 0x8, 0x8, 0x64, 0xa, 0x4, 0x40,
    0x0, 0x0, 0x12, 0x7, 0xc0, 0xf0, 0x18, 0x15,
    0x5, 0x50, 0x60, 0x0, 0x0, 0x1, 0x80, 0x0,
    0x0, 0x5, 0x2, 0xff, 0xc0, 0x42, 0x2, 0xfc,
    0x2, 0x2, 0x0, 0x0, 0x20, 0x2, 0x0, 0x6,
    0x0, 0x1, 0xaa, 0x90, 0x0,
    /* U+0042 "B" */
    0x0, 0x6a, 0xa4, 0x0, 0x14, 0x1, 0x58, 0x1,
    0x40, 0x20, 0x48, 0x8, 0x0, 0x4, 0x48, 0x81,
    0x44, 0x71, 0x12, 0x15, 0x44, 0x4, 0x14, 0x65,
    0x5, 0x40, 0x50, 0x50, 0xb, 0xc1, 0x80, 0x1a,
    0xbf, 0x11, 0xb, 0x84, 0xf8, 0x82, 0x1d, 0x3,
    0x85, 0x2, 0x4, 0x4, 0x60, 0x2, 0x50, 0x19,
    0x0, 0x0, 0x55, 0x40, 0x0,
    /* U+0043 "C" */
    0x2f, 0xf9, 0xbf, 0xf0, 0x7f, 0xc0, 0xb, 0xf8,
    0x7f, 0x0, 0x2, 0xf8, 0xfc, 0x0, 0x0, 0x7c,
    0xa0, 0xb0, 0x28, 0x1c, 0x40, 0xb0, 0x38, 0x4,
    0x40, 0xb, 0xd0, 0x4, 0x47, 0x9f, 0xe7, 0x84,
    0x41, 0x1f, 0xe0, 0x4, 0x11, 0x47, 0x85, 0x10,
    0x12, 0xff, 0xfe, 0x10, 0x4, 0x2f, 0xe4, 0x40,
    0x1, 0x0, 0x1, 0x0, 0x0, 0x55, 0x54, 0x0,
    /* U+0044 "D" */
    0x0, 0x5a, 0x94, 0x0, 0x8, 0x0, 0x18, 0x0,
    0x40, 0x0, 0x8, 0x4, 0x0, 0x0, 0x4, 0x40,
    0x0, 0x0, 0x12, 0x2c, 0x0, 0x2c, 0x14, 0xb0,
    0x0, 0xf0, 0x60, 0x0, 0x0, 0x41, 0x50, 0x10,
    0x80, 0x54, 0x40, 0x14, 0x0, 0x82, 0x0, 0x0,
    0x2, 0x2, 0x0, 0x0, 0x20, 0x2, 0x0, 0x2,
    0x0, 0x1, 0xaa, 0x90, 0x0,
    /* U+0045 "E" */
    0x0, 0x5a, 0xa4, 0x0, 0x14, 0x0, 0x18, 0x1,
    0xa8, 0x0, 0xa8, 0x8, 0x0, 0x1, 0x4, 0x45,
    0x10, 0x51, 0x12, 0x10, 0x11, 0x1, 0x14, 0x1c,
    0x41, 0xc4, 0x51, 0x0, 0x10, 0x11, 0x81, 0x40,
    0x15, 0x5, 0x0, 0x0, 0x0, 0x82, 0x0, 0xf8,
    0x2, 0x5, 0x0, 0x0, 0x20, 0x2, 0x0, 0x6,
    0x0, 0x1, 0xaa, 0x90, 0x0,
    /* U+0046 "F" */
    0x0, 0x6a, 0xa4, 0x0, 0x14, 0x0, 0x8, 0x1,
    0x40, 0x0, 0x8, 0x8, 0x0, 0x0, 0x4, 0x40,
    0x0, 0x0, 0x12, 0x1f, 0x81, 0xf8, 0x14, 0x0,
    0x0, 0x0, 0x50, 0x0, 0x0, 0x1, 0x80, 0x0,
    0x0, 0x5, 0x3, 0xff, 0xe0, 0x82, 0x0, 0x0,
    0x2, 0x5, 0x0, 0x0, 0x20, 0x2, 0x0, 0x6,
    0x0, 0x1, 0xaa, 0x90, 0x0,
    /* U+0047 "G" */
    0x0, 0x56, 0x94, 0x0, 0x14, 0x0, 0x8, 0x1,
    0x40, 0x0, 0x8, 0x8, 0x0, 0x0, 0x8, 0x40,
    0xb0, 0x34, 0x12, 0x3, 0xc0, 0xe0, 0x18, 0x0,
    0x0, 0x0, 0x60, 0x15, 0x54, 0x1, 0x85, 0x96,
    0x59, 0x5, 0x26, 0xae, 0xb9, 0x42, 0x2a, 0xba,
    0xa2, 0x1, 0x0, 0x0, 0x20, 0x2, 0x0, 0x6,
    0x0, 0x1, 0xaa, 0x90, 0x0,
    /* U+0048 "H" */
    0x0, 0x6f, 0xe4, 0x0, 0x1b, 0xfb, 0xf8, 0x1,
    0x83, 0x2, 0xc, 0x4, 0xb9, 0x1f, 0x68, 0x24,
    0x0, 0x0, 0x31, 0x2, 0xc1, 0xd1, 0x28, 0xf,
    0x3, 0x84, 0xaa, 0x80, 0x0, 0xe1, 0x90, 0x0,
    0x0, 0x1, 0x12, 0xae, 0xe0, 0x42, 0x3e, 0x13,
    0xe1, 0x5, 0x28, 0xd, 0x10, 0x6, 0x10, 0x52,
    0x0, 0x1, 0x7f, 0x50, 0x0,
    /* U+0049 "I" */
    0x0, 0x6a, 0xa4, 0x0, 0x9, 0x0, 0x9, 0x0,
    0x80, 0x0, 0x5, 0x4, 0x0, 0x0, 0x8, 0x11,
    0xc0, 0xa, 0x5, 0x2, 0xd0, 0xf4, 0x24, 0xf,
    0x86, 0xe0, 0x90, 0x1, 0x80, 0x2, 0x51, 0x40,
    0x4a, 0x9, 0x0, 0x43, 0xfc, 0x11, 0x15, 0x5f,
    0x82, 0x4, 0x0, 0x90, 0x24, 0x15, 0x8, 0x2,
    0x0, 0x1, 0xba, 0x90, 0x0,
    /* U+004A "J" */
    0x0, 0x0, 0x0, 0x0, 0x93, 0xe5, 0x6b, 0x1,
    0xb4, 0x0, 0x3d, 0x0, 0x40, 0x0, 0x80, 0x2c,
    0x0, 0x5, 0xd0, 0x71, 0x0, 0x53, 0x4, 0xe5,
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    0x0,
    /* U+004B "K" */
    0x0, 0x65, 0xa4, 0x0, 0x14, 0x0, 0x18, 0x1,
    0x40, 0x3, 0x88, 0x8, 0xb4, 0x1, 0x54, 0x41,
    0x0, 0x0, 0x21, 0x2, 0xc0, 0xd0, 0x44, 0xf,
    0xb, 0x81, 0x50, 0x0, 0x15, 0x56, 0x40, 0x0,
    0x55, 0x69, 0x0, 0x0, 0x0, 0x82, 0x0, 0xb8,
    0x5, 0x5, 0xa, 0x0, 0x20, 0x6, 0x0, 0x6,
    0x0, 0x1, 0xaa, 0x90, 0x0,
    /* U+004C "L" */
    0x0, 0x56, 0x94, 0x0, 0x4, 0x0, 0x8, 0x0,
    0x40, 0x0, 0x8, 0x4, 0x70, 0x0, 0x8, 0x42,
    0x0, 0x0, 0x12, 0x2, 0x80, 0xb0, 0x18, 0xf,
    0xb, 0xc0, 0x60, 0x0, 0x0, 0x1, 0x80, 0x0,
    0x0, 0x5, 0x1, 0xff, 0xd0, 0x42, 0x1, 0xf8,
    0x2, 0x5, 0x0, 0x0, 0x20, 0x6, 0x0, 0x6,
    0x0, 0x1, 0xaa, 0x90, 0x0,
    /* U+004D "M" */
    0x0, 0x5a, 0x94, 0x0, 0x18, 0x0, 0x18, 0x1,
    0x40, 0x0, 0x8, 0x9, 0xe4, 0xb, 0x58, 0x5b,
    0x4, 0x78, 0x62, 0x40, 0x10, 0x0, 0x55, 0x0,
    0x44, 0x0, 0x61, 0x1, 0x10, 0x11, 0x81, 0x50,
    0x15, 0x15, 0x0, 0x0, 0x0, 0x82, 0x0, 0xbc,
    0x2, 0x5, 0x6, 0x40, 0x20, 0x6, 0x0, 0x6,
    0x0, 0x1, 0xaa, 0x80, 0x0,
    /* U+004E "N" */
    0x0, 0x6a, 0x94, 0x0, 0x18, 0x0, 0x8, 0x0,
    0x40, 0x0, 0x8, 0x8, 0x8, 0x8, 0x8, 0x40,
    0x80, 0x14, 0x12, 0x2, 0xc1, 0xd0, 0x4, 0xf,
    0x7, 0x40, 0x50, 0x0, 0x4, 0x1, 0x80, 0x0,
    0x0, 0x15, 0x1, 0xff, 0xc0, 0x81, 0x6, 0x3,
    0x2, 0x5, 0x10, 0x8, 0x20, 0x6, 0x0, 0x2,
    0x0, 0x2, 0xaa, 0x90, 0x0,
    /* U+004F "O" */
    0x0, 0x5a, 0x94, 0x0, 0x14, 0x0, 0x18, 0x1,
    0x40, 0x0, 0x8, 0x8, 0x0, 0x0, 0x4, 0x40,
    0x0, 0x0, 0x12, 0x2, 0xc1, 0xd0, 0x14, 0xf,
    0x7, 0x40, 0x50, 0x0, 0x0, 0x1, 0x40, 0x0,
    0x0, 0x5, 0x0, 0x0, 0x0, 0x82, 0x0, 0x0,
    0x2, 0x5, 0x0, 0x0, 0x20, 0x6, 0x0, 0x6,
    0x0, 0x1, 0xaa, 0x90, 0x0,
    /* U+0050 "P" */
    0x0, 0x0, 0x0, 0x10, 0xb0, 0x7, 0x5, 0xc0,
    0x5, 0x67, 0xc1, 0x1, 0x80, 0x4, 0x10, 0x14,
    0x0, 0x0, 0x40, 0x80, 0x0, 0x2, 0x4, 0x0,
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    0x0,
    /* U+0051 "Q" */
    0x0, 0x6a, 0xa4, 0x0, 0x9, 0x0, 0x18, 0x0,
    0x80, 0x0, 0x8, 0xc, 0x0, 0x0, 0x8, 0x60,
    0x0, 0x0, 0x12, 0x3, 0xd1, 0xf0, 0x18, 0x14,
    0x0, 0x50, 0x91, 0x55, 0x55, 0x55, 0x94, 0x0,
    0x0, 0x5, 0x50, 0x0, 0x1, 0x52, 0x0, 0x0,
    0x6, 0x1, 0x40, 0x0, 0x10, 0x2, 0x54, 0x15,
    0x0, 0x1, 0xaa, 0x50, 0x0,
    /* U+0052 "R" */
    0x0, 0x65, 0x69, 0x0, 0x2, 0x40, 0x1, 0x80,
    0x9, 0xd0, 0x2, 0x20, 0x14, 0xb8, 0x2d, 0x4,
    0x30, 0xf8, 0x3f, 0x98, 0xb6, 0x80, 0x3, 0x4,
    0x40, 0x55, 0x55, 0x84, 0x2b, 0x40, 0x1, 0xe8,
    0x23, 0xff, 0xff, 0xc4, 0x20, 0xb9, 0x6f, 0x4,
    0x4, 0x1a, 0x94, 0x10, 0x5, 0x0, 0x0, 0x10,
    0x1, 0x40, 0x1, 0x40, 0x0, 0x2a, 0xa8, 0x0,
    /* U+0053 "S" */
    0x0, 0x6a, 0xa4, 0x0, 0xb, 0x40, 0xb8, 0x0,
    0x50, 0x0, 0x48, 0x8, 0xa0, 0x2, 0x88, 0x5b,
    0xd0, 0x2b, 0x52, 0x5, 0x0, 0x48, 0x18, 0x14,
    0x0, 0x10, 0x60, 0x57, 0xe8, 0x41, 0x81, 0x3f,
    0xf1, 0x15, 0x4, 0xff, 0xc4, 0x82, 0x13, 0xaf,
    0x11, 0x6, 0x4, 0x4, 0x20, 0x10, 0x10, 0x0,
    0x10, 0x15, 0xeb, 0x9a, 0x0,
    /* U+0054 "T" */
    0x0, 0x55, 0x64, 0x0, 0x14, 0x0, 0x8, 0x1,
    0x44, 0x1, 0x88, 0x4, 0x90, 0x0, 0x8, 0x80,
    0x0, 0x0, 0x12, 0x7, 0xc1, 0xe0, 0x14, 0x20,
    0x0, 0x50, 0x50, 0x0, 0x0, 0x1, 0x80, 0x0,
    0x0, 0x11, 0x2, 0x41, 0x90, 0x82, 0x3, 0xff,
    0x5, 0x2, 0x1, 0xc4, 0x60, 0x2, 0x41, 0x19,
    0x0, 0x0, 0x69, 0x80, 0x0,
    /* U+0055 "U" */
    0x0, 0x55, 0x64, 0x0, 0x14, 0x0, 0x8, 0x1,
    0x40, 0x0, 0x8, 0x4, 0x0, 0x0, 0x8, 0x40,
    0xa0, 0x34, 0x12, 0x3, 0xc0, 0xe0, 0x18, 0x5,
    0x2, 0x0, 0x60, 0x0, 0x0, 0x1, 0x87, 0xfa,
    0xbe, 0x15, 0x4f, 0x44, 0xf4, 0x82, 0x1d, 0x13,
    0xc5, 0x2, 0x54, 0xc, 0x90, 0x1, 0xa0, 0x39,
    0x0, 0x0, 0x56, 0x40, 0x0,
    /* U+0056 "V" */
    0x0, 0x6a, 0xa4, 0x0, 0x18, 0x0, 0x8, 0x1,
    0x40, 0x0, 0x8, 0x8, 0x0, 0x0, 0x8, 0x40,
    0xa0, 0x34, 0x12, 0x3, 0xc0, 0xe0, 0x18, 0x0,
    0x0, 0x0, 0x60, 0x1, 0x20, 0x1, 0x80, 0x5,
    0x50, 0x5, 0x40, 0x1, 0x90, 0x82, 0x1, 0x5,
    0x41, 0x2, 0x4, 0x8, 0x60, 0x2, 0xa0, 0x6a,
    0x0, 0x0, 0x96, 0x80, 0x0,
    /* U+0057 "W" */
    0x0, 0x5a, 0x94, 0x0, 0x18, 0x0, 0x48, 0x0,
    0x41, 0x1, 0x88, 0x8, 0xb4, 0x0, 0x8, 0x47,
    0xf4, 0x7e, 0x12, 0x12, 0xd3, 0xfd, 0x18, 0x40,
    0x4e, 0x4, 0x61, 0x1, 0x0, 0x1, 0x81, 0x50,
    0x1, 0x5, 0x0, 0x0, 0xc, 0x42, 0x2b, 0xff,
    0x82, 0x5, 0x0, 0x0, 0x20, 0x6, 0x0, 0x6,
    0x0, 0x1, 0xaa, 0x90, 0x0,
    /* U+0058 "X" */
    0x0, 0x6a, 0x94, 0x0, 0x18, 0x0, 0x8, 0x1,
    0x40, 0x1, 0x48, 0x9, 0xa0, 0x29, 0x4, 0x84,
    0x2, 0x5, 0x22, 0xb, 0x10, 0xc9, 0x54, 0x3c,
    0x47, 0x28, 0x50, 0x0, 0x81, 0x61, 0x80, 0x0,
    0x64, 0x95, 0x0, 0x0, 0x2, 0x42, 0x3, 0xf0,
    0xe, 0x5, 0x0, 0x0, 0x30, 0x6, 0x0, 0x3,
    0x80, 0x2, 0xaa, 0x91, 0x0,
    /* U+0059 "Y" */
    0x0, 0x0, 0x0, 0x0, 0x0, 0x2f, 0xf8, 0x0,
    0x1, 0xff, 0xfe, 0x0, 0xbf, 0x6a, 0xa6, 0xfe,
    0xbf, 0xff, 0xff, 0xfd, 0x7f, 0xff, 0xff, 0x6c,
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    0x0, 0x1a, 0xa4, 0x0,
    /* U+005A "Z" */
    0x0, 0xbd, 0xa4, 0x0, 0x8, 0x0, 0x68, 0x1,
    0x4b, 0x6, 0x8, 0x8, 0x2c, 0x1c, 0x8, 0x40,
    0x0, 0x70, 0x12, 0x0, 0x0, 0x0, 0x14, 0x3,
    0xe0, 0x0, 0xb4, 0x0, 0x60, 0x2, 0xa4, 0x19,
    0x0, 0x6, 0x15, 0x4, 0x0, 0x48, 0x1, 0x0,
    0x2, 0x10, 0x8, 0x0, 0x20, 0x10, 0x20, 0x2,
    0x0, 0x6b, 0xe6, 0x90, 0x0,
    /* U+0061 "a" */
    0x0, 0x65, 0x64, 0x0, 0x8, 0x0, 0x18, 0x0,
    0x80, 0x0, 0x8, 0xc, 0x0, 0x0, 0x18, 0xbf,
    0xff, 0xff, 0xfa, 0xef, 0xfb, 0xbf, 0xdb, 0xff,
    0xcf, 0xff, 0x5f, 0xfd, 0x1f, 0xfd, 0x4f, 0xd0,
    0x1f, 0x90, 0x40, 0xaa, 0x80, 0x42, 0x2, 0xfd,
    0x2, 0x1, 0x0, 0x0, 0x20, 0x2, 0x0, 0x2,
    0x0, 0x2, 0xaa, 0x90, 0x0,
    /* U+0062 "b" */
    0x0, 0x6a, 0xa4, 0x0, 0x18, 0x0, 0x18, 0x0,
    0x83, 0x6, 0x8, 0x8, 0x34, 0xe, 0x4, 0x51,
    0x40, 0x4, 0x22, 0xb, 0x40, 0xb4, 0x58, 0xf,
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    0x0,
    /* U+0063 "c" */
    0x0, 0x55, 0x50, 0x0, 0x5, 0x0, 0x19, 0x0,
    0x20, 0xa4, 0x1, 0x40, 0x41, 0x20, 0x22, 0x54,
    0x44, 0x90, 0x1f, 0x8, 0xb4, 0x70, 0x36, 0x18,
    0x89, 0xb0, 0x38, 0x8, 0x82, 0x0, 0x0, 0x8,
    0x6b, 0xea, 0xaa, 0xa8, 0x3d, 0x22, 0x15, 0xf4,
    0x3d, 0x77, 0x69, 0xf0, 0xf, 0xbb, 0xab, 0xc0,
    0x3, 0xc3, 0xff, 0x0, 0x0, 0x9b, 0xf4, 0x0,
    /* U+0064 "d" */
    0x0, 0x56, 0xa4, 0x0, 0x4, 0x0, 0x18, 0x0,
    0x40, 0x0, 0x8, 0x4, 0x60, 0x2, 0x8, 0x40,
    0x0, 0x0, 0x11, 0x0, 0x0, 0x0, 0x18, 0xf,
    0x3, 0xc0, 0x60, 0x38, 0xe, 0x1, 0x80, 0x0,
    0x0, 0x5, 0x40, 0x7f, 0x0, 0x42, 0x3, 0xff,
    0x2, 0x6, 0xa, 0xa4, 0x20, 0x6, 0x0, 0x6,
    0x0, 0x1, 0xaa, 0x90, 0x0,
    /* U+0065 "e" */
    0x0, 0x5a, 0xa4, 0x0, 0x14, 0x0, 0x18, 0x1,
    0x40, 0x0, 0x8, 0x8, 0x0, 0x0, 0x8, 0x40,
    0xa0, 0x34, 0x22, 0x3, 0xc0, 0xd0, 0x14, 0x9,
    0x2, 0x0, 0x50, 0x0, 0x0, 0x1, 0x80, 0x1f,
    0x80, 0x5, 0x0, 0xff, 0x80, 0x42, 0x3, 0xfe,
    0x1, 0x5, 0x2, 0x90, 0x20, 0x6, 0x0, 0x6,
    0x0, 0x1, 0xaa, 0x90, 0x0,
    /* U+0066 "f" */
    0x0, 0x6a, 0xa4, 0x0, 0x18, 0x0, 0x8, 0x1,
    0x80, 0x40, 0x4, 0x8, 0xa, 0x34, 0x8, 0x50,
    0x0, 0x0, 0x26, 0x9, 0x52, 0x26, 0x18, 0xf,
    0x4b, 0xf6, 0x90, 0x0, 0x7, 0xf5, 0xa9, 0x6f,
    0xff, 0x5, 0xa, 0x55, 0x74, 0x1, 0x0, 0x0,
    0x1, 0x0, 0x0, 0x0, 0x10, 0x1, 0x0, 0x1,
    0x0, 0x1, 0x55, 0x50, 0x0,
    /* U+0067 "g" */
    0x2, 0xea, 0xa4, 0x0, 0x11, 0x0, 0x18, 0x1,
    0x4, 0x0, 0x8, 0xc, 0x0, 0x0, 0x8, 0x50,
    0x0, 0x0, 0x22, 0x25, 0x0, 0x0, 0x58, 0x31,
    0x0, 0x10, 0x60, 0xbc, 0x1f, 0x41, 0x80, 0x0,
    0x0, 0x15, 0x0, 0x19, 0x0, 0x82, 0x3, 0xfd,
    0x2, 0x5, 0x8, 0x14, 0x20, 0x6, 0x0, 0x6,
    0x0, 0x1, 0xaa, 0x90, 0x0,
    /* U+0068 "h" */
    0x0, 0x6a, 0xa4, 0x0, 0x14, 0x0, 0x18, 0x1,
    0x40, 0x2, 0x88, 0x8, 0x0, 0x0, 0x4, 0x42,
    0xa0, 0x0, 0x12, 0x0, 0x0, 0xd0, 0x14, 0xe,
    0x3, 0x40, 0x50, 0x28, 0xc, 0x1, 0x80, 0x0,
    0x0, 0x6, 0x0, 0x0, 0x0, 0x82, 0x1, 0xfc,
    0x2, 0x5, 0x0, 0x0, 0x20, 0x6, 0x0, 0x6,
    0x0, 0x1, 0xaa, 0x90, 0x0,
    /* U+0069 "i" */
    0x0, 0x6a, 0xa4, 0x0, 0x18, 0x0, 0x18, 0x1,
    0x40, 0x0, 0x8, 0x8, 0x0, 0x0, 0x4, 0x40,
    0x6, 0x40, 0x12, 0x1, 0xeb, 0xc0, 0x14, 0x0,
    0x0, 0x0, 0x50, 0x0, 0x0, 0x1, 0x80, 0x0,
    0x10, 0x6, 0x3, 0xc1, 0xd0, 0x82, 0xa, 0x3,
    0x42, 0x5, 0x0, 0x0, 0x20, 0x6, 0x0, 0x6,
    0x0, 0x1, 0xaa, 0x90, 0x0,
    /* U+006A "j" */
    0x0, 0x6a, 0xa4, 0x0, 0x8, 0x0, 0x8, 0x0,
    0x80, 0x0, 0x9, 0x8, 0x14, 0x5, 0x8, 0x11,
    0x4, 0x41, 0x15, 0x4, 0x11, 0x0, 0x28, 0x10,
    0x44, 0x10, 0x90, 0x0, 0x41, 0x1, 0x40, 0xb,
    0xc0, 0x5, 0x4, 0x3f, 0x4, 0x21, 0x4, 0xfc,
    0x1, 0x4, 0x1, 0xd0, 0x4, 0x4, 0x10, 0x10,
    0x40, 0x15, 0xd5, 0xd6, 0x0,
    /* U+006B "k" */
    0x0, 0x6a, 0x90, 0x0, 0x1c, 0x0, 0x28, 0x1,
    0xf4, 0x0, 0xbc, 0xf, 0xfe, 0x3f, 0xf8, 0x7f,
    0xf0, 0x7f, 0xf2, 0x3f, 0xc1, 0xff, 0x58, 0xfb,
    0x7, 0xb8, 0x56, 0x95, 0x56, 0xb1, 0x4e, 0x50,
    0x1b, 0x85, 0x1f, 0xff, 0xfc, 0x41, 0x1e, 0x7,
    0x81, 0x5, 0x1, 0x90, 0x10, 0x6, 0x0, 0x6,
    0x0, 0x1, 0xaa, 0x90, 0x0,
    /* U+006C "l" */
    0x0, 0x1a, 0x90, 0x0, 0x5, 0x0, 0x14, 0x0,
    0x80, 0x0, 0x4, 0x5, 0x0, 0x3c, 0x10, 0x20,
    0xf0, 0x90, 0x20, 0x41, 0x0, 0x4, 0x85, 0x0,
    0x6, 0xc2, 0x10, 0x2f, 0xf8, 0x4, 0x50, 0x0,
    0x1, 0x62, 0xc4, 0x0, 0x39, 0xd9, 0x54, 0x1,
    0x15, 0x54, 0x44, 0x4, 0x45, 0x10, 0x10, 0x20,
    0x10, 0x17, 0xea, 0xe5, 0x0,
    /* U+006D "m" */
    0x0, 0x6a, 0xa4, 0x0, 0x8, 0x0, 0x18, 0x1,
    0x47, 0x3, 0x8, 0x8, 0x34, 0x7, 0x8, 0x50,
    0x0, 0x40, 0x22, 0x1, 0xd2, 0xd0, 0x58, 0x1e,
    0x2, 0x80, 0x60, 0x1, 0x50, 0x1, 0x80, 0x20,
    0x20, 0x5, 0x3, 0xff, 0xe0, 0x42, 0xf, 0xff,
    0xc1, 0x5, 0x3e, 0x6f, 0x20, 0x5, 0x0, 0x6,
    0x0, 0x1, 0xaa, 0x90, 0x0,
    /* U+006E "n" */
    0x0, 0x55, 0x64, 0x0, 0x4, 0x0, 0x4, 0x0,
    0x0, 0x0, 0x4, 0x7, 0xe9, 0x1f, 0xf4, 0x60,
    0xf, 0xc0, 0x26, 0x87, 0x77, 0x34, 0xab, 0xd,
    0xcd, 0xd2, 0x99, 0xa, 0x18, 0x1e, 0x9e, 0xa9,
    0x6a, 0xd9, 0x6d, 0x40, 0x5b, 0x52, 0x3f, 0xff,
    0xf6, 0x6, 0x3d, 0x5f, 0x54, 0x6, 0x16, 0x92,
    0x40, 0x2, 0xaa, 0x90, 0x0,
    /* U+006F "o" */
    0x0, 0x7f, 0xe4, 0x0, 0xf, 0xff, 0xf8, 0x0,
    0x94, 0x1, 0x58, 0x8, 0x20, 0x5, 0x4, 0x42,
    0x0, 0x6, 0x12, 0x0, 0x0, 0x40, 0x18, 0xf,
    0x7, 0x40, 0x64, 0x2c, 0x1d, 0x1, 0xa8, 0x0,
    0x0, 0x3, 0x14, 0xbf, 0x40, 0x48, 0x17, 0xff,
    0x0, 0x10, 0x4a, 0xa4, 0x10, 0x1b, 0x0, 0x5,
    0x0, 0x2, 0xaa, 0x90, 0x0,
    /* U+0070 "p" */
    0x0, 0x6a, 0x64, 0x0, 0x18, 0x0, 0x4, 0x1,
    0x40, 0x0, 0x8, 0x8, 0x10, 0x1, 0x4, 0x42,
    0x80, 0x6, 0x12, 0x1, 0x40, 0x60, 0x4, 0x12,
    0x44, 0x60, 0x50, 0x9e, 0x13, 0xc1, 0x82, 0xf4,
    0x7d, 0x5, 0x0, 0x0, 0x0, 0x42, 0x0, 0x0,
    0x2, 0x5, 0x3, 0xe0, 0x20, 0x6, 0x0, 0x2,
    0x0, 0x2, 0xa6, 0x90, 0x0,
    /* U+0071 "q" */
    0x0, 0x6a, 0xa4, 0x0, 0x8, 0x0, 0x18, 0x1,
    0x40, 0x0, 0x8, 0x8, 0x40, 0x5, 0x8, 0x56,
    0xa0, 0xff, 0x22, 0xf, 0xd3, 0xb4, 0x58, 0x1e,
    0x2, 0x40, 0x60, 0x2, 0x90, 0x1, 0x80, 0x50,
    0x10, 0x5, 0x3, 0xff, 0xf0, 0x42, 0x1f, 0xff,
    0xc2, 0x1, 0xbe, 0x6f, 0x60, 0x2, 0x40, 0xa,
    0x0, 0x1, 0xaa, 0x90, 0x0,
    /* U+0072 "r" */
    0x0, 0x5a, 0xa4, 0x0, 0x14, 0x0, 0x18, 0x1,
    0x40, 0x0, 0x8, 0x8, 0x0, 0x0, 0x4, 0x41,
    0x0, 0x4, 0x22, 0x10, 0x0, 0x4, 0x14, 0x2e,
    0x3, 0xd0, 0x50, 0x24, 0x2, 0x1, 0x80, 0x0,
    0x0, 0x5, 0x0, 0x19, 0x0, 0x42, 0x3, 0xee,
    0x1, 0x5, 0x0, 0x0, 0x20, 0x6, 0x0, 0x6,
    0x0, 0x1, 0xaa, 0x90, 0x0,
    /* U+0073 "s" */
    0x0, 0xaa, 0xb9, 0x90, 0x14, 0x1, 0x4e, 0x41,
    0x40, 0x14, 0x5a, 0x8, 0x0, 0x10, 0x8, 0x40,
    0x0, 0x0, 0x11, 0x0, 0x0, 0x0, 0x14, 0x2f,
    0x7, 0xd0, 0x60, 0x0, 0x0, 0x1, 0x80, 0x0,
    0x0, 0x5, 0x0, 0x0, 0x0, 0x42, 0x1, 0xfc,
    0x2, 0x2, 0x7, 0xf0, 0x20, 0x2, 0x0, 0x6,
    0x0, 0x1, 0xaa, 0x90, 0x0,
    /* U+0074 "t" */
    0x0, 0x6a, 0xa4, 0x0, 0x8, 0x0, 0x8, 0x0,
    0x80, 0x0, 0x8, 0x8, 0x2d, 0x1e, 0x18, 0x7f,
    0xf8, 0xff, 0xf2, 0xff, 0xe2, 0xff, 0xd4, 0xff,
    0x7, 0xfc, 0x6f, 0xf4, 0xb, 0x85, 0x95, 0x0,
    0x1, 0x55, 0x40, 0x6a, 0x40, 0x82, 0x3, 0xff,
    0x2, 0x2, 0x7, 0xf0, 0x20, 0x2, 0x0, 0x2,
    0x0, 0x2, 0xaa, 0x90, 0x0,
    /* U+0075 "u" */
    0x0, 0x55, 0x6f, 0xf8, 0x4, 0x0, 0x3f, 0xf0,
    0x40, 0x0, 0xff, 0x88, 0x2c, 0x1f, 0xfd, 0x10,
    0x94, 0x98, 0x61, 0x0, 0x0, 0x0, 0x18, 0x10,
    0x0, 0x0, 0xa6, 0xf4, 0x1, 0x82, 0xff, 0xff,
    0xfc, 0x6, 0xff, 0x6a, 0x64, 0x43, 0xf4, 0x1,
    0xf6, 0x2, 0x0, 0xb, 0xfc, 0x2, 0x0, 0x1f,
    0xf0, 0x1, 0xaa, 0xfe, 0x0,
    /* U+0076 "v" */
    0x0, 0x6a, 0xa4, 0x0, 0x4, 0x0, 0x4, 0x1,
    0xfe, 0x3, 0xfc, 0xf, 0xfd, 0x3f, 0xf8, 0x7f,
    0xfc, 0xff, 0xf2, 0xff, 0xe3, 0xff, 0x95, 0xff,
    0xb, 0xfc, 0x50, 0xa0, 0x6, 0x81, 0x46, 0x95,
    0x69, 0x11, 0x5f, 0xfb, 0xf8, 0x82, 0x2f, 0x4f,
    0xc5, 0x2, 0x3f, 0x3c, 0x50, 0x1, 0xb8, 0xf9,
    0x0, 0x0, 0x7e, 0x40, 0x0,
    /* U+0077 "w" */
    0x0, 0x55, 0x94, 0x0, 0x20, 0x0, 0xb8, 0x4,
    0x0, 0x2, 0x12, 0x1e, 0xb, 0x51, 0x43, 0xb0,
    0xec, 0x18, 0x0, 0x0, 0x16, 0x90, 0x55, 0x50,
    0x5a, 0xe4, 0x1, 0xb6, 0x8f, 0xff, 0xff, 0x12,
    0x3e, 0x5b, 0xc4, 0x24, 0x6a, 0x90, 0x40, 0x90,
    0x0, 0x50, 0x1, 0xaa, 0xa0, 0x0,
    /* U+0078 "x" */
    0x0, 0x25, 0xa8, 0x0, 0x2, 0x40, 0x2, 0x40,
    0x4, 0x20, 0x8, 0x40, 0x4, 0x1c, 0x30, 0x20,
    0x20, 0x0, 0x0, 0x4, 0x20, 0x0, 0x0, 0x8,
    0x10, 0xbc, 0x7c, 0x8, 0x50, 0x10, 0x0, 0x8,
    0x65, 0x50, 0x29, 0x5c, 0x40, 0x2b, 0xe4, 0x4,
    0x40, 0x24, 0x18, 0x1, 0x80, 0x10, 0x8, 0x1,
    0x1a, 0xd0, 0xa, 0x94, 0x0, 0x1a, 0xa4, 0x0,
    /* U+0079 "y" */
    0x0, 0x6a, 0xa4, 0x0, 0x14, 0x0, 0x18, 0x1,
    0x40, 0x0, 0x8, 0x8, 0x28, 0x1d, 0x4, 0x42,
    0xf4, 0xec, 0x22, 0x0, 0x0, 0x0, 0x8, 0x40,
    0x0, 0x14, 0x66, 0x15, 0x55, 0x21, 0x8f, 0x80,
    0x1b, 0x51, 0x1f, 0xff, 0xfc, 0x42, 0x1e, 0x57,
    0xc1, 0x1, 0x5, 0xa4, 0x20, 0x1, 0x0, 0x5,
    0x0, 0x1, 0x6a, 0x80, 0x0,
    /* U+007A "z" */
    0x0, 0x6a, 0xa0, 0x0, 0x18, 0x0, 0x14, 0x1,
    0x5d, 0x2, 0x88, 0x8, 0x0, 0x0, 0x14, 0x40,
    0x0, 0x0, 0x22, 0xb, 0xc1, 0xf0, 0x88, 0x0,
    0x0, 0x1, 0x20, 0x7, 0xf0, 0x4, 0x86, 0x6f,
    0xf0, 0x11, 0x55, 0x5f, 0xc0, 0x43, 0x2, 0x7f,
    0x1, 0x4, 0x2, 0xf0, 0x20, 0x20, 0x18, 0x6,
    0x0, 0x2b, 0xea, 0x90, 0x0
};
/*---------------------
 *  GLYPH DESCRIPTION
 *--------------------*/
static const lv_font_fmt_txt_glyph_dsc_t emoji_20_glyph_dsc[] = {
    {.bitmap_index = 0, .adv_w = 0, .box_w = 0, .box_h = 0, .ofs_x = 0, .ofs_y = 0} /* id = 0 reserved */,
    {.bitmap_index = 0, .adv_w = 96, .box_w = 0, .box_h = 0, .ofs_x = 0, .ofs_y = 0},
    {.bitmap_index = 0, .adv_w = 265, .box_w = 15, .box_h = 14, .ofs_x = 1, .ofs_y = 1},
    {.bitmap_index = 53, .adv_w = 268, .box_w = 15, .box_h = 14, .ofs_x = 1, .ofs_y = 1},
    {.bitmap_index = 106, .adv_w = 267, .box_w = 15, .box_h = 14, .ofs_x = 1, .ofs_y = 1},
    {.bitmap_index = 159, .adv_w = 267, .box_w = 15, .box_h = 14, .ofs_x = 1, .ofs_y = 1},
    {.bitmap_index = 212, .adv_w = 265, .box_w = 15, .box_h = 14, .ofs_x = 1, .ofs_y = 1},
    {.bitmap_index = 265, .adv_w = 262, .box_w = 15, .box_h = 14, .ofs_x = 1, .ofs_y = 1},
    {.bitmap_index = 318, .adv_w = 267, .box_w = 15, .box_h = 14, .ofs_x = 1, .ofs_y = 1},
    {.bitmap_index = 371, .adv_w = 265, .box_w = 15, .box_h = 14, .ofs_x = 1, .ofs_y = 1},
    {.bitmap_index = 424, .adv_w = 265, .box_w = 15, .box_h = 14, .ofs_x = 1, .ofs_y = 1},
    {.bitmap_index = 477, .adv_w = 276, .box_w = 16, .box_h = 14, .ofs_x = 1, .ofs_y = 1},
    {.bitmap_index = 533, .adv_w = 268, .box_w = 15, .box_h = 14, .ofs_x = 1, .ofs_y = 1},
    {.bitmap_index = 586, .adv_w = 265, .box_w = 15, .box_h = 14, .ofs_x = 1, .ofs_y = 1},
    {.bitmap_index = 639, .adv_w = 279, .box_w = 16, .box_h = 14, .ofs_x = 1, .ofs_y = 1},
    {.bitmap_index = 695, .adv_w = 266, .box_w = 15, .box_h = 14, .ofs_x = 1, .ofs_y = 1},
    {.bitmap_index = 748, .adv_w = 265, .box_w = 15, .box_h = 14, .ofs_x = 1, .ofs_y = 1},
    {.bitmap_index = 801, .adv_w = 265, .box_w = 15, .box_h = 14, .ofs_x = 1, .ofs_y = 1},
    {.bitmap_index = 854, .adv_w = 266, .box_w = 15, .box_h = 14, .ofs_x = 1, .ofs_y = 1},
    {.bitmap_index = 907, .adv_w = 274, .box_w = 15, .box_h = 14, .ofs_x = 1, .ofs_y = 1},
    {.bitmap_index = 960, .adv_w = 272, .box_w = 15, .box_h = 14, .ofs_x = 1, .ofs_y = 1},
    {.bitmap_index = 1013, .adv_w = 268, .box_w = 15, .box_h = 15, .ofs_x = 1, .ofs_y = 1},
    {.bitmap_index = 1070, .adv_w = 274, .box_w = 15, .box_h = 14, .ofs_x = 1, .ofs_y = 1},
    {.bitmap_index = 1123, .adv_w = 266, .box_w = 15, .box_h = 14, .ofs_x = 1, .ofs_y = 1},
    {.bitmap_index = 1176, .adv_w = 266, .box_w = 15, .box_h = 14, .ofs_x = 1, .ofs_y = 1},
    {.bitmap_index = 1229, .adv_w = 265, .box_w = 15, .box_h = 14, .ofs_x = 1, .ofs_y = 1},
    {.bitmap_index = 1282, .adv_w = 265, .box_w = 15, .box_h = 14, .ofs_x = 1, .ofs_y = 1},
    {.bitmap_index = 1335, .adv_w = 265, .box_w = 15, .box_h = 15, .ofs_x = 1, .ofs_y = 1},
    {.bitmap_index = 1392, .adv_w = 269, .box_w = 15, .box_h = 14, .ofs_x = 1, .ofs_y = 1},
    {.bitmap_index = 1445, .adv_w = 278, .box_w = 16, .box_h = 14, .ofs_x = 1, .ofs_y = 1},
    {.bitmap_index = 1501, .adv_w = 267, .box_w = 15, .box_h = 14, .ofs_x = 1, .ofs_y = 1},
    {.bitmap_index = 1554, .adv_w = 267, .box_w = 15, .box_h = 14, .ofs_x = 1, .ofs_y = 1},
    {.bitmap_index = 1607, .adv_w = 266, .box_w = 15, .box_h = 14, .ofs_x = 1, .ofs_y = 1},
    {.bitmap_index = 1660, .adv_w = 267, .box_w = 15, .box_h = 14, .ofs_x = 1, .ofs_y = 1},
    {.bitmap_index = 1713, .adv_w = 267, .box_w = 15, .box_h = 14, .ofs_x = 1, .ofs_y = 1},
    {.bitmap_index = 1766, .adv_w = 265, .box_w = 15, .box_h = 14, .ofs_x = 1, .ofs_y = 1},
    {.bitmap_index = 1819, .adv_w = 285, .box_w = 16, .box_h = 15, .ofs_x = 1, .ofs_y = 1},
    {.bitmap_index = 1879, .adv_w = 268, .box_w = 15, .box_h = 14, .ofs_x = 1, .ofs_y = 1},
    {.bitmap_index = 1932, .adv_w = 269, .box_w = 15, .box_h = 14, .ofs_x = 1, .ofs_y = 1},
    {.bitmap_index = 1985, .adv_w = 265, .box_w = 15, .box_h = 15, .ofs_x = 1, .ofs_y = 0},
    {.bitmap_index = 2042, .adv_w = 275, .box_w = 16, .box_h = 14, .ofs_x = 1, .ofs_y = 1},
    {.bitmap_index = 2098, .adv_w = 267, .box_w = 15, .box_h = 14, .ofs_x = 1, .ofs_y = 1},
    {.bitmap_index = 2151, .adv_w = 265, .box_w = 15, .box_h = 14, .ofs_x = 1, .ofs_y = 1},
    {.bitmap_index = 2204, .adv_w = 270, .box_w = 15, .box_h = 14, .ofs_x = 1, .ofs_y = 1},
    {.bitmap_index = 2257, .adv_w = 265, .box_w = 15, .box_h = 14, .ofs_x = 1, .ofs_y = 1},
    {.bitmap_index = 2310, .adv_w = 265, .box_w = 15, .box_h = 14, .ofs_x = 1, .ofs_y = 1},
    {.bitmap_index = 2363, .adv_w = 265, .box_w = 15, .box_h = 14, .ofs_x = 1, .ofs_y = 1},
    {.bitmap_index = 2416, .adv_w = 273, .box_w = 15, .box_h = 14, .ofs_x = 1, .ofs_y = 1},
    {.bitmap_index = 2469, .adv_w = 268, .box_w = 15, .box_h = 14, .ofs_x = 1, .ofs_y = 1},
    {.bitmap_index = 2522, .adv_w = 268, .box_w = 15, .box_h = 14, .ofs_x = 1, .ofs_y = 1},
    {.bitmap_index = 2575, .adv_w = 267, .box_w = 15, .box_h = 14, .ofs_x = 1, .ofs_y = 1},
    {.bitmap_index = 2628, .adv_w = 274, .box_w = 15, .box_h = 14, .ofs_x = 1, .ofs_y = 1},
    {.bitmap_index = 2681, .adv_w = 266, .box_w = 15, .box_h = 14, .ofs_x = 1, .ofs_y = 1},
    {.bitmap_index = 2734, .adv_w = 266, .box_w = 15, .box_h = 14, .ofs_x = 1, .ofs_y = 1},
    {.bitmap_index = 2787, .adv_w = 267, .box_w = 15, .box_h = 14, .ofs_x = 1, .ofs_y = 1},
    {.bitmap_index = 2840, .adv_w = 265, .box_w = 15, .box_h = 14, .ofs_x = 1, .ofs_y = 1},
    {.bitmap_index = 2893, .adv_w = 267, .box_w = 15, .box_h = 14, .ofs_x = 1, .ofs_y = 1},
    {.bitmap_index = 2946, .adv_w = 268, .box_w = 15, .box_h = 14, .ofs_x = 1, .ofs_y = 1},
    {.bitmap_index = 2999, .adv_w = 275, .box_w = 15, .box_h = 14, .ofs_x = 1, .ofs_y = 1},
    {.bitmap_index = 3052, .adv_w = 266, .box_w = 15, .box_h = 14, .ofs_x = 1, .ofs_y = 1},
    {.bitmap_index = 3105, .adv_w = 257, .box_w = 14, .box_h = 13, .ofs_x = 1, .ofs_y = 1},
    {.bitmap_index = 3151, .adv_w = 281, .box_w = 16, .box_h = 14, .ofs_x = 1, .ofs_y = 1},
    {.bitmap_index = 3207, .adv_w = 265, .box_w = 15, .box_h = 14, .ofs_x = 1, .ofs_y = 1},
    {.bitmap_index = 3260, .adv_w = 263, .box_w = 15, .box_h = 14, .ofs_x = 1, .ofs_y = 1}
};
/*---------------------
 *  CHARACTER MAPPING
 *--------------------*/
/*Collect the unicode lists and glyph_id offsets*/
static const lv_font_fmt_txt_cmap_t emoji_20_cmaps[] =
{
    {
        .range_start = 32, .range_length = 1, .glyph_id_start = 1,
        .unicode_list = NULL, .glyph_id_ofs_list = NULL, .list_length = 0, .type = LV_FONT_FMT_TXT_CMAP_FORMAT0_TINY
    },
    {
        .range_start = 48, .range_length = 10, .glyph_id_start = 2,
        .unicode_list = NULL, .glyph_id_ofs_list = NULL, .list_length = 0, .type = LV_FONT_FMT_TXT_CMAP_FORMAT0_TINY
    },
    {
        .range_start = 65, .range_length = 26, .glyph_id_start = 12,
        .unicode_list = NULL, .glyph_id_ofs_list = NULL, .list_length = 0, .type = LV_FONT_FMT_TXT_CMAP_FORMAT0_TINY
    },
    {
        .range_start = 97, .range_length = 26, .glyph_id_start = 38,
        .unicode_list = NULL, .glyph_id_ofs_list = NULL, .list_length = 0, .type = LV_FONT_FMT_TXT_CMAP_FORMAT0_TINY
    }
};
/*--------------------
 *  ALL CUSTOM DATA
 *--------------------*/
/*Store all the custom data of the font*/
static lv_font_fmt_txt_glyph_cache_t emoji_20_cache;
static const lv_font_fmt_txt_dsc_t emoji_20_font_dsc = {
    .glyph_bitmap = emoji_20_glyph_bitmap,
    .glyph_dsc = emoji_20_glyph_dsc,
    .cmaps = emoji_20_cmaps,
    .kern_dsc = NULL,
    .kern_scale = 0,
    .cmap_num = 4,
    .bpp = 2,
    .kern_classes = 0,
    .bitmap_format = 0,
    .cache = &emoji_20_cache
};
/*-----------------
 *  PUBLIC FONT
 *----------------*/
/*Initialize a public general font descriptor*/
const lv_font_t emoji_20 = {
    .get_glyph_dsc = lv_font_get_glyph_dsc_fmt_txt,    /*Function pointer to get glyph's data*/
    .get_glyph_bitmap = lv_font_get_bitmap_fmt_txt,    /*Function pointer to get glyph's bitmap*/
    .line_height = 16,          /*The maximum line height required by the font*/
    .base_line = 0,             /*Baseline measured from the bottom of the line*/

    .subpx = LV_FONT_SUBPX_NONE,
    .underline_position = -1,
    .underline_thickness = 1,
    .dsc = &emoji_20_font_dsc,          /*The custom font data. Will be accessed by `get_glyph_bitmap/dsc` */
};
#endif

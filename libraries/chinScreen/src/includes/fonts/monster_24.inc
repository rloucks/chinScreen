/*******************************************************************************
 * Size: 24 px
 * Bpp: 2
 ******************************************************************************/


#ifdef __has_include

    #if __has_include("lvgl.h")
         #ifndef LV_LVGL_H_INCLUDE_SIMPLE
             #define LV_LVGL_H_INCLUDE_SIMPLE
         #endif
     #endif
 #endif

 #ifdef LV_LVGL_H_INCLUDE_SIMPLE
     #include "lvgl.h"
 #else
     #include "../lvgl-8.3.11/lvgl.h"
 #endif

 #ifndef MONSTER_24
 #define MONSTER_24 1
 #endif

 #if MONSTER_24

/*-----------------
 *    BITMAPS
 *----------------*/
/*Store the image of the glyphs*/
static LV_ATTRIBUTE_LARGE_CONST const uint8_t monster_24_glyph_bitmap[] = {
    /* U+0020 " " */
    /* U+0021 "!" */
    0x0, 0x0, 0x3, 0xee, 0x3, 0xfd, 0x7, 0xfc,
    0xb, 0xfc, 0xf, 0xf8, 0xf, 0xf0, 0xf, 0xf0,
    0x1f, 0xe0, 0x2f, 0xe0, 0x2f, 0xd0, 0x3f, 0xc0,
    0x2f, 0xc0, 0x5, 0x0, 0x3f, 0x0, 0x7f, 0x0,
    0x7f, 0x0, 0x6f, 0x0, 0x0, 0x0,
    /* U+0030 "0" */
    0x0, 0x2, 0xfe, 0x0, 0x0, 0xbf, 0xff, 0x0,
    0xf, 0xff, 0xfe, 0x0, 0xff, 0xff, 0xfc, 0xb,
    0xff, 0x7f, 0xf4, 0x3f, 0xf4, 0x3f, 0xe2, 0xff,
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    0x3, 0xff, 0xf8, 0x0, 0x2, 0xfe, 0x0, 0x0,
    /* U+0031 "1" */
    0x0, 0x44, 0x2, 0xfd, 0x7, 0xfc, 0x1f, 0xfc,
    0x7f, 0xfc, 0x7f, 0xfc, 0xf, 0xf8, 0x1f, 0xf4,
    0x1f, 0xf0, 0x2f, 0xf0, 0x2f, 0xe0, 0x3f, 0xd0,
    0x3f, 0xc0, 0x3f, 0xc0, 0x3f, 0xc0, 0x7f, 0x80,
    0x7f, 0x40, 0x5f, 0x0, 0x0, 0x0,
    /* U+0032 "2" */
    0x0, 0x0, 0x0, 0xbf, 0x80, 0xf, 0xff, 0x0,
    0x7f, 0xf8, 0xf, 0xff, 0xc0, 0x5b, 0xfc, 0x0,
    0x3f, 0xd0, 0x3, 0xfc, 0x0, 0x7f, 0xc0, 0xf,
    0xf8, 0x1, 0xff, 0x0, 0x3f, 0xd0, 0xf, 0xf4,
    0x2, 0xfe, 0x0, 0x7f, 0xff, 0xc7, 0xff, 0xf4,
    0x3f, 0xff, 0xcb, 0xff, 0xf4,
    /* U+0033 "3" */
    0x0, 0x50, 0x0, 0x3f, 0xe0, 0x2, 0xff, 0x80,
    0x7f, 0xfc, 0x7, 0xff, 0xd0, 0xb, 0xfc, 0x0,
    0x7f, 0xc0, 0xb, 0xf4, 0x7, 0xfe, 0x0, 0xff,
    0xc0, 0x1f, 0xfd, 0x0, 0x7f, 0xe0, 0x1, 0xff,
    0x0, 0x3f, 0xe0, 0x3f, 0xfc, 0x7, 0xff, 0x80,
    0x7f, 0xe0, 0x7, 0xe0, 0x0,
    /* U+0034 "4" */
    0x0, 0x0, 0x0, 0x0, 0x0, 0xfb, 0xee, 0x0,
    0x2f, 0xbf, 0xd0, 0x7, 0xff, 0xfc, 0x0, 0xff,
    0xff, 0x80, 0x3f, 0xff, 0xf4, 0xb, 0xfe, 0xff,
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    0x0, 0x0, 0x0,
    /* U+0035 "5" */
    0x0, 0x0, 0x0, 0x3, 0xff, 0xfd, 0x7, 0xff,
    0xfc, 0x7, 0xff, 0xf8, 0xb, 0xff, 0xf4, 0xf,
    0xfe, 0xa0, 0xf, 0xf4, 0x0, 0xf, 0xf0, 0x0,
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    0x0,
    /* U+0036 "6" */
    0x0, 0x0, 0x0, 0x0, 0x7b, 0x0, 0x3, 0xff,
    0x0, 0x3f, 0xf8, 0x2, 0xff, 0x80, 0x1f, 0xf8,
    0x0, 0xff, 0xc0, 0x7, 0xfc, 0x0, 0x3f, 0xff,
    0x40, 0xff, 0x7f, 0x87, 0xf9, 0xff, 0x2f, 0xd7,
    0xfd, 0xbf, 0x3, 0xf5, 0xfd, 0xf, 0xc3, 0xfe,
    0xfe, 0xf, 0xff, 0xf0, 0xf, 0xff, 0x40, 0xb,
    0xe0, 0x0,
    /* U+0037 "7" */
    0x0, 0x0, 0x0, 0xff, 0xff, 0xe2, 0xff, 0xff,
    0x1f, 0xff, 0xfd, 0xbf, 0xff, 0xf0, 0x57, 0xff,
    0x80, 0xf, 0xfc, 0x0, 0x7f, 0xd0, 0x2, 0xff,
    0x0, 0xf, 0xf4, 0x0, 0x7f, 0xc0, 0x2, 0xfd,
    0x0, 0xf, 0xf0, 0x0, 0x3f, 0x80, 0x1, 0xfd,
    0x0, 0xb, 0xf0, 0x0, 0x3f, 0x80, 0x1, 0xfd,
    0x0, 0x0, 0x10, 0x0, 0x0,
    /* U+0038 "8" */
    0x0, 0x1f, 0xe0, 0x0, 0x6f, 0xfc, 0x2, 0xfb,
    0xfe, 0x3, 0xff, 0xff, 0xb, 0xf2, 0xff, 0xf,
    0xf2, 0xfe, 0xf, 0xff, 0xfd, 0xb, 0xff, 0xf8,
    0x3, 0xff, 0xe0, 0xb, 0xff, 0xc0, 0x2f, 0xff,
    0xd0, 0x3f, 0xcf, 0xe0, 0x7f, 0x4f, 0xe0, 0xbf,
    0xaf, 0xd0, 0x7f, 0xff, 0xc0, 0x2f, 0xff, 0x0,
    0xb, 0xf8, 0x0,
    /* U+0039 "9" */
    0x0, 0x0, 0x0, 0x0, 0xff, 0xd0, 0x7, 0xff,
    0xf4, 0xf, 0xff, 0xfc, 0x3f, 0xff, 0xfd, 0x3f,
    0xc3, 0xfe, 0x7f, 0x82, 0xff, 0x7f, 0x82, 0xff,
    0x7f, 0xe2, 0xfe, 0x3f, 0xf3, 0xfd, 0x1f, 0xf7,
    0xfc, 0x7, 0xdf, 0xf8, 0x0, 0x1f, 0xf0, 0x0,
    0x3f, 0xd0, 0x0, 0xbf, 0x80, 0x2, 0xff, 0x0,
    0xb, 0xfc, 0x0, 0x1a, 0xe0, 0x0,
    /* U+003F "?" */
    0x2f, 0xf4, 0x1f, 0xff, 0x82, 0xff, 0xf0, 0xff,
    0xfe, 0x2, 0xff, 0x80, 0x3f, 0xe0, 0xf, 0xf4,
    0xb, 0xfc, 0x7, 0xfd, 0x3, 0xfe, 0x1, 0xfe,
    0x0, 0xff, 0x0, 0x11, 0x0, 0xf, 0xa0, 0x7,
    0xf4, 0x2, 0xfd, 0x0, 0x7f, 0x0, 0x0,
    /* U+0041 "A" */
    0x0, 0x0, 0x0, 0x0, 0x0, 0x3, 0xfc, 0x0,
    0x0, 0xff, 0xc0, 0x0, 0x1f, 0xfc, 0x0, 0x3,
    0xff, 0xc0, 0x0, 0xbf, 0xfc, 0x0, 0xf, 0xff,
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    0x0, 0x0, 0x0,
    /* U+0042 "B" */
    0x0, 0x0, 0x0, 0x0, 0xff, 0xf9, 0x0, 0x7f,
    0xff, 0xd0, 0x2f, 0xff, 0xfc, 0xf, 0xff, 0xff,
    0x81, 0xfb, 0x7f, 0xe0, 0x7f, 0x4b, 0xf4, 0x3f,
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    0xdf, 0x90, 0x0, 0x0, 0x0, 0x0,
    /* U+0043 "C" */
    0x0, 0x0, 0x0, 0x0, 0x2, 0xfd, 0x0, 0x2f,
    0xfc, 0x0, 0xff, 0xfc, 0x2, 0xff, 0xf8, 0xb,
    0xff, 0x90, 0xf, 0xfd, 0x0, 0x2f, 0xf4, 0x0,
    0x3f, 0xe0, 0x0, 0x7f, 0xc0, 0x0, 0xbf, 0x80,
    0x0, 0xbf, 0x40, 0x0, 0xbf, 0x80, 0x0, 0x7f,
    0xc0, 0x0, 0x3f, 0xfa, 0x40, 0x2f, 0xff, 0x40,
    0xb, 0xff, 0x0, 0x1, 0xbf, 0x0,
    /* U+0044 "D" */
    0x0, 0x0, 0x0, 0x0, 0xbf, 0xfe, 0x40, 0xf,
    0xff, 0xfe, 0x0, 0xff, 0xff, 0xf4, 0xf, 0xff,
    0xff, 0xc0, 0xaf, 0x5f, 0xfd, 0xf, 0xf0, 0x3f,
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    0x0, 0x0, 0x0,
    /* U+0045 "E" */
    0x0, 0x0, 0x0, 0xf, 0xff, 0xfc, 0xf, 0xff,
    0xfc, 0xf, 0xff, 0xf4, 0x1f, 0xff, 0xf8, 0xb,
    0xf9, 0x50, 0x7, 0xf8, 0x0, 0xf, 0xf4, 0x0,
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    0x0,
    /* U+0046 "F" */
    0x0, 0x0, 0x0, 0xb, 0xff, 0xfe, 0xf, 0xff,
    0xfe, 0x1f, 0xff, 0xfd, 0x1f, 0xff, 0xfc, 0xa,
    0xfd, 0x50, 0xf, 0xf4, 0x0, 0xf, 0xf0, 0x0,
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    0x0,
    /* U+0047 "G" */
    0x0, 0x0, 0x0, 0x0, 0x1, 0xff, 0x0, 0x7,
    0xff, 0x80, 0x7, 0xff, 0xf0, 0x3, 0xff, 0xf4,
    0x3, 0xff, 0xd0, 0x1, 0xff, 0x80, 0x0, 0xff,
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    0xbf, 0x40, 0x0,
    /* U+0048 "H" */
    0x0, 0x0, 0x0, 0x0, 0xf, 0xf0, 0x1f, 0xb0,
    0x7f, 0xc0, 0xff, 0x82, 0xff, 0x3, 0xfc, 0xf,
    0xf8, 0x1f, 0xf0, 0x3f, 0xd0, 0xbf, 0x80, 0xff,
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    0xec, 0xb, 0xf0, 0x0, 0x0, 0x0, 0x0, 0x0,
    /* U+0049 "I" */
    0x0, 0x0, 0x3, 0xad, 0xb, 0xfc, 0xb, 0xfc,
    0xf, 0xf8, 0xf, 0xf8, 0x1f, 0xf4, 0x1f, 0xf0,
    0x2f, 0xf0, 0x3f, 0xf0, 0x3f, 0xe0, 0x3f, 0xd0,
    0x3f, 0xc0, 0x3f, 0xc0, 0x7f, 0x80, 0x7f, 0x80,
    0x7f, 0x40, 0xbf, 0x0, 0x4, 0x0,
    /* U+004A "J" */
    0x0, 0x0, 0x0, 0x0, 0xfe, 0xc0, 0x3, 0xff,
    0x0, 0x1f, 0xf8, 0x0, 0xbf, 0xd0, 0x2, 0xff,
    0x0, 0xf, 0xfc, 0x0, 0x3f, 0xe0, 0x0, 0xff,
    0x40, 0x7, 0xfc, 0x0, 0x1f, 0xf0, 0x0, 0xbf,
    0xc0, 0x2, 0xfe, 0x0, 0xf, 0xf4, 0x1, 0xbf,
    0xd0, 0xf, 0xff, 0x0, 0xbf, 0xf0, 0x1, 0xfe,
    0x0, 0x0,
    /* U+004B "K" */
    0x0, 0x0, 0x0, 0x0, 0x6f, 0xc0, 0xe4, 0xb,
    0xfc, 0x3f, 0xc0, 0xff, 0x8b, 0xfc, 0xf, 0xf5,
    0xff, 0x41, 0xff, 0x7f, 0xe0, 0x1f, 0xff, 0xf8,
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    0x0, 0x0, 0x0,
    /* U+004C "L" */
    0x0, 0x0, 0x0, 0x3d, 0xc0, 0x7, 0xfc, 0x0,
    0xbf, 0xc0, 0xf, 0xf8, 0x0, 0xff, 0x80, 0xf,
    0xf4, 0x1, 0xff, 0x0, 0x2f, 0xf0, 0x2, 0xfe,
    0x0, 0x3f, 0xd0, 0x3, 0xfd, 0x0, 0x3f, 0xc0,
    0x3, 0xfc, 0x0, 0x3f, 0xfe, 0x97, 0xff, 0xfd,
    0x7f, 0xff, 0xca, 0xff, 0xfc, 0x0, 0x0, 0x0,
    /* U+004D "M" */
    0x0, 0xa, 0xe0, 0x3, 0xd0, 0x0, 0xf, 0xf0,
    0xf, 0xf0, 0x0, 0x2f, 0xf0, 0x1f, 0xf4, 0x0,
    0x3f, 0xf4, 0x3f, 0xf4, 0x0, 0xbf, 0xf4, 0x7f,
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    0x0, 0x0,
    /* U+004E "N" */
    0x0, 0x0, 0x0, 0x0, 0x0, 0xba, 0x0, 0x77,
    0x80, 0x3f, 0xd0, 0x1f, 0xf0, 0x1f, 0xfc, 0xb,
    0xf8, 0xb, 0xff, 0x43, 0xfd, 0x3, 0xff, 0xf0,
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    0x0,
    /* U+004F "O" */
    0x0, 0x2, 0xfe, 0x0, 0x0, 0xbf, 0xff, 0x0,
    0xf, 0xff, 0xfe, 0x0, 0xff, 0xff, 0xfc, 0xb,
    0xff, 0x7f, 0xf4, 0x3f, 0xf4, 0x3f, 0xe2, 0xff,
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    0x3, 0xff, 0xf8, 0x0, 0x2, 0xfe, 0x40, 0x0,
    /* U+0050 "P" */
    0x0, 0x0, 0x0, 0x7, 0xff, 0xfd, 0x1, 0xff,
    0xff, 0xd0, 0xbf, 0xff, 0xfc, 0x3f, 0xff, 0xff,
    0x42, 0xfa, 0x7f, 0xe1, 0xff, 0xb, 0xf8, 0xbf,
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    0xc0, 0x0, 0x0, 0x0, 0x0, 0x0,
    /* U+0051 "Q" */
    0x0, 0x2, 0xf8, 0x0, 0x0, 0xab, 0xfc, 0x0,
    0xf, 0xff, 0xfc, 0x0, 0xff, 0xff, 0xf8, 0xf,
    0xff, 0xbf, 0xf0, 0x3f, 0xf0, 0x7f, 0xc2, 0xff,
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    0x0, 0x0, 0x10, 0x0,
    /* U+0052 "R" */
    0x0, 0x0, 0x0, 0x7, 0xff, 0xf8, 0x2, 0xff,
    0xff, 0xd0, 0x7f, 0xff, 0xfc, 0x2f, 0xff, 0xff,
    0x42, 0xf9, 0x3f, 0xd1, 0xff, 0xf, 0xf4, 0xbf,
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    0x80, 0x3f, 0x80, 0x0, 0x5, 0x40,
    /* U+0053 "S" */
    0x0, 0x0, 0x0, 0x0, 0xbf, 0xd0, 0x2f, 0xff,
    0x42, 0xff, 0xf8, 0xf, 0xff, 0xe0, 0xbf, 0xf5,
    0x2, 0xff, 0x40, 0x7, 0xff, 0x0, 0xf, 0xfe,
    0x0, 0x2f, 0xfd, 0x0, 0x2f, 0xfc, 0x0, 0x2f,
    0xf0, 0x0, 0x3f, 0xc0, 0x2, 0xff, 0x2, 0xff,
    0xf8, 0x1f, 0xff, 0xc0, 0xbf, 0xfc, 0x1, 0xff,
    0x40, 0x0, 0x0, 0x0, 0x0,
    /* U+0054 "T" */
    0x0, 0x0, 0x0, 0xff, 0xff, 0xe7, 0xff, 0xff,
    0x8b, 0xff, 0xfe, 0xbf, 0xff, 0xf0, 0x5f, 0xb5,
    0x40, 0x3f, 0xd0, 0x1, 0xff, 0x0, 0xb, 0xfc,
    0x0, 0x2f, 0xe0, 0x0, 0xff, 0x80, 0x3, 0xfd,
    0x0, 0xf, 0xf0, 0x0, 0x3f, 0xc0, 0x0, 0xfe,
    0x0, 0x7, 0xf4, 0x0, 0x1f, 0xd0, 0x0, 0x77,
    0x0, 0x0, 0x0, 0x0, 0x0,
    /* U+0055 "U" */
    0x0, 0x0, 0x0, 0x0, 0x1f, 0xf0, 0x3f, 0xd0,
    0xbf, 0x81, 0xff, 0x3, 0xfe, 0xb, 0xfc, 0xf,
    0xf8, 0x3f, 0xe0, 0x7f, 0xd0, 0xff, 0x42, 0xff,
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    0x7f, 0x9e, 0xd0, 0x0, 0x0, 0x0, 0x0, 0x0,
    /* U+0056 "V" */
    0x0, 0x0, 0x0, 0x2f, 0x70, 0x2f, 0xc7, 0xfd,
    0xf, 0xf1, 0xff, 0x47, 0xfc, 0x7f, 0xd2, 0xfd,
    0xf, 0xf4, 0xff, 0x3, 0xfd, 0x7f, 0x80, 0xff,
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    0xee, 0x0, 0x0, 0x0, 0x0, 0x0,
    /* U+0057 "W" */
    0x0, 0x0, 0x0, 0x0, 0x0, 0x2f, 0xf0, 0x1f,
    0xd0, 0x2b, 0xfb, 0xfc, 0xf, 0xf8, 0xf, 0xf5,
    0xff, 0x7, 0xfe, 0x7, 0xfc, 0x7f, 0xc2, 0xff,
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    0x0, 0x0, 0x0, 0x0,
    /* U+0058 "X" */
    0x0, 0x0, 0x0, 0x0, 0x2b, 0xf0, 0x3f, 0x90,
    0xbf, 0xc2, 0xff, 0x1, 0xff, 0x5f, 0xf0, 0x3,
    0xfe, 0xff, 0x40, 0xb, 0xff, 0xf8, 0x0, 0x1f,
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    0xfc, 0x9, 0xf0, 0x0, 0x0, 0x0, 0x0, 0x0,
    /* U+0059 "Y" */
    0x0, 0x0, 0x0, 0x0, 0x2b, 0xd0, 0x7f, 0xc0,
    0xff, 0x83, 0xfd, 0x2, 0xfe, 0x3f, 0xe0, 0x7,
    0xfd, 0xff, 0x0, 0xf, 0xff, 0xf0, 0x0, 0x2f,
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    0xf8, 0x0, 0x0, 0x0,
    /* U+005A "Z" */
    0x0, 0x0, 0x0, 0xb, 0xff, 0xff, 0xf, 0xff,
    0xff, 0xb, 0xff, 0xfd, 0xf, 0xff, 0xfd, 0x0,
    0x3f, 0xf0, 0x0, 0x7f, 0xf0, 0x0, 0xff, 0xd0,
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    0x0,
    /* U+0061 "a" */
    0x0, 0x0, 0x0, 0x0, 0xf, 0xd0, 0x0, 0xbf,
    0x40, 0x3, 0xfd, 0x0, 0x2f, 0xf4, 0x1, 0xff,
    0xe0, 0xf, 0xff, 0x80, 0x7f, 0xfe, 0x3, 0xf7,
    0xf8, 0x1f, 0xcf, 0xe0, 0xff, 0xbf, 0x47, 0xff,
    0xfd, 0x3f, 0xff, 0xf4, 0xf8, 0xb, 0xdb, 0xc0,
    0x2f, 0x40, 0x0, 0x0,
    /* U+0062 "b" */
    0x0, 0x0, 0x0, 0x2f, 0xf9, 0x0, 0xff, 0xfd,
    0x7, 0xff, 0xfc, 0xf, 0xff, 0xf0, 0x3f, 0x1f,
    0xc2, 0xfc, 0xbd, 0xb, 0xff, 0xe0, 0x3f, 0xff,
    0x80, 0xfd, 0xbf, 0x3, 0xf0, 0xfd, 0x1f, 0xcb,
    0xf0, 0x7f, 0xff, 0xc2, 0xff, 0xfc, 0xa, 0xdf,
    0x80, 0x0, 0x0, 0x0,
    /* U+0063 "c" */
    0x0, 0x0, 0x0, 0x1, 0xfc, 0x0, 0xff, 0xc0,
    0x3f, 0xf8, 0xf, 0xfe, 0x41, 0xff, 0x0, 0x3f,
    0xc0, 0x3, 0xf4, 0x0, 0x7f, 0x0, 0xb, 0xe0,
    0x0, 0xbe, 0x0, 0x7, 0xf8, 0x0, 0x3f, 0xfc,
    0x1, 0xff, 0x80, 0x2, 0xf4, 0x0,
    /* U+0064 "d" */
    0x0, 0x0, 0x0, 0xf, 0xff, 0x40, 0x1f, 0xff,
    0xe0, 0x1f, 0xff, 0xf4, 0x1b, 0xdb, 0xf8, 0x1f,
    0xc3, 0xfc, 0x1f, 0xc2, 0xfc, 0x2f, 0x82, 0xfc,
    0x3f, 0x42, 0xf8, 0x3f, 0x3, 0xf4, 0x3f, 0xb,
    0xf0, 0x7f, 0x2f, 0xd0, 0x7f, 0xff, 0x80, 0x7f,
    0xff, 0x0, 0xbe, 0xf4, 0x0, 0x0, 0x0, 0x0,
    /* U+0065 "e" */
    0x0, 0x0, 0x0, 0xbf, 0xfc, 0x1f, 0xff, 0xc1,
    0xff, 0xf4, 0x1f, 0xea, 0x40, 0xfd, 0x0, 0x1f,
    0xc0, 0x2, 0xff, 0xd0, 0x3f, 0xfc, 0x3, 0xfe,
    0x40, 0x3f, 0x0, 0x3, 0xf0, 0x0, 0x7f, 0xfc,
    0xb, 0xff, 0xc0, 0xbf, 0xf8, 0x0, 0x0, 0x0,
    /* U+0066 "f" */
    0xf, 0xff, 0xd1, 0xff, 0xfd, 0x2f, 0xff, 0xc1,
    0xbe, 0x54, 0x1f, 0xc0, 0x2, 0xfc, 0x0, 0x3f,
    0xfd, 0x3, 0xff, 0xc0, 0x3f, 0x54, 0x7, 0xf0,
    0x0, 0x7e, 0x0, 0xb, 0xd0, 0x0, 0xbc, 0x0,
    0x6, 0x80, 0x0,
    /* U+0067 "g" */
    0x0, 0x0, 0x0, 0x0, 0xbe, 0x0, 0x1f, 0xf8,
    0x1, 0xff, 0xe0, 0xf, 0xfe, 0x0, 0xbf, 0x40,
    0x3, 0xf8, 0x0, 0x1f, 0xc3, 0xfc, 0xbe, 0x2f,
    0xf2, 0xf4, 0x7f, 0x4b, 0xd0, 0xbc, 0x1f, 0x87,
    0xf0, 0x3f, 0xff, 0x0, 0xbf, 0xf4, 0x0, 0x7e,
    0x0, 0x0,
    /* U+0068 "h" */
    0x0, 0x0, 0x0, 0xe, 0xe0, 0xbb, 0xf, 0xe0,
    0xfe, 0xf, 0xd0, 0xfd, 0x1f, 0xc1, 0xfc, 0x2f,
    0xc2, 0xfc, 0x2f, 0x83, 0xf4, 0x3f, 0xff, 0xf0,
    0x3f, 0xff, 0xf0, 0x3f, 0x2f, 0xe0, 0x3f, 0xb,
    0xe0, 0x7e, 0xb, 0xd0, 0x7d, 0xf, 0xc0, 0xbd,
    0xf, 0xc0, 0xbc, 0xf, 0xc0, 0x0, 0x0, 0x0,
    /* U+0069 "i" */
    0x0, 0x0, 0xfb, 0xf, 0xe1, 0xfd, 0x1f, 0xd2,
    0xfc, 0x3f, 0xc3, 0xf8, 0x3f, 0x43, 0xf4, 0x7f,
    0x7, 0xf0, 0x7e, 0xb, 0xe0, 0x6d, 0x0,
    /* U+006A "j" */
    0x0, 0x0, 0x0, 0x3f, 0xc0, 0xf, 0xf0, 0x7,
    0xf8, 0x2, 0xfd, 0x0, 0xbf, 0x0, 0x3f, 0xc0,
    0xf, 0xe0, 0x3, 0xf4, 0x0, 0xfd, 0x0, 0x7f,
    0x0, 0x2f, 0xc0, 0x7f, 0xf0, 0x1f, 0xf0, 0xb,
    0xe0, 0x0,
    /* U+006B "k" */
    0x0, 0x0, 0x0, 0x3f, 0x83, 0x80, 0xfe, 0x3f,
    0x87, 0xf6, 0xfc, 0x2f, 0xdf, 0xd0, 0xbf, 0xfe,
    0x3, 0xff, 0xf0, 0xf, 0xff, 0x40, 0x3f, 0xfe,
    0x0, 0xfd, 0xfc, 0x7, 0xf3, 0xf8, 0x1f, 0x8b,
    0xf0, 0x7d, 0x1f, 0xd2, 0xf4, 0x3f, 0x8b, 0xc0,
    0xb4, 0x0, 0x0, 0x0,
    /* U+006C "l" */
    0x0, 0x0, 0xf, 0xa0, 0xf, 0xe0, 0xf, 0xd0,
    0x1f, 0xd0, 0x2f, 0xc0, 0x2f, 0xc0, 0x3f, 0x80,
    0x3f, 0x40, 0x3f, 0x40, 0x3f, 0x0, 0x3f, 0x0,
    0x7f, 0xfe, 0xbf, 0xfd, 0xbf, 0xfd, 0x0, 0x0,
    /* U+006D "m" */
    0x0, 0x15, 0x0, 0x50, 0x0, 0x3f, 0x1, 0xf8,
    0x0, 0xbf, 0x3, 0xfc, 0x0, 0xff, 0x4b, 0xfc,
    0x1, 0xff, 0x8f, 0xfc, 0x3, 0xff, 0x9f, 0xfc,
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    0x0, 0x0, 0x0, 0x0,
    /* U+006E "n" */
    0x7, 0x90, 0x2b, 0x82, 0xfc, 0xf, 0xe0, 0xff,
    0x83, 0xf4, 0x3f, 0xf0, 0xfc, 0x1f, 0xfd, 0x3f,
    0xb, 0xff, 0xdf, 0x82, 0xff, 0xff, 0xe0, 0xff,
    0xff, 0xf4, 0x3f, 0x2f, 0xfc, 0xf, 0xc3, 0xff,
    0x7, 0xf0, 0xbf, 0xc1, 0xf8, 0xf, 0xe0, 0xbd,
    0x2, 0xf8, 0x2e, 0x40, 0x3d, 0x0, 0x0, 0x0,
    0x0,
    /* U+006F "o" */
    0x0, 0xf, 0xd0, 0x1, 0xff, 0xf4, 0x7, 0xff,
    0xfc, 0xf, 0xff, 0xfd, 0x1f, 0xf0, 0xfe, 0x3f,
    0x80, 0xfe, 0x3f, 0x0, 0xfe, 0x7e, 0x1, 0xfd,
    0xbd, 0x2, 0xfc, 0xbe, 0x3, 0xf4, 0x7f, 0x5f,
    0xf0, 0x3f, 0xff, 0xc0, 0x2f, 0xff, 0x0, 0x7,
    0xf8, 0x0,
    /* U+0070 "p" */
    0x0, 0x0, 0x0, 0xbf, 0xfd, 0x3, 0xff, 0xfd,
    0xf, 0xff, 0xfc, 0x1f, 0xdb, 0xf0, 0xbf, 0xf,
    0xc3, 0xf8, 0xbf, 0xf, 0xeb, 0xf4, 0x3f, 0xff,
    0x80, 0xfe, 0xf4, 0x7, 0xf1, 0x0, 0x1f, 0x80,
    0x0, 0xbd, 0x0, 0x2, 0xf0, 0x0, 0xa, 0xc0,
    0x0, 0x0,
    /* U+0071 "q" */
    0x0, 0x1f, 0x80, 0x0, 0xef, 0xf0, 0x7, 0xff,
    0xf8, 0xf, 0xfb, 0xfc, 0x1f, 0xe1, 0xfc, 0x3f,
    0xc0, 0xfc, 0x3f, 0x0, 0xfc, 0x7e, 0x0, 0xfc,
    0xbd, 0x7, 0xf8, 0xbd, 0x1f, 0xf0, 0x7f, 0xf,
    0xe0, 0x3f, 0xff, 0xf0, 0x1f, 0xff, 0xf8, 0x7,
    0xf5, 0xfc, 0x0, 0x0, 0x0,
    /* U+0072 "r" */
    0x0, 0x0, 0x3, 0xff, 0xe0, 0x3f, 0xff, 0xc3,
    0xff, 0xfe, 0x1f, 0xff, 0xe2, 0xfc, 0xbe, 0x3f,
    0x8b, 0xd3, 0xfa, 0xf8, 0x3f, 0xff, 0x3, 0xff,
    0xe0, 0x3e, 0xbf, 0x7, 0xd3, 0xf4, 0x7d, 0x2f,
    0x8b, 0xc0, 0xfc, 0x64, 0xb, 0xc0, 0x0, 0x0,
    /* U+0073 "s" */
    0x0, 0x0, 0x0, 0x6f, 0xc0, 0xbf, 0xf0, 0x7f,
    0xf8, 0x3f, 0xf9, 0xf, 0xf0, 0x3, 0xfe, 0x0,
    0x7f, 0xd0, 0xb, 0xfc, 0x0, 0xbf, 0x0, 0xf,
    0xc0, 0x4b, 0xf0, 0x3f, 0xf8, 0x2f, 0xfc, 0xb,
    0xf4, 0x0, 0x0, 0x0,
    /* U+0074 "t" */
    0x7f, 0xff, 0x9f, 0xff, 0xe7, 0xff, 0xf4, 0x7f,
    0xe8, 0xb, 0xf0, 0x3, 0xfc, 0x0, 0xfe, 0x0,
    0x3f, 0x40, 0x1f, 0xc0, 0x7, 0xf0, 0x1, 0xf8,
    0x0, 0xbe, 0x0, 0x2f, 0x40, 0xb, 0xc0, 0x0,
    0x0, 0x0,
    /* U+0075 "u" */
    0x0, 0x0, 0x0, 0xf, 0xe0, 0xfe, 0xf, 0xd1,
    0xfd, 0x1f, 0xd2, 0xfc, 0x2f, 0xc3, 0xfc, 0x3f,
    0xc3, 0xf8, 0x3f, 0x83, 0xf4, 0x3f, 0x47, 0xf0,
    0x7f, 0xb, 0xf0, 0x7f, 0xf, 0xe0, 0xbe, 0xf,
    0xd0, 0xbf, 0x3f, 0xc0, 0xbf, 0xff, 0xc0, 0x7f,
    0xff, 0x80, 0x2f, 0xab, 0x40, 0x0, 0x0, 0x0,
    /* U+0076 "v" */
    0x0, 0x0, 0xb, 0xb0, 0x7e, 0xbf, 0xb, 0xe7,
    0xf4, 0xfd, 0x7f, 0x5f, 0xc3, 0xf6, 0xf8, 0x3f,
    0x7f, 0x3, 0xfb, 0xf0, 0x3f, 0xfd, 0x2, 0xff,
    0xc0, 0x1f, 0xfc, 0x0, 0xff, 0x40, 0xf, 0xf0,
    0x0, 0xfe, 0x0, 0xb, 0xd0, 0x0, 0x0, 0x0,
    /* U+0077 "w" */
    0x0, 0x0, 0x0, 0x0, 0x2f, 0xc0, 0xfc, 0xe,
    0xeb, 0xf0, 0xbf, 0x7, 0xf6, 0xfc, 0x3f, 0xd2,
    0xfc, 0x7f, 0x1f, 0xf4, 0xfd, 0x1f, 0xcb, 0xfd,
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    0x0, 0x0, 0x0, 0x0,
    /* U+0078 "x" */
    0xb, 0xd0, 0xbe, 0xf, 0xf1, 0xfc, 0xb, 0xf3,
    0xf4, 0x7, 0xff, 0xd0, 0x3, 0xff, 0x80, 0x3,
    0xff, 0x0, 0x2, 0xfd, 0x0, 0x1, 0xfc, 0x0,
    0x3, 0xfd, 0x0, 0x7, 0xfe, 0x0, 0xf, 0xff,
    0x0, 0x2f, 0x7f, 0x0, 0x3f, 0x2f, 0x80, 0xbc,
    0xb, 0xc0, 0x0, 0x0, 0x0,
    /* U+0079 "y" */
    0x0, 0x0, 0x0, 0x1b, 0xc1, 0xfc, 0xf, 0xd3,
    0xf8, 0xf, 0xeb, 0xf0, 0xb, 0xff, 0xc0, 0x7,
    0xff, 0x40, 0x3, 0xff, 0x0, 0x2, 0xfc, 0x0,
    0x2, 0xf8, 0x0, 0x3, 0xf0, 0x0, 0xb, 0xd0,
    0x0, 0xf, 0xc0, 0x0, 0x2f, 0x0, 0x0, 0x3e,
    0x0, 0x0, 0xbc, 0x0, 0x0,
    /* U+007A "z" */
    0x0, 0x0, 0x0, 0xff, 0xfe, 0xf, 0xff, 0xd1,
    0xff, 0xfc, 0x5, 0xff, 0x40, 0x1f, 0xf0, 0x3,
    0xfd, 0x0, 0x7f, 0xc0, 0xb, 0xf0, 0x0, 0xfe,
    0x0, 0x1f, 0xc0, 0x3, 0xf4, 0x0, 0x7f, 0xfe,
    0xb, 0xff, 0xf0, 0xbf, 0xfe, 0x0, 0x0, 0x0
};
/*---------------------
 *  GLYPH DESCRIPTION
 *--------------------*/
static const lv_font_fmt_txt_glyph_dsc_t monster_24_glyph_dsc[] = {
    {.bitmap_index = 0, .adv_w = 0, .box_w = 0, .box_h = 0, .ofs_x = 0, .ofs_y = 0} /* id = 0 reserved */,
    {.bitmap_index = 0, .adv_w = 153, .box_w = 0, .box_h = 0, .ofs_x = 0, .ofs_y = 0},
    {.bitmap_index = 0, .adv_w = 129, .box_w = 8, .box_h = 19, .ofs_x = 0, .ofs_y = -1},
    {.bitmap_index = 38, .adv_w = 241, .box_w = 15, .box_h = 17, .ofs_x = 0, .ofs_y = 0},
    {.bitmap_index = 102, .adv_w = 128, .box_w = 8, .box_h = 19, .ofs_x = 0, .ofs_y = -1},
    {.bitmap_index = 140, .adv_w = 155, .box_w = 10, .box_h = 18, .ofs_x = 0, .ofs_y = 0},
    {.bitmap_index = 185, .adv_w = 155, .box_w = 10, .box_h = 18, .ofs_x = 0, .ofs_y = 0},
    {.bitmap_index = 230, .adv_w = 225, .box_w = 14, .box_h = 19, .ofs_x = 0, .ofs_y = -1},
    {.bitmap_index = 297, .adv_w = 189, .box_w = 12, .box_h = 19, .ofs_x = 0, .ofs_y = -1},
    {.bitmap_index = 354, .adv_w = 172, .box_w = 11, .box_h = 18, .ofs_x = 0, .ofs_y = 0},
    {.bitmap_index = 404, .adv_w = 175, .box_w = 11, .box_h = 19, .ofs_x = 0, .ofs_y = -1},
    {.bitmap_index = 457, .adv_w = 197, .box_w = 12, .box_h = 17, .ofs_x = 0, .ofs_y = 0},
    {.bitmap_index = 508, .adv_w = 196, .box_w = 12, .box_h = 18, .ofs_x = 0, .ofs_y = 0},
    {.bitmap_index = 562, .adv_w = 146, .box_w = 9, .box_h = 17, .ofs_x = 0, .ofs_y = 0},
    {.bitmap_index = 601, .adv_w = 216, .box_w = 14, .box_h = 19, .ofs_x = 0, .ofs_y = -1},
    {.bitmap_index = 668, .adv_w = 207, .box_w = 13, .box_h = 19, .ofs_x = 0, .ofs_y = -1},
    {.bitmap_index = 730, .adv_w = 187, .box_w = 12, .box_h = 18, .ofs_x = 0, .ofs_y = 0},
    {.bitmap_index = 784, .adv_w = 224, .box_w = 14, .box_h = 19, .ofs_x = 0, .ofs_y = -1},
    {.bitmap_index = 851, .adv_w = 186, .box_w = 12, .box_h = 19, .ofs_x = 0, .ofs_y = -1},
    {.bitmap_index = 908, .adv_w = 195, .box_w = 12, .box_h = 19, .ofs_x = 0, .ofs_y = -1},
    {.bitmap_index = 965, .adv_w = 207, .box_w = 13, .box_h = 18, .ofs_x = 0, .ofs_y = 0},
    {.bitmap_index = 1024, .adv_w = 244, .box_w = 15, .box_h = 19, .ofs_x = 0, .ofs_y = -1},
    {.bitmap_index = 1096, .adv_w = 124, .box_w = 8, .box_h = 19, .ofs_x = 0, .ofs_y = -1},
    {.bitmap_index = 1134, .adv_w = 166, .box_w = 11, .box_h = 18, .ofs_x = 0, .ofs_y = 0},
    {.bitmap_index = 1184, .adv_w = 223, .box_w = 14, .box_h = 19, .ofs_x = 0, .ofs_y = -1},
    {.bitmap_index = 1251, .adv_w = 158, .box_w = 10, .box_h = 19, .ofs_x = 0, .ofs_y = -1},
    {.bitmap_index = 1299, .adv_w = 316, .box_w = 20, .box_h = 18, .ofs_x = 0, .ofs_y = -1},
    {.bitmap_index = 1389, .adv_w = 263, .box_w = 17, .box_h = 19, .ofs_x = 0, .ofs_y = -1},
    {.bitmap_index = 1470, .adv_w = 242, .box_w = 15, .box_h = 17, .ofs_x = 0, .ofs_y = 0},
    {.bitmap_index = 1534, .adv_w = 209, .box_w = 13, .box_h = 19, .ofs_x = 0, .ofs_y = -1},
    {.bitmap_index = 1596, .adv_w = 233, .box_w = 15, .box_h = 18, .ofs_x = 0, .ofs_y = -1},
    {.bitmap_index = 1664, .adv_w = 205, .box_w = 13, .box_h = 19, .ofs_x = 0, .ofs_y = -1},
    {.bitmap_index = 1726, .adv_w = 173, .box_w = 11, .box_h = 19, .ofs_x = 0, .ofs_y = -1},
    {.bitmap_index = 1779, .adv_w = 179, .box_w = 11, .box_h = 19, .ofs_x = 0, .ofs_y = -1},
    {.bitmap_index = 1832, .adv_w = 239, .box_w = 15, .box_h = 19, .ofs_x = 0, .ofs_y = -1},
    {.bitmap_index = 1904, .adv_w = 199, .box_w = 13, .box_h = 19, .ofs_x = 0, .ofs_y = -1},
    {.bitmap_index = 1966, .adv_w = 340, .box_w = 21, .box_h = 19, .ofs_x = 0, .ofs_y = -1},
    {.bitmap_index = 2066, .adv_w = 240, .box_w = 15, .box_h = 19, .ofs_x = 0, .ofs_y = -1},
    {.bitmap_index = 2138, .adv_w = 232, .box_w = 15, .box_h = 18, .ofs_x = 0, .ofs_y = 0},
    {.bitmap_index = 2206, .adv_w = 195, .box_w = 12, .box_h = 19, .ofs_x = 0, .ofs_y = -1},
    {.bitmap_index = 2263, .adv_w = 175, .box_w = 11, .box_h = 16, .ofs_x = 0, .ofs_y = -1},
    {.bitmap_index = 2307, .adv_w = 168, .box_w = 11, .box_h = 16, .ofs_x = 0, .ofs_y = -1},
    {.bitmap_index = 2351, .adv_w = 152, .box_w = 10, .box_h = 15, .ofs_x = 0, .ofs_y = 0},
    {.bitmap_index = 2389, .adv_w = 182, .box_w = 12, .box_h = 16, .ofs_x = 0, .ofs_y = -1},
    {.bitmap_index = 2437, .adv_w = 152, .box_w = 10, .box_h = 16, .ofs_x = 0, .ofs_y = -1},
    {.bitmap_index = 2477, .adv_w = 157, .box_w = 10, .box_h = 14, .ofs_x = 0, .ofs_y = 0},
    {.bitmap_index = 2512, .adv_w = 169, .box_w = 11, .box_h = 15, .ofs_x = 0, .ofs_y = 0},
    {.bitmap_index = 2554, .adv_w = 196, .box_w = 12, .box_h = 16, .ofs_x = 0, .ofs_y = -1},
    {.bitmap_index = 2602, .adv_w = 100, .box_w = 6, .box_h = 15, .ofs_x = 0, .ofs_y = 0},
    {.bitmap_index = 2625, .adv_w = 134, .box_w = 9, .box_h = 15, .ofs_x = 0, .ofs_y = 0},
    {.bitmap_index = 2659, .adv_w = 179, .box_w = 11, .box_h = 16, .ofs_x = 0, .ofs_y = -1},
    {.bitmap_index = 2703, .adv_w = 127, .box_w = 8, .box_h = 16, .ofs_x = 0, .ofs_y = -1},
    {.bitmap_index = 2735, .adv_w = 255, .box_w = 16, .box_h = 15, .ofs_x = 0, .ofs_y = -1},
    {.bitmap_index = 2795, .adv_w = 213, .box_w = 13, .box_h = 15, .ofs_x = 0, .ofs_y = -1},
    {.bitmap_index = 2844, .adv_w = 194, .box_w = 12, .box_h = 14, .ofs_x = 0, .ofs_y = 0},
    {.bitmap_index = 2886, .adv_w = 169, .box_w = 11, .box_h = 15, .ofs_x = 0, .ofs_y = 0},
    {.bitmap_index = 2928, .adv_w = 187, .box_w = 12, .box_h = 15, .ofs_x = 0, .ofs_y = -1},
    {.bitmap_index = 2973, .adv_w = 162, .box_w = 10, .box_h = 16, .ofs_x = 0, .ofs_y = -1},
    {.bitmap_index = 3013, .adv_w = 139, .box_w = 9, .box_h = 16, .ofs_x = 0, .ofs_y = -1},
    {.bitmap_index = 3049, .adv_w = 144, .box_w = 9, .box_h = 15, .ofs_x = 0, .ofs_y = -1},
    {.bitmap_index = 3083, .adv_w = 193, .box_w = 12, .box_h = 16, .ofs_x = 0, .ofs_y = -1},
    {.bitmap_index = 3131, .adv_w = 161, .box_w = 10, .box_h = 16, .ofs_x = 0, .ofs_y = -1},
    {.bitmap_index = 3171, .adv_w = 274, .box_w = 17, .box_h = 16, .ofs_x = 0, .ofs_y = -1},
    {.bitmap_index = 3239, .adv_w = 194, .box_w = 12, .box_h = 15, .ofs_x = 0, .ofs_y = -1},
    {.bitmap_index = 3284, .adv_w = 188, .box_w = 12, .box_h = 15, .ofs_x = 0, .ofs_y = 0},
    {.bitmap_index = 3329, .adv_w = 159, .box_w = 10, .box_h = 16, .ofs_x = 0, .ofs_y = -1}
};
/*---------------------
 *  CHARACTER MAPPING
 *--------------------*/
static const uint16_t monster_24_unicode_list_0[] = {
    0x0, 0x1, 0x10, 0x11, 0x12, 0x13, 0x14, 0x15,
    0x16, 0x17, 0x18, 0x19, 0x1f
};
/*Collect the unicode lists and glyph_id offsets*/
static const lv_font_fmt_txt_cmap_t monster_24_cmaps[] =
{
    {
        .range_start = 32, .range_length = 32, .glyph_id_start = 1,
        .unicode_list = monster_24_unicode_list_0, .glyph_id_ofs_list = NULL, .list_length = 13, .type = LV_FONT_FMT_TXT_CMAP_SPARSE_TINY
    },
    {
        .range_start = 65, .range_length = 26, .glyph_id_start = 14,
        .unicode_list = NULL, .glyph_id_ofs_list = NULL, .list_length = 0, .type = LV_FONT_FMT_TXT_CMAP_FORMAT0_TINY
    },
    {
        .range_start = 97, .range_length = 26, .glyph_id_start = 40,
        .unicode_list = NULL, .glyph_id_ofs_list = NULL, .list_length = 0, .type = LV_FONT_FMT_TXT_CMAP_FORMAT0_TINY
    }
};
/*--------------------
 *  ALL CUSTOM DATA
 *--------------------*/
/*Store all the custom data of the font*/
static lv_font_fmt_txt_glyph_cache_t monster_24_cache;
static const lv_font_fmt_txt_dsc_t monster_24_font_dsc = {
    .glyph_bitmap = monster_24_glyph_bitmap,
    .glyph_dsc = monster_24_glyph_dsc,
    .cmaps = monster_24_cmaps,
    .kern_dsc = NULL,
    .kern_scale = 0,
    .cmap_num = 3,
    .bpp = 2,
    .kern_classes = 0,
    .bitmap_format = 0,
    .cache = &monster_24_cache
};
/*-----------------
 *  PUBLIC FONT
 *----------------*/
/*Initialize a public general font descriptor*/
const lv_font_t monster_24 = {
    .get_glyph_dsc = lv_font_get_glyph_dsc_fmt_txt,    /*Function pointer to get glyph's data*/
    .get_glyph_bitmap = lv_font_get_bitmap_fmt_txt,    /*Function pointer to get glyph's bitmap*/
    .line_height = 19,          /*The maximum line height required by the font*/
    .base_line = 1,             /*Baseline measured from the bottom of the line*/

    .subpx = LV_FONT_SUBPX_NONE,
    .underline_position = -1,
    .underline_thickness = 1,
    .dsc = &monster_24_font_dsc,          /*The custom font data. Will be accessed by `get_glyph_bitmap/dsc` */
};
#endif

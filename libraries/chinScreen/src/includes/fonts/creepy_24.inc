/*******************************************************************************
 * Size: 24 px
 * Bpp: 2
 ******************************************************************************/


#ifdef __has_include

    #if __has_include("lvgl.h")
         #ifndef LV_LVGL_H_INCLUDE_SIMPLE
             #define LV_LVGL_H_INCLUDE_SIMPLE
         #endif
     #endif
 #endif

 #ifdef LV_LVGL_H_INCLUDE_SIMPLE
     #include "lvgl.h"
 #else
     #include "../lvgl-8.3.11/lvgl.h"
 #endif

 #ifndef CREEPY_24
 #define CREEPY_24 1
 #endif

 #if CREEPY_24

/*-----------------
 *    BITMAPS
 *----------------*/
/*Store the image of the glyphs*/
static LV_ATTRIBUTE_LARGE_CONST const uint8_t creepy_24_glyph_bitmap[] = {
    /* U+0020 " " */
    /* U+0021 "!" */
    0x1b, 0xcb, 0xfc, 0xbf, 0xc7, 0xfe, 0x3f, 0xe2,
    0xfd, 0x3f, 0xc7, 0xfc, 0x6f, 0xc1, 0xf4, 0x9,
    0x40, 0x4, 0x2e, 0xc3, 0xfc, 0x3f, 0xe3, 0xe1,
    0x20, 0x1, 0x1, 0x10, 0x2, 0x0,
    /* U+0022 "\"" */
    0x2c, 0x1c, 0xf, 0xcf, 0x87, 0xf7, 0xf2, 0xfe,
    0xfc, 0xbf, 0xbf, 0xb, 0x47, 0x41, 0x40, 0x50,
    0x50, 0x4, 0x14, 0x1, 0x0, 0x0, 0x51, 0x0,
    0x0, 0x0, 0x0,
    /* U+0023 "#" */
    0x0, 0x1, 0xe0, 0x2c, 0x0, 0x0, 0xfe, 0xb,
    0xd0, 0x0, 0xf, 0xc0, 0xbc, 0x0, 0x1, 0xfe,
    0x9f, 0xc0, 0x3, 0xff, 0xff, 0xff, 0xc0, 0xbf,
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    0x1, 0x0, 0x0, 0x0, 0x0, 0x0, 0x0, 0x0,
    /* U+0024 "$" */
    0x0, 0x2, 0x0, 0x0, 0x0, 0xbd, 0x0, 0x0,
    0xf, 0xff, 0xb4, 0x2, 0xff, 0xff, 0xf0, 0x3f,
    0xff, 0xff, 0xe1, 0xfe, 0x4f, 0xff, 0x83, 0xfc,
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    0x0, 0x40, 0x0, 0x1, 0x0, 0x0,
    /* U+0025 "%" */
    0x1, 0xfd, 0x0, 0x0, 0x40, 0x0, 0x7, 0xff,
    0x80, 0x2, 0xc0, 0x0, 0x2f, 0xff, 0xe0, 0xf,
    0x80, 0x0, 0xbf, 0x2a, 0xf8, 0x1f, 0x40, 0x0,
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    0x40, 0x0, 0x0, 0x0,
    /* U+0026 "&" */
    0x0, 0x2f, 0xfa, 0x0, 0x0, 0x7f, 0xff, 0xf0,
    0x0, 0xbf, 0xdb, 0xfe, 0x0, 0x3f, 0xd0, 0x3f,
    0xc0, 0xf, 0xfd, 0x5f, 0xe0, 0x1, 0xbf, 0xff,
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    0x0, 0x0,
    /* U+0027 "'" */
    0x0, 0xf, 0x7, 0xe1, 0xfc, 0xbf, 0x2b, 0x80,
    0x80, 0x20, 0x8, 0x0, 0x0, 0x40,
    /* U+0028 "(" */
    0x3, 0x90, 0xf, 0xf0, 0x7f, 0x82, 0xfd, 0x2f,
    0xe4, 0xff, 0x63, 0xfd, 0xf, 0xf0, 0x7f, 0xc1,
    0xff, 0x47, 0xfe, 0x2f, 0xf4, 0xbf, 0xc6, 0xff,
    0x2b, 0xfc, 0x1b, 0xf0, 0x9f, 0xd0, 0x3f, 0xc8,
    0xff, 0x1, 0xfd, 0x2, 0x14, 0x4, 0x50, 0x1,
    0x40, 0x5, 0x1, 0x10, 0x0, 0x40,
    /* U+0029 ")" */
    0x3d, 0x2, 0xfc, 0x7, 0xf8, 0xb, 0xf0, 0x1f,
    0xd0, 0x3f, 0x81, 0xff, 0xf, 0xfc, 0x2b, 0xf0,
    0xbf, 0xd2, 0xff, 0xb, 0xfc, 0x1f, 0xf4, 0x7f,
    0xe2, 0xfd, 0x4b, 0xf5, 0x2f, 0xe4, 0xbf, 0x5b,
    0xf8, 0x4f, 0xc0, 0x20, 0x0, 0x40, 0x0, 0x0,
    0x80,
    /* U+002A "*" */
    0x0, 0xb0, 0x0, 0x3f, 0x80, 0x2f, 0xff, 0x8b,
    0xff, 0xfd, 0x8f, 0xfe, 0x80, 0xff, 0xd8, 0x1f,
    0xfd, 0x40, 0xe7, 0xf0, 0x8, 0x9, 0x0, 0x80,
    0x40, 0x8, 0x4, 0x0, 0x0, 0x40, 0x0, 0x4,
    0x0, 0x0, 0x80, 0x0, 0x4, 0x0,
    /* U+002B "+" */
    0x0, 0xf, 0x40, 0x0, 0x0, 0xfe, 0x0, 0x0,
    0x3, 0xfc, 0x0, 0x0, 0x7, 0xe0, 0x0, 0x5,
    0x6f, 0xd0, 0x0, 0xbf, 0xff, 0xfe, 0xb, 0xff,
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    0x0, 0x0, 0x0,
    /* U+002C "," */
    0x19, 0x41, 0xff, 0xb, 0xfd, 0x1b, 0xfc, 0x7,
    0xf0, 0xe, 0x43, 0xf6, 0xf, 0x50, 0x20, 0x50,
    0x41, 0x1, 0x0, 0x4, 0x0, 0x0, 0x0, 0x40,
    0x0,
    /* U+002D "-" */
    0x0, 0x50, 0x2, 0xff, 0xf8, 0x3f, 0xff, 0xc7,
    0xff, 0xfc, 0xaf, 0xfe, 0xc8, 0x1, 0x40, 0x40,
    0x14, 0x40, 0x1, 0x40, 0x0, 0x14, 0x4, 0x0,
    0x40, 0x0, 0x0, 0x0, 0x0, 0x0,
    /* U+002E "." */
    0x1d, 0xb, 0xf4, 0xff, 0xcb, 0xfc, 0x2, 0x40,
    0x10, 0x0, 0x0, 0x0,
    /* U+002F "/" */
    0x0, 0xe, 0x0, 0x7, 0xc0, 0x2, 0xd0, 0x0,
    0xf4, 0x0, 0xbd, 0x0, 0x3c, 0x80, 0xa, 0x0,
    0x7, 0x80, 0x3, 0xe0, 0x0, 0xe0, 0x40, 0x3c,
    0x0, 0x2e, 0x0, 0x1e, 0x80, 0xb, 0x20, 0x2,
    0xc8, 0x0, 0xf2, 0x0, 0x7c, 0x80, 0x2e, 0x0,
    0x8, 0x40, 0x2, 0x0, 0x0, 0x40, 0x0, 0x0,
    /* U+0030 "0" */
    0x0, 0x1e, 0x0, 0x0, 0x1, 0x7f, 0xff, 0x40,
    0xb, 0xff, 0xff, 0xc0, 0xf, 0xff, 0xff, 0xd0,
    0x2f, 0xf7, 0x1f, 0xf0, 0x2f, 0xe2, 0xf, 0xfc,
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    0x0, 0x0, 0x0, 0x0,
    /* U+0031 "1" */
    0x0, 0xf, 0x0, 0x2, 0xf4, 0x0, 0xbf, 0xc0,
    0xbf, 0xfc, 0x7f, 0xff, 0xcb, 0xff, 0xfc, 0x9b,
    0xff, 0xc8, 0x2f, 0xfd, 0x81, 0xff, 0xd0, 0xf,
    0xfd, 0x0, 0xff, 0xd0, 0xf, 0xfc, 0x0, 0xff,
    0xc0, 0x2f, 0xfc, 0x1, 0xbf, 0xc0, 0x12, 0x88,
    0x1, 0x14, 0x80, 0x21, 0x40, 0x0, 0x14, 0x0,
    0x1, 0x40, 0x0, 0x0, 0x0,
    /* U+0032 "2" */
    0x0, 0xb7, 0xd4, 0x0, 0x7, 0xff, 0xfc, 0x0,
    0x7f, 0xff, 0xfd, 0xb, 0xff, 0xff, 0xf8, 0x7f,
    0xd0, 0x2f, 0xf2, 0xff, 0x0, 0x3f, 0xd8, 0xb0,
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    0x0, 0x0, 0x80, 0x10, 0x0, 0x1, 0x0,
    /* U+0033 "3" */
    0x2, 0x1f, 0x80, 0x0, 0xf, 0xff, 0xe4, 0x1,
    0xff, 0xff, 0xf8, 0x1f, 0xff, 0xff, 0xf0, 0xbf,
    0x81, 0xff, 0xc2, 0x9, 0x3, 0xff, 0x8, 0x14,
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    0x0, 0x0, 0x0,
    /* U+0034 "4" */
    0x0, 0x0, 0x1f, 0x0, 0x0, 0x1, 0xff, 0x80,
    0x0, 0x3, 0xff, 0xc0, 0x0, 0x1f, 0xff, 0xc0,
    0x0, 0x7f, 0xff, 0xc0, 0x0, 0xff, 0xff, 0xc0,
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    0x0, 0x0, 0x0, 0x0,
    /* U+0035 "5" */
    0x1, 0x5f, 0x95, 0x0, 0xff, 0xff, 0xf0, 0x1f,
    0xff, 0xff, 0x1, 0xff, 0xff, 0xf0, 0x3f, 0xd0,
    0x2, 0x3, 0xfd, 0x14, 0x10, 0x3f, 0xff, 0xfe,
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    0x0,
    /* U+0036 "6" */
    0x0, 0x3, 0x40, 0x0, 0x0, 0xff, 0xff, 0x0,
    0x3, 0xff, 0xff, 0xd0, 0xf, 0xff, 0x5f, 0xd0,
    0xf, 0xf0, 0x1, 0x80, 0x2f, 0xd0, 0x0, 0x40,
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    0x0, 0x0, 0x0, 0x0,
    /* U+0037 "7" */
    0x2d, 0xba, 0xe5, 0x40, 0xff, 0xff, 0xff, 0xcb,
    0xff, 0xff, 0xff, 0x66, 0xaf, 0xff, 0xfd, 0x80,
    0x51, 0xff, 0xc6, 0x0, 0x3, 0xfe, 0x8, 0x0,
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    0x2, 0x0, 0x0, 0x0, 0x8, 0x0, 0x0,
    /* U+0038 "8" */
    0x0, 0x6e, 0xe9, 0x0, 0xf, 0xff, 0xfd, 0x0,
    0xbf, 0xff, 0xfc, 0xb, 0xfe, 0x6f, 0xf8, 0x7f,
    0xf0, 0x1f, 0xf5, 0xbf, 0x40, 0x3f, 0xd4, 0xbf,
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    0x0, 0x0, 0x0, 0x8, 0x0, 0x0, 0x0,
    /* U+0039 "9" */
    0x0, 0x2, 0xc4, 0x0, 0x3, 0xbf, 0xfe, 0x0,
    0xf, 0xff, 0xff, 0x90, 0x1f, 0xff, 0xff, 0xf0,
    0x2f, 0xf5, 0x1f, 0xf4, 0x3f, 0xf1, 0xb, 0xf4,
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    0x5, 0x0, 0x0, 0x0, 0x0, 0x0, 0x0, 0x0,
    /* U+003A ":" */
    0xf, 0x3, 0xf8, 0x7f, 0xca, 0xfc, 0x7, 0x0,
    0x20, 0x1, 0x0, 0x10, 0x7f, 0xcb, 0xfc, 0x7f,
    0xc8, 0xf0, 0x88, 0x4, 0x80, 0x8, 0x8, 0x80,
    0x8, 0x0, 0x40,
    /* U+003B ";" */
    0x2, 0x40, 0xbf, 0x4b, 0xff, 0x27, 0xf4, 0x87,
    0x2, 0x4, 0x4, 0x0, 0x1, 0xa0, 0x3f, 0xd0,
    0xff, 0xc2, 0xff, 0x42, 0xfd, 0x7, 0xd4, 0x3f,
    0x42, 0xe1, 0xb, 0x4, 0x8, 0x10, 0x10, 0x0,
    0x0, 0x0,
    /* U+003C "<" */
    0x0, 0x0, 0x0, 0x40, 0x0, 0x0, 0xf, 0xc0,
    0x0, 0xb, 0xff, 0x40, 0xf, 0xff, 0xd4, 0x0,
    0xbf, 0xd2, 0x11, 0xbf, 0xf8, 0x0, 0x8f, 0xff,
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    0x0, 0x0, 0x0, 0x0, 0x0, 0x0, 0x1, 0x0,
    /* U+003D "=" */
    0xb, 0x83, 0xc7, 0x40, 0x2f, 0xff, 0xff, 0xf8,
    0x3f, 0xff, 0xff, 0xf4, 0xa, 0x56, 0xd6, 0x90,
    0x2, 0x0, 0x80, 0x0, 0x7, 0x59, 0x68, 0x0,
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    0x0, 0x0, 0x0, 0x80, 0x0, 0x0, 0x0, 0xc0,
    /* U+003E ">" */
    0x7f, 0xc0, 0x0, 0x2, 0xff, 0xc0, 0x0, 0x3,
    0xbf, 0xfc, 0x0, 0x8, 0x3f, 0xfe, 0x0, 0x20,
    0x4e, 0xff, 0xf0, 0x80, 0x11, 0xff, 0xd0, 0x0,
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    0x8, 0x0, 0x0, 0x80, 0x20, 0x0, 0x0, 0x0,
    /* U+003F "?" */
    0x0, 0x6f, 0x80, 0x0, 0xbf, 0xff, 0xc0, 0x7f,
    0xff, 0xfe, 0xb, 0xfd, 0x7f, 0xf8, 0x7f, 0x1,
    0xff, 0xd5, 0x10, 0xf, 0xf5, 0x40, 0xa, 0xff,
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    0x0,
    /* U+0040 "@" */
    0x0, 0x1, 0xfb, 0xfe, 0x0, 0x0, 0x0, 0x2f,
    0xff, 0xff, 0xf0, 0x0, 0xf, 0xe0, 0x60, 0xb,
    0xe0, 0x0, 0xbf, 0x0, 0x40, 0x17, 0xf0, 0x7,
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    0x0, 0x0, 0x80, 0x0, 0x0, 0x0,
    /* U+0041 "A" */
    0x0, 0x0, 0x0, 0x0, 0x0, 0x3, 0xff, 0x0,
    0x0, 0x3, 0xff, 0xe0, 0x0, 0x0, 0xff, 0xfc,
    0x0, 0x0, 0xbf, 0xff, 0x40, 0x0, 0x7f, 0xff,
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    0x2, 0x0, 0x0, 0x0, 0x0, 0x0,
    /* U+0042 "B" */
    0xf, 0xff, 0xff, 0x40, 0x3f, 0xff, 0xff, 0xe4,
    0x7f, 0xff, 0xff, 0xfc, 0x7f, 0xff, 0xff, 0xfc,
    0x7f, 0xf0, 0xf, 0xfc, 0x7f, 0xe0, 0x6f, 0xf8,
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    0x0, 0x8, 0x0, 0x0,
    /* U+0043 "C" */
    0x0, 0x2f, 0xff, 0x80, 0x0, 0x2f, 0xff, 0xff,
    0xd0, 0xb, 0xff, 0xff, 0xff, 0x1, 0xff, 0xe6,
    0xff, 0xf4, 0x1f, 0xfc, 0x3, 0xff, 0xc2, 0xff,
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    0x0, 0x0, 0x0, 0x0,
    /* U+0044 "D" */
    0x1, 0xf6, 0xfc, 0x0, 0xb, 0xff, 0xff, 0xe0,
    0x3, 0xff, 0xff, 0xff, 0x40, 0xff, 0xff, 0xff,
    0xf4, 0xbf, 0xff, 0x1f, 0xff, 0x2f, 0xf8, 0x85,
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    0x0, 0x0,
    /* U+0045 "E" */
    0x7, 0xeb, 0xe4, 0x41, 0xff, 0xff, 0xff, 0xcb,
    0xff, 0xff, 0xff, 0x2f, 0xff, 0xbf, 0xa8, 0x3f,
    0xf4, 0x20, 0x20, 0xff, 0xe0, 0x0, 0x47, 0xff,
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    0x2, 0x0, 0x0, 0x0, 0x0, 0x0,
    /* U+0046 "F" */
    0x2, 0xfa, 0xf4, 0x3, 0xff, 0xff, 0xf8, 0x3f,
    0xff, 0xff, 0xc7, 0xff, 0xfb, 0xf0, 0xbf, 0xf8,
    0x24, 0x7, 0xfd, 0x2, 0x0, 0x7f, 0xe0, 0x20,
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    0x0,
    /* U+0047 "G" */
    0x0, 0xbf, 0xff, 0xf8, 0x0, 0x1f, 0xff, 0xff,
    0xc0, 0xf, 0xff, 0xff, 0xfe, 0x1, 0xff, 0xff,
    0xff, 0xe0, 0x1f, 0xfc, 0x80, 0xc, 0x3, 0xff,
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    0x10, 0x0, 0x0, 0x0, 0x5, 0x0, 0x1, 0x0,
    /* U+0048 "H" */
    0x2f, 0xc0, 0x0, 0xbd, 0x3, 0xfe, 0x0, 0x1f,
    0xf0, 0x3f, 0xe0, 0x2, 0xff, 0x7, 0xfe, 0x0,
    0x3f, 0xf8, 0x7f, 0xe0, 0x3, 0xff, 0xcb, 0xff,
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    0x0, 0x1, 0x40, 0x0, 0x0, 0x0, 0x0, 0x0,
    /* U+0049 "I" */
    0xf, 0x80, 0xff, 0xd7, 0xff, 0xf, 0xfc, 0x3f,
    0xf8, 0xff, 0xd7, 0xff, 0xf, 0xfc, 0x3f, 0xf9,
    0xff, 0xdb, 0xff, 0x1f, 0xfe, 0x7f, 0xf9, 0xff,
    0xe5, 0xff, 0x43, 0xe5, 0x42, 0x10, 0x8, 0x0,
    0x10, 0x0, 0x80, 0x2, 0x0, 0x18, 0x0, 0x10,
    0x0,
    /* U+004A "J" */
    0x0, 0x0, 0x1e, 0x0, 0x0, 0xb, 0xfc, 0x0,
    0x0, 0xbf, 0xd0, 0x0, 0xf, 0xfe, 0x0, 0x0,
    0xff, 0xe0, 0x0, 0x7, 0xfd, 0x0, 0x1, 0xff,
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    0x0, 0x0, 0x10, 0x0,
    /* U+004B "K" */
    0x1f, 0xd0, 0x7, 0xf0, 0x3f, 0xf0, 0x3f, 0xe0,
    0x7f, 0xff, 0xff, 0xd0, 0xbf, 0xff, 0xff, 0xd0,
    0xbf, 0xff, 0xff, 0xc0, 0x3f, 0xff, 0xfc, 0x80,
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    0x0, 0x0, 0x0, 0x50,
    /* U+004C "L" */
    0xb, 0xc0, 0x0, 0x3, 0xfd, 0x0, 0x0, 0x7f,
    0xf4, 0x0, 0x7, 0xff, 0x80, 0x0, 0x7f, 0xe8,
    0x0, 0x3, 0xff, 0x80, 0x0, 0x3f, 0xf0, 0x0,
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    0x0,
    /* U+004D "M" */
    0x0, 0x0, 0x0, 0x0, 0x0, 0xb, 0xfc, 0x0,
    0xf, 0xfe, 0x7, 0xff, 0xc0, 0x3, 0xff, 0xd2,
    0xff, 0xfc, 0x0, 0xff, 0xf4, 0x7f, 0xff, 0x0,
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    0x0, 0x0, 0x0, 0x0, 0x0, 0x0,
    /* U+004E "N" */
    0x2f, 0x40, 0x0, 0xbd, 0x2f, 0xfd, 0x0, 0xbf,
    0xcb, 0xff, 0x80, 0x1f, 0xf4, 0xff, 0xf0, 0x7,
    0xfd, 0x7f, 0xff, 0x43, 0xff, 0x3f, 0xff, 0xf0,
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    0x0, 0x0, 0x0, 0x1, 0x0, 0x0,
    /* U+004F "O" */
    0x0, 0x3, 0xfd, 0x38, 0x0, 0x0, 0x6f, 0xff,
    0xfe, 0x0, 0x2, 0xff, 0xff, 0xff, 0x40, 0x3,
    0xff, 0xff, 0xff, 0xd0, 0xb, 0xff, 0xe7, 0xbf,
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    0x0, 0x0, 0x0,
    /* U+0050 "P" */
    0x0, 0x0, 0x0, 0x0, 0x2, 0xff, 0xf9, 0x0,
    0x6, 0xff, 0xff, 0xfe, 0x1, 0xff, 0xff, 0xff,
    0xe0, 0x7f, 0xff, 0xbf, 0xfd, 0x2f, 0xfd, 0x83,
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    0x0, 0x10, 0x0,
    /* U+0051 "Q" */
    0x0, 0x2, 0xff, 0x0, 0x0, 0xf, 0xff, 0xff,
    0x40, 0x2, 0xff, 0xff, 0xfc, 0x0, 0xff, 0xfb,
    0xff, 0xf8, 0x3f, 0xf4, 0x22, 0xff, 0xd7, 0xfe,
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    0x2, 0x0, 0x0,
    /* U+0052 "R" */
    0x2f, 0xff, 0xff, 0xf0, 0xf, 0xff, 0xff, 0xfe,
    0x3, 0xff, 0xff, 0xff, 0xf0, 0xff, 0xfc, 0x3f,
    0xfc, 0x7f, 0xf1, 0x7, 0xfe, 0x1f, 0xfc, 0x0,
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    0x0, 0x0,
    /* U+0053 "S" */
    0x0, 0x7f, 0xfd, 0x0, 0x1f, 0xff, 0xfd, 0x2,
    0xff, 0xff, 0xfe, 0xf, 0xff, 0xbf, 0xff, 0x7f,
    0xf4, 0x7, 0xfa, 0xff, 0xd0, 0xd, 0x26, 0xff,
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    0x0, 0x20, 0x0, 0x0, 0x0, 0x0, 0x0,
    /* U+0054 "T" */
    0x3f, 0xff, 0xff, 0xf4, 0x1f, 0xff, 0xff, 0xff,
    0x8b, 0xff, 0xff, 0xff, 0xe0, 0xff, 0xff, 0xff,
    0xf0, 0x20, 0x7f, 0xfe, 0xc, 0x8, 0x7, 0xfd,
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    0x0, 0x0, 0x0, 0x0, 0x0, 0x0,
    /* U+0055 "U" */
    0x3f, 0xc0, 0x1, 0xf4, 0xf, 0xf4, 0x1, 0xff,
    0x83, 0xff, 0x0, 0x3f, 0xf0, 0xff, 0x80, 0xf,
    0xfc, 0xbf, 0xd0, 0x3, 0xff, 0x2f, 0xf4, 0x0,
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    0x0, 0x0, 0x0, 0x40, 0x0, 0x0, 0x0,
    /* U+0056 "V" */
    0x3f, 0xc0, 0x1, 0xe5, 0xff, 0x0, 0x1f, 0xf3,
    0xfc, 0x0, 0xff, 0xef, 0xf4, 0x7, 0xfd, 0xbf,
    0xf0, 0xf, 0xf1, 0x7f, 0xc0, 0xbf, 0xc4, 0xff,
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    0x0, 0x0, 0x0,
    /* U+0057 "W" */
    0xb, 0x0, 0x0, 0x0, 0xb, 0x4b, 0xf4, 0x1,
    0xf8, 0x1, 0xfc, 0xbf, 0xc0, 0x7f, 0xf0, 0x7f,
    0xd7, 0xfc, 0xf, 0xfe, 0xb, 0xfd, 0x7f, 0xc0,
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    0x0, 0x0, 0x0, 0x40, 0x0, 0x0, 0x0,
    /* U+0058 "X" */
    0x1f, 0xc0, 0x7, 0xc0, 0xbf, 0xd1, 0xff, 0x81,
    0xff, 0xff, 0xff, 0x3, 0xff, 0xff, 0xf8, 0xf,
    0xff, 0xff, 0x20, 0x2f, 0xff, 0xf4, 0x80, 0x4f,
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    0x0, 0x0, 0x0, 0x8, 0x0, 0x0, 0x0,
    /* U+0059 "Y" */
    0xb, 0x0, 0x1, 0xe1, 0xff, 0x0, 0x3f, 0xdb,
    0xfe, 0x2, 0xff, 0xdf, 0xff, 0xb, 0xfe, 0xf,
    0xff, 0xff, 0xe8, 0x1f, 0xff, 0xff, 0x20, 0x2f,
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    0x0, 0x0,
    /* U+005A "Z" */
    0x0, 0x0, 0x0, 0x0, 0xf, 0xff, 0xff, 0xf4,
    0x3f, 0xff, 0xff, 0xfd, 0x3f, 0xff, 0xff, 0xff,
    0x7, 0xaf, 0xff, 0xfa, 0x2, 0x1, 0xff, 0xe1,
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    0x2, 0x0, 0x10, 0x0, 0x1, 0x0, 0x0, 0x0,
    /* U+005B "[" */
    0x1, 0xb4, 0x7, 0xff, 0xc7, 0xff, 0xf5, 0xff,
    0x85, 0x7f, 0xe1, 0x4f, 0xf4, 0x53, 0xfc, 0x15,
    0xff, 0x5, 0xbf, 0xd1, 0x5f, 0xf8, 0x3, 0xfe,
    0x0, 0xff, 0x80, 0x7f, 0xd0, 0xf, 0xf4, 0x3,
    0xfd, 0x0, 0xff, 0x0, 0x7f, 0xf8, 0xb, 0xff,
    0xd3, 0xff, 0xf8, 0x8b, 0x88, 0x20, 0x12, 0x8,
    0x0, 0x82, 0x0, 0x20,
    /* U+005C "\\" */
    0x70, 0x0, 0x2f, 0x0, 0x2, 0xc0, 0x0, 0xb0,
    0x0, 0x1c, 0x0, 0x3, 0xc0, 0x0, 0xf4, 0x0,
    0x3d, 0x0, 0xa, 0x80, 0x2, 0x74, 0x0, 0x8f,
    0x0, 0x27, 0xc0, 0x8, 0xf4, 0x0, 0xe, 0x0,
    0x3, 0x80, 0x0, 0xf0, 0x0, 0x2f, 0x0, 0x4,
    0xc0, 0x1, 0x20, 0x0, 0x8, 0x0, 0x2, 0x0,
    0x0, 0x80, 0x0, 0x10, 0x0, 0x0,
    /* U+005D "]" */
    0xb, 0x40, 0xbf, 0xfc, 0x7f, 0xff, 0x7f, 0xfd,
    0x13, 0xfd, 0x12, 0xff, 0x12, 0xfe, 0x23, 0xfc,
    0x3, 0xfe, 0x3, 0xfe, 0x3, 0xfd, 0x2, 0xfc,
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    0x0, 0x0,
    /* U+005E "^" */
    0x0, 0x0, 0x0, 0x2, 0xfe, 0x40, 0xb, 0xff,
    0xc0, 0xf, 0xff, 0xe0, 0x1f, 0x8f, 0xfc, 0x7a,
    0x4, 0xfd, 0xa0, 0x4, 0x8e, 0x40, 0x4, 0x81,
    0x40, 0x4, 0x81, 0x40, 0x4, 0x41, 0x0, 0x4,
    0x1, 0x0, 0x4, 0x40, 0x0, 0x4, 0x4, 0x0,
    0x14, 0x4, 0x0, 0x4, 0x0, 0x0, 0x0, 0x0,
    0x0, 0x0, 0x0, 0x0, 0x0, 0x0,
    /* U+005F "_" */
    0x2f, 0xff, 0xff, 0x1f, 0xff, 0xff, 0xd7, 0xff,
    0xff, 0x94, 0x21, 0x80, 0x80, 0x8, 0x10, 0x20,
    0x2, 0x0, 0x8, 0x0, 0x41, 0x2, 0x0, 0x20,
    0x0, 0x0, 0x8, 0x0, 0x0, 0x0,
    /* U+0061 "a" */
    0x0, 0x7b, 0xeb, 0x0, 0x1f, 0xff, 0xfe, 0x2,
    0xff, 0xff, 0xfd, 0x0, 0xb0, 0xb, 0xfc, 0x0,
    0x40, 0x7f, 0xf0, 0x2, 0xff, 0xff, 0xc1, 0xff,
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    0x2, 0x0, 0x0, 0x0, 0x4, 0x0, 0x1, 0x0,
    /* U+0062 "b" */
    0xb, 0x0, 0x0, 0x0, 0xfe, 0x0, 0x0, 0xb,
    0xfc, 0x0, 0x0, 0x2f, 0xf4, 0x0, 0x0, 0x7f,
    0xff, 0xfe, 0x0, 0xff, 0xff, 0xfe, 0x3, 0xff,
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    0x0, 0x0,
    /* U+0063 "c" */
    0x0, 0xb, 0x90, 0x0, 0x2f, 0xff, 0xd0, 0xb,
    0xff, 0xff, 0xc3, 0xff, 0xfb, 0xfc, 0x3f, 0xe0,
    0x42, 0x83, 0xfd, 0x4, 0x4, 0x7f, 0xc0, 0x0,
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    0x0, 0x50, 0x0,
    /* U+0064 "d" */
    0x0, 0x0, 0xb, 0xc0, 0x0, 0x0, 0x3f, 0xc0,
    0x0, 0x1, 0xff, 0x0, 0x0, 0x7, 0xfc, 0x1,
    0xf1, 0xff, 0xf0, 0xf, 0xff, 0xff, 0xc2, 0xff,
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    0x0, 0x0, 0x0, 0x0, 0x0,
    /* U+0065 "e" */
    0x0, 0xb, 0x80, 0x0, 0x7f, 0xff, 0xd0, 0x1f,
    0xff, 0xff, 0x7, 0xff, 0xab, 0xfd, 0x7f, 0xe1,
    0x3f, 0xeb, 0xff, 0x47, 0xff, 0xbf, 0xff, 0xff,
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    0x0, 0x0, 0x0,
    /* U+0066 "f" */
    0x0, 0x2f, 0xc0, 0xf, 0xff, 0xc0, 0x3f, 0xfd,
    0x1, 0xff, 0x40, 0xf, 0xff, 0x2, 0xff, 0xff,
    0x4b, 0xff, 0xff, 0x62, 0xff, 0xd5, 0x4b, 0xfe,
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    0x20, 0x0, 0x0, 0x40, 0x0, 0x1, 0x0, 0x0,
    /* U+0067 "g" */
    0x3, 0xfe, 0xaf, 0xc0, 0x3f, 0xff, 0xff, 0xc2,
    0xff, 0xff, 0xff, 0x1f, 0xff, 0x7f, 0xfc, 0x7f,
    0xd8, 0x2f, 0xf1, 0xff, 0x10, 0x3f, 0xdb, 0xfe,
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    0x0, 0x0, 0x0, 0x0, 0x0, 0x10, 0x0,
    /* U+0068 "h" */
    0x2a, 0x40, 0x0, 0x1, 0xff, 0x0, 0x0, 0xb,
    0xfc, 0x0, 0x0, 0x1f, 0xf8, 0x0, 0x0, 0x3f,
    0xfb, 0xd5, 0x2, 0xff, 0xff, 0xff, 0x3, 0xff,
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    0x0, 0x0, 0x0,
    /* U+0069 "i" */
    0x3f, 0x0, 0xfe, 0x1, 0xfc, 0x0, 0xc0, 0x2,
    0x0, 0x3f, 0x2, 0xfc, 0xf, 0xf4, 0x7f, 0xe1,
    0xff, 0x83, 0xff, 0xf, 0xfc, 0x3f, 0xf2, 0xff,
    0x4b, 0xfd, 0x2b, 0xf8, 0x7, 0xa0, 0x8, 0x44,
    0x21, 0x0, 0x44, 0x0, 0x10, 0x0, 0x40, 0x0,
    0x0,
    /* U+006A "j" */
    0x0, 0x64, 0x0, 0xff, 0x0, 0x3f, 0x80, 0x2,
    0xc0, 0x0, 0x14, 0x0, 0x79, 0x0, 0x2f, 0xf0,
    0xf, 0xfc, 0x3, 0xfe, 0x0, 0xff, 0x80, 0x3f,
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    0x8, 0x0, 0x2, 0x0, 0x0, 0x80,
    /* U+006B "k" */
    0xb, 0x0, 0x0, 0x2f, 0xe0, 0x0, 0xb, 0xfd,
    0x0, 0x1, 0xff, 0x80, 0x0, 0xbf, 0xd0, 0x3d,
    0x2f, 0xf4, 0x3f, 0x43, 0xff, 0xbf, 0xc1, 0xff,
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    0x0, 0x0, 0x4, 0x0, 0x0,
    /* U+006C "l" */
    0xd, 0x2, 0xfc, 0x7f, 0xcb, 0xfc, 0xff, 0xcb,
    0xfe, 0x3f, 0xeb, 0xfc, 0xbf, 0xd7, 0xfe, 0xbf,
    0xd7, 0xfd, 0x7f, 0xdb, 0xfe, 0xbf, 0xeb, 0xf5,
    0x87, 0x8, 0x30, 0x2, 0x0, 0x10, 0x2, 0x0,
    0x20, 0x1, 0x0,
    /* U+006D "m" */
    0x0, 0x0, 0x0, 0x0, 0x0, 0x0, 0xf6, 0xd7,
    0xf9, 0x75, 0xe4, 0xb, 0xff, 0xff, 0xff, 0xff,
    0xfc, 0x2f, 0xff, 0xff, 0xff, 0xff, 0xf4, 0x7f,
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    0x0, 0x0,
    /* U+006E "n" */
    0xf, 0x0, 0xfe, 0x0, 0xfe, 0xbf, 0xfc, 0xb,
    0xff, 0xff, 0xfe, 0x1f, 0xfd, 0x3f, 0xf8, 0x3f,
    0xe0, 0xbf, 0xe0, 0xff, 0x80, 0xff, 0xcb, 0xfe,
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    0x20, 0x0, 0x0,
    /* U+006F "o" */
    0x0, 0xbf, 0xf8, 0x0, 0x3f, 0xff, 0xfe, 0x0,
    0xff, 0xbb, 0xff, 0xb, 0xf8, 0x8b, 0xfc, 0x3f,
    0xd1, 0x2f, 0xf2, 0xff, 0x88, 0xbf, 0xeb, 0xfe,
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    0x1, 0x40, 0x0, 0x0, 0x0, 0x0, 0x0,
    /* U+0070 "p" */
    0x0, 0x0, 0x10, 0x0, 0xa0, 0x3f, 0xf4, 0x3,
    0xff, 0xff, 0xf4, 0xf, 0xff, 0xff, 0xf8, 0x3f,
    0xe6, 0xbf, 0xf2, 0xff, 0x4, 0xbf, 0xcb, 0xfd,
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    0x0, 0x8, 0x0, 0x8, 0x0, 0x0, 0x0,
    /* U+0071 "q" */
    0x6, 0xfc, 0x3, 0x40, 0x3f, 0xff, 0xff, 0x40,
    0xff, 0xff, 0xff, 0x2f, 0xff, 0xff, 0xfd, 0xbf,
    0xe4, 0xff, 0xf2, 0xff, 0x40, 0xff, 0xcf, 0xfd,
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    0x0, 0x0, 0x10, 0x0, 0x0, 0x1, 0x40,
    /* U+0072 "r" */
    0x0, 0x0, 0x0, 0x38, 0x7, 0xc2, 0xf6, 0xff,
    0x9f, 0xff, 0xfd, 0xbf, 0xff, 0xf2, 0xff, 0xfa,
    0x43, 0xff, 0x45, 0xf, 0xfc, 0x4, 0x7f, 0xe0,
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    0x0, 0x0, 0x20, 0x0, 0x0,
    /* U+0073 "s" */
    0x2, 0xff, 0xfc, 0x0, 0xbf, 0xff, 0xf0, 0x2f,
    0xf9, 0x5b, 0x87, 0xff, 0x40, 0x14, 0x5f, 0xfd,
    0x11, 0x0, 0xff, 0xff, 0xf0, 0x2, 0x7f, 0xff,
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    0x40, 0x0, 0x0, 0x0, 0x0,
    /* U+0074 "t" */
    0x0, 0xb4, 0x0, 0x7, 0xfc, 0x0, 0x3f, 0xf0,
    0x1, 0xff, 0xc0, 0xf, 0xff, 0xf5, 0xff, 0xff,
    0xea, 0xff, 0xf9, 0xa0, 0xff, 0xd1, 0x83, 0xff,
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    0x1, 0x14, 0x0, 0x0, 0x50, 0x0, 0x1, 0x40,
    /* U+0075 "u" */
    0x29, 0x0, 0x7, 0x82, 0xff, 0x40, 0x7f, 0xb,
    0xfd, 0x3, 0xfe, 0x2f, 0xf0, 0xf, 0xfd, 0xbf,
    0xc0, 0x7f, 0xf1, 0xff, 0x40, 0xbf, 0xc7, 0xfc,
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    0x2, 0x0, 0x0,
    /* U+0076 "v" */
    0x78, 0x0, 0x34, 0x3f, 0x80, 0x3f, 0xcb, 0xf4,
    0xf, 0xfa, 0xff, 0x3, 0xfe, 0x3f, 0xd3, 0xfd,
    0x4f, 0xff, 0xff, 0x13, 0xff, 0xff, 0x94, 0x7f,
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    0x0, 0x0, 0x0, 0x0, 0x0,
    /* U+0077 "w" */
    0x0, 0x0, 0x0, 0x0, 0x0, 0x38, 0x0, 0x74,
    0x0, 0xa0, 0xbf, 0x1, 0xff, 0x40, 0xfe, 0xbf,
    0x42, 0xff, 0x80, 0xff, 0x7f, 0x83, 0xff, 0xc1,
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    0x10, 0x0, 0x0,
    /* U+0078 "x" */
    0x2e, 0x1, 0xe0, 0x7f, 0x87, 0xf8, 0x7f, 0xff,
    0xf8, 0x7f, 0xff, 0xf8, 0xf, 0xff, 0xe8, 0x7,
    0xff, 0x88, 0x7, 0xff, 0xc4, 0xb, 0xff, 0xf4,
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    0x50, 0x0, 0x0, 0x50, 0x1, 0x0, 0x50,
    /* U+0079 "y" */
    0x38, 0x0, 0x7f, 0x1f, 0xd0, 0x2f, 0xcb, 0xf4,
    0x1f, 0xf1, 0xfe, 0xb, 0xf8, 0x7f, 0xd7, 0xfe,
    0xf, 0xff, 0xff, 0x82, 0xff, 0xff, 0x50, 0x2f,
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    0x0, 0x0, 0x8, 0x0, 0x0, 0x0, 0x0, 0x0,
    /* U+007A "z" */
    0x7, 0x9f, 0xe4, 0x0, 0xff, 0xff, 0xf0, 0xb,
    0xff, 0xff, 0xc0, 0x87, 0xff, 0xe5, 0x4, 0xf,
    0xfc, 0x50, 0x1, 0xff, 0x44, 0x1, 0xff, 0xa0,
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    0x0, 0x0, 0x10, 0x0, 0x0,
    /* U+007B "{" */
    0x0, 0x2f, 0x40, 0xb, 0xfc, 0x2, 0xff, 0xc0,
    0x3f, 0xd8, 0x3, 0xf8, 0x80, 0x2f, 0xc8, 0x2,
    0xf8, 0x40, 0x3f, 0x80, 0x1f, 0xfc, 0x3, 0xff,
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    0x0,
    /* U+007C "|" */
    0x0, 0xf, 0x47, 0xf1, 0xfc, 0x7f, 0x1f, 0xcb,
    0xf2, 0xfc, 0xbf, 0x1f, 0x8b, 0xf1, 0xfc, 0x3f,
    0xf, 0xc7, 0xf1, 0xfc, 0xbf, 0x2f, 0xcb, 0xf2,
    0xfc, 0xbf, 0x1f, 0xc3, 0xe4, 0x51, 0x15, 0x5,
    0x41, 0x40, 0x10, 0x14, 0x0,
    /* U+007D "}" */
    0x0, 0x0, 0x3, 0xf4, 0x0, 0x3f, 0xf0, 0x2,
    0xff, 0xc0, 0xb, 0xfc, 0x0, 0x3f, 0x80, 0x3,
    0xfc, 0x0, 0x3f, 0xc0, 0x7, 0xf8, 0x0, 0x7f,
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    0x0, 0x14, 0x0, 0x0, 0x0, 0x0,
    /* U+007E "~" */
    0x1, 0x5d, 0x0, 0x0, 0x3, 0xff, 0xe9, 0x2,
    0xcb, 0xff, 0xff, 0xff, 0xf0, 0xf4, 0xb, 0xff,
    0xf8, 0x8, 0x0, 0x27, 0x5, 0x1, 0x0, 0x4,
    0x1, 0x0, 0x40, 0x1, 0x0, 0x40, 0x10, 0x0,
    0x40, 0x10, 0x0, 0x0, 0x10, 0x4, 0x0, 0x0,
    0x4, 0x1, 0x0, 0x0, 0x5, 0x0, 0x0,
    /* U+00C6 "Æ" */
    0x0, 0x3, 0xff, 0xff, 0xff, 0xf8, 0x0, 0x3,
    0xff, 0xff, 0xff, 0xff, 0xc0, 0x2, 0xff, 0xff,
    0xff, 0xff, 0xf0, 0x0, 0xbf, 0xff, 0xff, 0x7,
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    0x0,
    /* U+00E6 "æ" */
    0x0, 0x0, 0x0, 0x0, 0x0, 0x0, 0x0, 0xb9,
    0x0, 0x3f, 0x80, 0x0, 0x6f, 0xff, 0xff, 0xff,
    0xe0, 0xb, 0xff, 0xff, 0xff, 0xff, 0xc0, 0xa,
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    0x40, 0x0, 0x80, 0x0, 0x0, 0x0, 0x0, 0x0,
    0x0
};
/*---------------------
 *  GLYPH DESCRIPTION
 *--------------------*/
static const lv_font_fmt_txt_glyph_dsc_t creepy_24_glyph_dsc[] = {
    {.bitmap_index = 0, .adv_w = 0, .box_w = 0, .box_h = 0, .ofs_x = 0, .ofs_y = 0} /* id = 0 reserved */,
    {.bitmap_index = 0, .adv_w = 154, .box_w = 0, .box_h = 0, .ofs_x = 0, .ofs_y = 0},
    {.bitmap_index = 0, .adv_w = 96, .box_w = 6, .box_h = 20, .ofs_x = 0, .ofs_y = -4},
    {.bitmap_index = 30, .adv_w = 137, .box_w = 9, .box_h = 12, .ofs_x = 0, .ofs_y = 4},
    {.bitmap_index = 57, .adv_w = 278, .box_w = 18, .box_h = 23, .ofs_x = 0, .ofs_y = -7},
    {.bitmap_index = 161, .adv_w = 239, .box_w = 15, .box_h = 25, .ofs_x = 0, .ofs_y = -7},
    {.bitmap_index = 255, .adv_w = 384, .box_w = 24, .box_h = 22, .ofs_x = 0, .ofs_y = -6},
    {.bitmap_index = 387, .adv_w = 267, .box_w = 17, .box_h = 23, .ofs_x = 0, .ofs_y = -7},
    {.bitmap_index = 485, .adv_w = 70, .box_w = 5, .box_h = 11, .ofs_x = 0, .ofs_y = 5},
    {.bitmap_index = 499, .adv_w = 113, .box_w = 7, .box_h = 26, .ofs_x = 0, .ofs_y = -10},
    {.bitmap_index = 545, .adv_w = 110, .box_w = 7, .box_h = 23, .ofs_x = 0, .ofs_y = -7},
    {.bitmap_index = 586, .adv_w = 157, .box_w = 10, .box_h = 15, .ofs_x = 0, .ofs_y = 1},
    {.bitmap_index = 624, .adv_w = 232, .box_w = 15, .box_h = 20, .ofs_x = 0, .ofs_y = -7},
    {.bitmap_index = 699, .adv_w = 103, .box_w = 7, .box_h = 14, .ofs_x = 0, .ofs_y = -9},
    {.bitmap_index = 724, .adv_w = 152, .box_w = 10, .box_h = 12, .ofs_x = 0, .ofs_y = -3},
    {.bitmap_index = 754, .adv_w = 90, .box_w = 6, .box_h = 8, .ofs_x = 0, .ofs_y = -3},
    {.bitmap_index = 766, .adv_w = 134, .box_w = 9, .box_h = 21, .ofs_x = 0, .ofs_y = -5},
    {.bitmap_index = 814, .adv_w = 250, .box_w = 16, .box_h = 23, .ofs_x = 0, .ofs_y = -7},
    {.bitmap_index = 906, .adv_w = 156, .box_w = 10, .box_h = 21, .ofs_x = 0, .ofs_y = -5},
    {.bitmap_index = 959, .adv_w = 235, .box_w = 15, .box_h = 23, .ofs_x = 0, .ofs_y = -7},
    {.bitmap_index = 1046, .adv_w = 228, .box_w = 15, .box_h = 22, .ofs_x = 0, .ofs_y = -6},
    {.bitmap_index = 1129, .adv_w = 252, .box_w = 16, .box_h = 23, .ofs_x = 0, .ofs_y = -7},
    {.bitmap_index = 1221, .adv_w = 222, .box_w = 14, .box_h = 23, .ofs_x = 0, .ofs_y = -7},
    {.bitmap_index = 1302, .adv_w = 249, .box_w = 16, .box_h = 23, .ofs_x = 0, .ofs_y = -7},
    {.bitmap_index = 1394, .adv_w = 236, .box_w = 15, .box_h = 21, .ofs_x = 0, .ofs_y = -5},
    {.bitmap_index = 1473, .adv_w = 244, .box_w = 15, .box_h = 23, .ofs_x = 0, .ofs_y = -7},
    {.bitmap_index = 1560, .adv_w = 249, .box_w = 16, .box_h = 22, .ofs_x = 0, .ofs_y = -6},
    {.bitmap_index = 1648, .adv_w = 87, .box_w = 6, .box_h = 18, .ofs_x = 0, .ofs_y = -6},
    {.bitmap_index = 1675, .adv_w = 107, .box_w = 7, .box_h = 19, .ofs_x = 0, .ofs_y = -7},
    {.bitmap_index = 1709, .adv_w = 235, .box_w = 15, .box_h = 19, .ofs_x = 0, .ofs_y = -5},
    {.bitmap_index = 1781, .adv_w = 247, .box_w = 16, .box_h = 16, .ofs_x = 0, .ofs_y = -5},
    {.bitmap_index = 1845, .adv_w = 238, .box_w = 15, .box_h = 17, .ofs_x = 0, .ofs_y = -5},
    {.bitmap_index = 1909, .adv_w = 218, .box_w = 14, .box_h = 23, .ofs_x = 0, .ofs_y = -7},
    {.bitmap_index = 1990, .adv_w = 364, .box_w = 23, .box_h = 26, .ofs_x = 0, .ofs_y = -10},
    {.bitmap_index = 2140, .adv_w = 261, .box_w = 17, .box_h = 24, .ofs_x = 0, .ofs_y = -7},
    {.bitmap_index = 2242, .adv_w = 258, .box_w = 16, .box_h = 23, .ofs_x = 0, .ofs_y = -7},
    {.bitmap_index = 2334, .adv_w = 278, .box_w = 18, .box_h = 24, .ofs_x = 0, .ofs_y = -8},
    {.bitmap_index = 2442, .adv_w = 273, .box_w = 17, .box_h = 23, .ofs_x = 0, .ofs_y = -7},
    {.bitmap_index = 2540, .adv_w = 235, .box_w = 15, .box_h = 25, .ofs_x = 0, .ofs_y = -9},
    {.bitmap_index = 2634, .adv_w = 213, .box_w = 14, .box_h = 23, .ofs_x = 0, .ofs_y = -7},
    {.bitmap_index = 2715, .adv_w = 285, .box_w = 18, .box_h = 23, .ofs_x = 0, .ofs_y = -7},
    {.bitmap_index = 2819, .adv_w = 280, .box_w = 18, .box_h = 23, .ofs_x = 0, .ofs_y = -7},
    {.bitmap_index = 2923, .adv_w = 110, .box_w = 7, .box_h = 23, .ofs_x = 0, .ofs_y = -7},
    {.bitmap_index = 2964, .adv_w = 224, .box_w = 14, .box_h = 24, .ofs_x = 0, .ofs_y = -8},
    {.bitmap_index = 3048, .adv_w = 260, .box_w = 16, .box_h = 23, .ofs_x = 0, .ofs_y = -7},
    {.bitmap_index = 3140, .adv_w = 218, .box_w = 14, .box_h = 23, .ofs_x = 0, .ofs_y = -7},
    {.bitmap_index = 3221, .adv_w = 326, .box_w = 21, .box_h = 24, .ofs_x = 0, .ofs_y = -7},
    {.bitmap_index = 3347, .adv_w = 267, .box_w = 17, .box_h = 24, .ofs_x = 0, .ofs_y = -8},
    {.bitmap_index = 3449, .adv_w = 311, .box_w = 20, .box_h = 23, .ofs_x = 0, .ofs_y = -7},
    {.bitmap_index = 3564, .adv_w = 261, .box_w = 17, .box_h = 25, .ofs_x = 0, .ofs_y = -8},
    {.bitmap_index = 3671, .adv_w = 291, .box_w = 18, .box_h = 29, .ofs_x = 0, .ofs_y = -13},
    {.bitmap_index = 3802, .adv_w = 269, .box_w = 17, .box_h = 23, .ofs_x = 0, .ofs_y = -7},
    {.bitmap_index = 3900, .adv_w = 242, .box_w = 15, .box_h = 23, .ofs_x = 0, .ofs_y = -7},
    {.bitmap_index = 3987, .adv_w = 264, .box_w = 17, .box_h = 22, .ofs_x = 0, .ofs_y = -6},
    {.bitmap_index = 4081, .adv_w = 264, .box_w = 17, .box_h = 26, .ofs_x = 0, .ofs_y = -10},
    {.bitmap_index = 4192, .adv_w = 242, .box_w = 15, .box_h = 22, .ofs_x = 0, .ofs_y = -6},
    {.bitmap_index = 4275, .adv_w = 351, .box_w = 22, .box_h = 23, .ofs_x = 0, .ofs_y = -7},
    {.bitmap_index = 4402, .adv_w = 228, .box_w = 15, .box_h = 23, .ofs_x = 0, .ofs_y = -7},
    {.bitmap_index = 4489, .adv_w = 242, .box_w = 15, .box_h = 24, .ofs_x = 0, .ofs_y = -8},
    {.bitmap_index = 4579, .adv_w = 258, .box_w = 16, .box_h = 24, .ofs_x = 0, .ofs_y = -7},
    {.bitmap_index = 4675, .adv_w = 143, .box_w = 9, .box_h = 23, .ofs_x = 0, .ofs_y = -7},
    {.bitmap_index = 4727, .adv_w = 132, .box_w = 9, .box_h = 24, .ofs_x = 0, .ofs_y = -8},
    {.bitmap_index = 4781, .adv_w = 131, .box_w = 8, .box_h = 33, .ofs_x = 0, .ofs_y = -17},
    {.bitmap_index = 4847, .adv_w = 190, .box_w = 12, .box_h = 18, .ofs_x = 0, .ofs_y = -1},
    {.bitmap_index = 4901, .adv_w = 204, .box_w = 13, .box_h = 9, .ofs_x = 0, .ofs_y = -11},
    {.bitmap_index = 4931, .adv_w = 232, .box_w = 15, .box_h = 19, .ofs_x = 0, .ofs_y = -7},
    {.bitmap_index = 5003, .adv_w = 233, .box_w = 15, .box_h = 26, .ofs_x = 0, .ofs_y = -10},
    {.bitmap_index = 5101, .adv_w = 216, .box_w = 14, .box_h = 19, .ofs_x = 0, .ofs_y = -7},
    {.bitmap_index = 5168, .adv_w = 238, .box_w = 15, .box_h = 29, .ofs_x = 0, .ofs_y = -13},
    {.bitmap_index = 5277, .adv_w = 224, .box_w = 14, .box_h = 19, .ofs_x = 0, .ofs_y = -7},
    {.bitmap_index = 5344, .adv_w = 169, .box_w = 11, .box_h = 23, .ofs_x = 0, .ofs_y = -7},
    {.bitmap_index = 5408, .adv_w = 236, .box_w = 15, .box_h = 23, .ofs_x = 0, .ofs_y = -11},
    {.bitmap_index = 5495, .adv_w = 239, .box_w = 15, .box_h = 22, .ofs_x = 0, .ofs_y = -6},
    {.bitmap_index = 5578, .adv_w = 104, .box_w = 7, .box_h = 23, .ofs_x = 0, .ofs_y = -7},
    {.bitmap_index = 5619, .adv_w = 134, .box_w = 9, .box_h = 31, .ofs_x = 0, .ofs_y = -14},
    {.bitmap_index = 5689, .adv_w = 207, .box_w = 13, .box_h = 26, .ofs_x = 0, .ofs_y = -10},
    {.bitmap_index = 5774, .adv_w = 95, .box_w = 6, .box_h = 23, .ofs_x = 0, .ofs_y = -7},
    {.bitmap_index = 5809, .adv_w = 361, .box_w = 23, .box_h = 24, .ofs_x = 0, .ofs_y = -11},
    {.bitmap_index = 5947, .adv_w = 232, .box_w = 15, .box_h = 20, .ofs_x = 0, .ofs_y = -8},
    {.bitmap_index = 6022, .adv_w = 239, .box_w = 15, .box_h = 21, .ofs_x = 0, .ofs_y = -9},
    {.bitmap_index = 6101, .adv_w = 244, .box_w = 15, .box_h = 23, .ofs_x = 0, .ofs_y = -10},
    {.bitmap_index = 6188, .adv_w = 239, .box_w = 15, .box_h = 21, .ofs_x = 0, .ofs_y = -9},
    {.bitmap_index = 6267, .adv_w = 172, .box_w = 11, .box_h = 22, .ofs_x = 0, .ofs_y = -9},
    {.bitmap_index = 6328, .adv_w = 214, .box_w = 14, .box_h = 22, .ofs_x = 0, .ofs_y = -10},
    {.bitmap_index = 6405, .adv_w = 177, .box_w = 11, .box_h = 23, .ofs_x = 0, .ofs_y = -7},
    {.bitmap_index = 6469, .adv_w = 239, .box_w = 15, .box_h = 20, .ofs_x = 0, .ofs_y = -8},
    {.bitmap_index = 6544, .adv_w = 205, .box_w = 13, .box_h = 21, .ofs_x = 0, .ofs_y = -9},
    {.bitmap_index = 6613, .adv_w = 320, .box_w = 20, .box_h = 23, .ofs_x = 0, .ofs_y = -10},
    {.bitmap_index = 6728, .adv_w = 182, .box_w = 12, .box_h = 21, .ofs_x = 0, .ofs_y = -9},
    {.bitmap_index = 6791, .adv_w = 200, .box_w = 13, .box_h = 27, .ofs_x = 0, .ofs_y = -15},
    {.bitmap_index = 6879, .adv_w = 216, .box_w = 14, .box_h = 22, .ofs_x = 0, .ofs_y = -10},
    {.bitmap_index = 6956, .adv_w = 151, .box_w = 10, .box_h = 29, .ofs_x = 0, .ofs_y = -13},
    {.bitmap_index = 7029, .adv_w = 73, .box_w = 5, .box_h = 29, .ofs_x = 0, .ofs_y = -11},
    {.bitmap_index = 7066, .adv_w = 156, .box_w = 10, .box_h = 28, .ofs_x = 0, .ofs_y = -11},
    {.bitmap_index = 7136, .adv_w = 264, .box_w = 17, .box_h = 11, .ofs_x = 0, .ofs_y = -2},
    {.bitmap_index = 7183, .adv_w = 395, .box_w = 25, .box_h = 27, .ofs_x = 0, .ofs_y = -11},
    {.bitmap_index = 7352, .adv_w = 358, .box_w = 23, .box_h = 21, .ofs_x = 0, .ofs_y = -8}
};
/*---------------------
 *  CHARACTER MAPPING
 *--------------------*/
static const uint16_t creepy_24_unicode_list_2[] = {
    0x0, 0x20
};
/*Collect the unicode lists and glyph_id offsets*/
static const lv_font_fmt_txt_cmap_t creepy_24_cmaps[] =
{
    {
        .range_start = 32, .range_length = 64, .glyph_id_start = 1,
        .unicode_list = NULL, .glyph_id_ofs_list = NULL, .list_length = 0, .type = LV_FONT_FMT_TXT_CMAP_FORMAT0_TINY
    },
    {
        .range_start = 97, .range_length = 30, .glyph_id_start = 65,
        .unicode_list = NULL, .glyph_id_ofs_list = NULL, .list_length = 0, .type = LV_FONT_FMT_TXT_CMAP_FORMAT0_TINY
    },
    {
        .range_start = 198, .range_length = 33, .glyph_id_start = 95,
        .unicode_list = creepy_24_unicode_list_2, .glyph_id_ofs_list = NULL, .list_length = 2, .type = LV_FONT_FMT_TXT_CMAP_SPARSE_TINY
    }
};
/*-----------------
 *    KERNING
 *----------------*/
/*Pair left and right glyphs for kerning*/
static const uint8_t creepy_24_kern_pair_glyph_ids[] =
{
    2, 4,
    2, 12,
    2, 14,
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    96, 96
};
/* Kerning between the respective left and right glyphs
 * 4.4 format which needs to scaled with `kern_scale`*/
static const int8_t creepy_24_kern_pair_values[] =
{
    -13, -12, -13, -11, -12, -5, -5, -8,
    -5, -11, -35, -10, -18, -8, -13, -28,
    -17, -12, -21, -17, -23, -17, -47, -11,
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    -12, -29, -18, -10
};
/*Collect the kern pair's data in one place*/
static const lv_font_fmt_txt_kern_pair_t creepy_24_kern_pairs =
{
    .glyph_ids = creepy_24_kern_pair_glyph_ids,
    .values = creepy_24_kern_pair_values,
    .pair_cnt = 2732,
    .glyph_ids_size = 0
};
/*--------------------
 *  ALL CUSTOM DATA
 *--------------------*/
/*Store all the custom data of the font*/
static lv_font_fmt_txt_glyph_cache_t creepy_24_cache;
static const lv_font_fmt_txt_dsc_t creepy_24_font_dsc = {
    .glyph_bitmap = creepy_24_glyph_bitmap,
    .glyph_dsc = creepy_24_glyph_dsc,
    .cmaps = creepy_24_cmaps,
    .kern_dsc = &creepy_24_kern_pairs,
    .kern_scale = 16,
    .cmap_num = 3,
    .bpp = 2,
    .kern_classes = 0,
    .bitmap_format = 0,
    .cache = &creepy_24_cache
};
/*-----------------
 *  PUBLIC FONT
 *----------------*/
/*Initialize a public general font descriptor*/
const lv_font_t creepy_24 = {
    .get_glyph_dsc = lv_font_get_glyph_dsc_fmt_txt,    /*Function pointer to get glyph's data*/
    .get_glyph_bitmap = lv_font_get_bitmap_fmt_txt,    /*Function pointer to get glyph's bitmap*/
    .line_height = 35,          /*The maximum line height required by the font*/
    .base_line = 17,             /*Baseline measured from the bottom of the line*/

    .subpx = LV_FONT_SUBPX_NONE,
    .underline_position = -1,
    .underline_thickness = 1,
    .dsc = &creepy_24_font_dsc,          /*The custom font data. Will be accessed by `get_glyph_bitmap/dsc` */
};
#endif

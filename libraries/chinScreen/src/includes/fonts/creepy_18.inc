/*******************************************************************************
 * Size: 18 px
 * Bpp: 2
 ******************************************************************************/


#ifdef __has_include

    #if __has_include("lvgl.h")
         #ifndef LV_LVGL_H_INCLUDE_SIMPLE
             #define LV_LVGL_H_INCLUDE_SIMPLE
         #endif
     #endif
 #endif

 #ifdef LV_LVGL_H_INCLUDE_SIMPLE
     #include "lvgl.h"
 #else
     #include "../lvgl-8.3.11/lvgl.h"
 #endif

 #ifndef CREEPY_18
 #define CREEPY_18 1
 #endif

 #if CREEPY_18

/*-----------------
 *    BITMAPS
 *----------------*/
/*Store the image of the glyphs*/
static LV_ATTRIBUTE_LARGE_CONST const uint8_t creepy_18_glyph_bitmap[] = {
    /* U+0020 " " */
    /* U+0021 "!" */
    0x6e, 0x3f, 0xcb, 0xf0, 0xfc, 0x3e, 0x1f, 0xc7,
    0xe0, 0x74, 0x1, 0xf, 0x87, 0xf1, 0xf5, 0x10,
    0x4, 0x2, 0x0,
    /* U+0022 "\"" */
    0x34, 0xd1, 0xf7, 0xcb, 0xef, 0x2f, 0xbc, 0x34,
    0x90, 0x80, 0x41, 0x1, 0x4, 0x0, 0x0, 0x0,
    /* U+0023 "#" */
    0x0, 0x1c, 0x1c, 0x0, 0x1f, 0xb, 0x40, 0xb,
    0x82, 0xc0, 0x3f, 0xff, 0xfe, 0xf, 0xff, 0xff,
    0x81, 0xfd, 0xbe, 0x10, 0x7e, 0x7e, 0x5, 0xff,
    0xff, 0xf2, 0xbf, 0xff, 0xfc, 0x1b, 0xc3, 0xe1,
    0x1, 0xf0, 0xf0, 0x0, 0x94, 0x38, 0x0, 0x21,
    0x4, 0x0, 0x8, 0x1, 0x0, 0x0, 0x0, 0x40,
    0x40, 0x40, 0x10, 0x0, 0x0, 0x4, 0x0, 0x0,
    /* U+0024 "$" */
    0x0, 0x0, 0x0, 0x0, 0x7c, 0x0, 0x7, 0xff,
    0xd0, 0x3f, 0xff, 0xf0, 0xbe, 0x2a, 0xb0, 0x7f,
    0x74, 0x40, 0x2f, 0xf8, 0x40, 0xf, 0xff, 0x80,
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    0x0,
    /* U+0025 "%" */
    0x7, 0xf4, 0x0, 0x80, 0x2, 0xff, 0xc0, 0x38,
    0x0, 0xbd, 0x9f, 0xb, 0x40, 0xb, 0xc4, 0xf0,
    0xc4, 0x0, 0x3e, 0xaf, 0x2c, 0x40, 0x2, 0xff,
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    0x0, 0x0, 0x0, 0x0, 0x0,
    /* U+0026 "&" */
    0x0, 0xfc, 0x0, 0x1, 0xff, 0xf4, 0x1, 0xfe,
    0xff, 0x0, 0xbf, 0x17, 0xd0, 0x1b, 0xff, 0xe4,
    0x2, 0xff, 0xe0, 0x2, 0xff, 0xf8, 0x72, 0xff,
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    0x0, 0x0, 0x0,
    /* U+0027 "'" */
    0x20, 0x7c, 0xbc, 0xbc, 0x4, 0x4, 0x0, 0x0,
    /* U+0028 "(" */
    0xa, 0x40, 0xfc, 0xf, 0xc3, 0xf8, 0x3f, 0x47,
    0xf0, 0xbe, 0x7, 0xf0, 0xbf, 0xb, 0xf4, 0xbf,
    0x7, 0xe0, 0x7f, 0x2, 0xf4, 0x1f, 0xc0, 0x98,
    0x4, 0x80, 0x8, 0x0, 0x40, 0x4,
    /* U+0029 ")" */
    0x78, 0x2f, 0x3, 0xe0, 0xbc, 0x2f, 0x4f, 0xe2,
    0xf8, 0xff, 0x3f, 0x8f, 0xf3, 0xfc, 0xfd, 0x3f,
    0x8f, 0xeb, 0xd4, 0xe0, 0x10, 0x0, 0x10,
    /* U+002A "*" */
    0x3, 0x80, 0xb, 0xc0, 0x7f, 0xfc, 0xaf, 0xf8,
    0x2f, 0xd4, 0x2e, 0xf0, 0x14, 0x20, 0x0, 0x10,
    0x4, 0x10, 0x0, 0x10, 0x0, 0x10,
    /* U+002B "+" */
    0x0, 0x70, 0x0, 0x3, 0xe0, 0x0, 0xf, 0xc0,
    0x5, 0x7f, 0x0, 0x7f, 0xff, 0xe2, 0xbf, 0xfe,
    0xa4, 0x4f, 0xc0, 0x1, 0x3d, 0x4, 0x4, 0xf8,
    0x10, 0x3, 0xd0, 0x0, 0x41, 0x0, 0x0, 0x4,
    0x0, 0x0, 0x10, 0x0, 0x0, 0x40, 0x0, 0x0,
    0x0, 0x0,
    /* U+002C "," */
    0x7e, 0x2f, 0xc2, 0xf8, 0x39, 0x7d, 0x5c, 0x41,
    0x10, 0x44, 0x10, 0x0, 0x0,
    /* U+002D "-" */
    0x1, 0x40, 0xff, 0xeb, 0xff, 0xea, 0xba, 0x40,
    0x44, 0x1, 0x0, 0x4, 0x0, 0x0, 0x0, 0x0,
    /* U+002E "." */
    0x0, 0xb, 0xb, 0xf2, 0xfc, 0x4, 0x0, 0x0,
    0x0,
    /* U+002F "/" */
    0x0, 0xb0, 0x3, 0x80, 0x1d, 0x0, 0xe4, 0x3,
    0x0, 0x2d, 0x0, 0xa0, 0x3, 0x80, 0x2e, 0x0,
    0xd4, 0x3, 0x10, 0xc, 0x40, 0xb1, 0x2, 0x40,
    0x4, 0x0, 0x0, 0x0,
    /* U+0030 "0" */
    0x0, 0xa0, 0x0, 0x6, 0xff, 0xd0, 0x1f, 0xff,
    0xe0, 0x2f, 0xb7, 0xf4, 0x3f, 0x12, 0xfc, 0x3f,
    0x52, 0xfd, 0xbf, 0x51, 0xfd, 0xff, 0x41, 0xfd,
    0xbf, 0x0, 0xfd, 0x7f, 0x12, 0xfd, 0x2f, 0xfb,
    0xfc, 0xb, 0xff, 0xe4, 0x3, 0xbd, 0x4, 0x2,
    0x14, 0x4, 0x2, 0x0, 0x0, 0x1, 0x0, 0x0,
    0x0, 0x0, 0x0, 0x0, 0x0, 0x0,
    /* U+0031 "1" */
    0x0, 0xb0, 0x1, 0xf4, 0xb, 0xfc, 0xbf, 0xf8,
    0xbf, 0xfc, 0x4b, 0xfc, 0x47, 0xfc, 0x3, 0xfc,
    0x3, 0xfc, 0x3, 0xfc, 0x7, 0xf8, 0x5, 0xf8,
    0x4, 0x88, 0x4, 0x40, 0x0, 0x40, 0x0, 0x0,
    /* U+0032 "2" */
    0x3, 0xff, 0x80, 0x3f, 0xff, 0xc3, 0xfa, 0xbf,
    0x6f, 0x80, 0xbf, 0x4c, 0x3, 0xf4, 0x0, 0x3f,
    0x90, 0x7, 0xf5, 0x80, 0xbe, 0x2, 0xf, 0xf0,
    0x8, 0xbf, 0xe6, 0xdf, 0xff, 0xff, 0x97, 0xff,
    0xfd, 0x48, 0x42, 0x6, 0x10, 0x4, 0x10, 0x40,
    0x10, 0x41, 0x0, 0x41, 0x4, 0x0, 0x0, 0x0,
    0x0, 0x0,
    /* U+0033 "3" */
    0x9, 0xb8, 0x0, 0x7f, 0xff, 0x4b, 0xff, 0xfe,
    0x2b, 0x43, 0xf8, 0x45, 0xf, 0xe0, 0x12, 0xff,
    0x4, 0x8, 0xfe, 0xd, 0x1, 0xfd, 0x7d, 0xb,
    0xf1, 0xff, 0xff, 0xc3, 0xff, 0xfe, 0x3, 0xff,
    0x84, 0x4, 0x48, 0x10, 0x10, 0x10, 0x40, 0x40,
    0x40, 0x0, 0x1, 0x0,
    /* U+0034 "4" */
    0x0, 0x6, 0xc0, 0x0, 0x2f, 0xe0, 0x0, 0xbf,
    0xf0, 0x2, 0xff, 0xe0, 0x7, 0xff, 0xe0, 0x3f,
    0x1b, 0xf0, 0x3f, 0x6f, 0xf4, 0xbf, 0xff, 0xfd,
    0x7f, 0xff, 0xfe, 0x8, 0x3f, 0xf1, 0x4, 0xf,
    0xf1, 0x4, 0x7, 0xe1, 0x4, 0x4, 0x10, 0x0,
    0x4, 0x10, 0x0, 0x4, 0x0, 0x0, 0x4, 0x0,
    0x0, 0x4, 0x0,
    /* U+0035 "5" */
    0x6, 0xba, 0x80, 0xbf, 0xff, 0x2, 0xff, 0xfc,
    0xf, 0xc0, 0x10, 0x7f, 0x0, 0x40, 0xfc, 0x14,
    0x3, 0xff, 0xfd, 0x4, 0x43, 0xfc, 0x0, 0x3,
    0xf0, 0xf0, 0x1f, 0xcb, 0xff, 0xff, 0x1b, 0xff,
    0xf0, 0x55, 0xbc, 0x41, 0x10, 0x11, 0x0, 0x40,
    0x44, 0x0, 0x1, 0x10, 0x0, 0x4, 0x0, 0x0,
    0x20, 0x0,
    /* U+0036 "6" */
    0x0, 0x79, 0x0, 0x7, 0xff, 0xd0, 0x1f, 0xfb,
    0xf0, 0x2f, 0x40, 0x50, 0x3f, 0x80, 0x0, 0x7f,
    0xff, 0xd0, 0xbf, 0xef, 0xf4, 0xbf, 0xc2, 0xf8,
    0x7f, 0x41, 0xfd, 0x3f, 0xc7, 0xfd, 0x2f, 0xff,
    0xf1, 0x13, 0xff, 0xf1, 0x11, 0x38, 0x20, 0x10,
    0x10, 0x10, 0x0, 0x10, 0x10, 0x0, 0x10, 0x10,
    0x0, 0x0, 0x0,
    /* U+0037 "7" */
    0x3b, 0xee, 0x92, 0xff, 0xff, 0xea, 0xbf, 0xff,
    0xd0, 0x47, 0xf8, 0x40, 0xf, 0xd1, 0x0, 0x7d,
    0x44, 0xf, 0xe0, 0x0, 0x7f, 0x0, 0x3, 0xfc,
    0x0, 0xf, 0xf0, 0x0, 0x3f, 0xc0, 0x1, 0x78,
    0x0, 0x0, 0x40, 0x0, 0x1, 0x0, 0x0, 0x4,
    0x0, 0x0, 0x10, 0x0,
    /* U+0038 "8" */
    0x1, 0xfd, 0x40, 0xb, 0xff, 0xd0, 0x1f, 0xff,
    0xf0, 0x7f, 0x87, 0xf8, 0x7f, 0x1, 0xfc, 0x5f,
    0x87, 0xe4, 0x1f, 0xff, 0xe0, 0x3f, 0x96, 0xf4,
    0xbf, 0x6, 0xfc, 0xff, 0x42, 0xfc, 0x7f, 0x8b,
    0xfc, 0x6f, 0xff, 0xf4, 0x47, 0xff, 0x84, 0x3,
    0x20, 0x4, 0x2, 0x10, 0x0, 0x2, 0x0, 0x0,
    0x1, 0x20, 0x0, 0x1, 0x0, 0x0,
    /* U+0039 "9" */
    0x0, 0x2d, 0x0, 0xf, 0xff, 0xc0, 0x3f, 0xff,
    0xf8, 0x3f, 0x91, 0xfc, 0x7f, 0x11, 0xfc, 0x7f,
    0xd3, 0xfd, 0x5f, 0xff, 0xfd, 0x41, 0xff, 0xfd,
    0x40, 0x41, 0xfd, 0x4a, 0x3, 0xf8, 0xf, 0xff,
    0xe1, 0xf, 0xfe, 0xc1, 0x6, 0x0, 0x40, 0x45,
    0x0, 0x40, 0x5, 0x0, 0x40, 0x4, 0x0, 0x0,
    /* U+003A ":" */
    0x2c, 0x7e, 0xbf, 0x8, 0x4, 0x0, 0xbe, 0xbf,
    0x6c, 0x44, 0x4, 0x44, 0x4,
    /* U+003B ";" */
    0x9, 0x1f, 0xdb, 0xf6, 0x30, 0x44, 0x0, 0x2,
    0xe1, 0xfc, 0x2f, 0xc3, 0xd1, 0xf0, 0xd4, 0x11,
    0x0, 0x40,
    /* U+003C "<" */
    0x0, 0x0, 0x0, 0x0, 0x2, 0xd0, 0x0, 0xbf,
    0x80, 0x7f, 0xf1, 0x1b, 0xf4, 0x7, 0xfe, 0x0,
    0x23, 0xf9, 0x0, 0xa, 0xff, 0x40, 0x10, 0xbf,
    0xf4, 0x0, 0x4f, 0xd0, 0x1, 0x11, 0x40, 0x4,
    0x0, 0x10, 0x10, 0x4, 0x0, 0x0, 0x0, 0x0,
    0x0, 0x0,
    /* U+003D "=" */
    0x1d, 0x28, 0xd8, 0x3f, 0xff, 0xfc, 0x2e, 0xbe,
    0xf0, 0x4, 0x4, 0x0, 0x6e, 0xff, 0xa8, 0xbf,
    0xff, 0xfc, 0x45, 0x5, 0x30, 0x4, 0x0, 0x10,
    0x4, 0x0, 0x10, 0x5, 0x0, 0x10, 0x0, 0x0,
    0x10, 0x0, 0x0, 0x20,
    /* U+003E ">" */
    0xbf, 0x0, 0x1, 0xaf, 0xe0, 0x4, 0x2f, 0xf9,
    0x10, 0x6, 0xfe, 0x0, 0x1b, 0xfc, 0x1, 0xff,
    0x50, 0xbf, 0xc4, 0x6f, 0xf1, 0x10, 0xb0, 0x44,
    0x40, 0x40, 0x11, 0x1, 0x0, 0x4, 0x4, 0x0,
    0x10, 0x0, 0x0, 0x0,
    /* U+003F "?" */
    0x6, 0xf9, 0x0, 0xbf, 0xfe, 0xb, 0xfb, 0xfd,
    0x2f, 0x3, 0xfc, 0x40, 0x1f, 0xd1, 0x3, 0xfe,
    0x48, 0x1f, 0x51, 0x10, 0x30, 0x48, 0x0, 0x0,
    0x0, 0xf, 0xc0, 0x0, 0x3f, 0x40, 0x0, 0xfd,
    0x0, 0x1, 0x14, 0x0, 0x4, 0x10, 0x0, 0x10,
    0x40, 0x0, 0x1, 0x0, 0x0, 0x4, 0x0, 0x0,
    0x0, 0x0,
    /* U+0040 "@" */
    0x0, 0x1f, 0xfe, 0x0, 0x0, 0xf, 0xf5, 0xb9,
    0x0, 0x2f, 0x48, 0xb, 0xd0, 0x2f, 0x1, 0x1,
    0x3c, 0x1d, 0x80, 0x40, 0x43, 0x8f, 0x12, 0xff,
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    0x0, 0x0, 0x4, 0x0, 0x0,
    /* U+0041 "A" */
    0x0, 0x0, 0x0, 0x0, 0x2f, 0xd0, 0x0, 0xf,
    0xfc, 0x0, 0xb, 0xff, 0x0, 0x7, 0xff, 0xc0,
    0x2, 0xff, 0xfc, 0x0, 0xbf, 0x7f, 0x0, 0x3e,
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    0x0, 0x0, 0x0,
    /* U+0042 "B" */
    0x2f, 0xff, 0xd0, 0x7f, 0xff, 0xfc, 0xbf, 0xff,
    0xfc, 0xbf, 0x81, 0xfc, 0xbf, 0x2, 0xf8, 0xff,
    0xff, 0xf4, 0xbf, 0xff, 0xfc, 0x7f, 0x88, 0xfe,
    0xff, 0x44, 0xfe, 0x7f, 0x43, 0xff, 0x7f, 0xff,
    0xfe, 0x7b, 0xef, 0xb5, 0x20, 0x85, 0x21, 0x0,
    0x40, 0x10, 0x0, 0x40, 0x10, 0x0, 0x40, 0x10,
    0x0, 0x40, 0x0, 0x0, 0x40, 0x1,
    /* U+0043 "C" */
    0x0, 0xff, 0xd0, 0x2, 0xff, 0xff, 0x82, 0xff,
    0xbf, 0xf0, 0xff, 0x3, 0xfe, 0x3f, 0x80, 0x59,
    0x6f, 0xc0, 0x0, 0xb, 0xf4, 0x4, 0x1, 0xfe,
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    0x4, 0x0, 0x0,
    /* U+0044 "D" */
    0x3, 0x5f, 0x0, 0xb, 0xff, 0xf4, 0x7, 0xff,
    0xff, 0xc2, 0xff, 0xcf, 0xfc, 0xbf, 0x11, 0xff,
    0x2f, 0xe4, 0x6f, 0xdb, 0xf8, 0x2b, 0xf6, 0xfd,
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    0x10, 0x0, 0x0,
    /* U+0045 "E" */
    0x1f, 0xff, 0xf6, 0xff, 0xff, 0xdb, 0xfe, 0xa5,
    0x1f, 0xe0, 0x0, 0xbf, 0xd0, 0x12, 0xff, 0xff,
    0xc7, 0xff, 0xfe, 0x1f, 0xc0, 0x40, 0x7f, 0x40,
    0x2, 0xff, 0xff, 0x87, 0xff, 0xff, 0x89, 0x7d,
    0xb5, 0x10, 0x51, 0x4, 0x0, 0x4, 0x0, 0x0,
    0x0, 0x0, 0x10, 0x0, 0x0, 0x0, 0x0, 0x0,
    0x4, 0x0,
    /* U+0046 "F" */
    0x1b, 0xde, 0x47, 0xff, 0xfe, 0xbf, 0xff, 0xdb,
    0xf4, 0x20, 0xbf, 0x1, 0xb, 0xff, 0xf0, 0xbf,
    0xff, 0x87, 0xff, 0xa4, 0x7f, 0x20, 0xb, 0xf4,
    0x0, 0x7f, 0x41, 0x3, 0xe4, 0x10, 0x14, 0x0,
    0x0, 0x40, 0x0, 0x4, 0x0, 0x0, 0x40, 0x0,
    0x4, 0x0, 0x0,
    /* U+0047 "G" */
    0x3, 0x6f, 0xe0, 0x0, 0x7f, 0xff, 0xc0, 0x2f,
    0xff, 0xfe, 0x3, 0xfd, 0x41, 0xf0, 0x7f, 0x84,
    0x4, 0xf, 0xf4, 0x40, 0x0, 0xbf, 0x6, 0xfe,
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    0x0, 0x10, 0x0, 0x0, 0x1, 0x0, 0x0,
    /* U+0048 "H" */
    0x3f, 0x0, 0x3e, 0x1f, 0xd0, 0x1f, 0xcb, 0xf4,
    0xf, 0xfa, 0xfd, 0x2, 0xfe, 0xff, 0xff, 0xff,
    0x6f, 0xff, 0xff, 0xdf, 0xff, 0xff, 0xfa, 0xff,
    0x47, 0xfd, 0x7f, 0x50, 0xff, 0xbf, 0xc0, 0x1f,
    0xeb, 0xf4, 0x7, 0xf0, 0xf9, 0x1, 0xfc, 0x14,
    0x40, 0x48, 0x0, 0x0, 0x2, 0x0, 0x0, 0x0,
    0x80, 0x40, 0x0, 0x10, 0x0, 0x0, 0x4, 0x0,
    /* U+0049 "I" */
    0x2e, 0x1f, 0xe7, 0xf8, 0xff, 0x7f, 0x9f, 0xe7,
    0xfe, 0xfe, 0xbf, 0xef, 0xf7, 0xfc, 0xbd, 0x9,
    0x1, 0x0, 0x40, 0x20, 0x8, 0x0, 0x0,
    /* U+004A "J" */
    0x0, 0x3, 0xc0, 0x0, 0x2f, 0xc0, 0x0, 0xff,
    0x0, 0x3, 0xfc, 0x0, 0xb, 0xf0, 0x0, 0x7f,
    0xc0, 0x1, 0xbf, 0x6, 0x7, 0xfd, 0x7f, 0xf,
    0xf6, 0xfd, 0x3f, 0xcf, 0xff, 0xff, 0x1b, 0xff,
    0xe4, 0x3, 0xba, 0x20, 0x0, 0x84, 0x0, 0x1,
    0x10, 0x0, 0x4, 0x40, 0x0, 0x11, 0x0, 0x0,
    0x0, 0x0, 0x0, 0x0, 0x0,
    /* U+004B "K" */
    0x2f, 0x0, 0xb8, 0x7f, 0x3, 0xf4, 0x7f, 0xdb,
    0xf0, 0xbf, 0xff, 0xf0, 0xbf, 0xff, 0x60, 0x7f,
    0xff, 0xa0, 0xbf, 0xff, 0xe0, 0x7f, 0xff, 0xf0,
    0x7f, 0x8f, 0xf8, 0x7f, 0x43, 0xfe, 0x7f, 0x82,
    0xff, 0x7f, 0x40, 0xbe, 0x49, 0x0, 0x28, 0x45,
    0x0, 0x10, 0x41, 0x0, 0x10, 0x41, 0x0, 0x10,
    0x4, 0x0, 0x10, 0x0, 0x0, 0x10,
    /* U+004C "L" */
    0x2f, 0x0, 0x1, 0xfc, 0x0, 0xb, 0xfc, 0x0,
    0x2f, 0xf0, 0x0, 0x7f, 0x80, 0x1, 0xfe, 0x0,
    0x7, 0xf4, 0x0, 0x1f, 0xd0, 0x0, 0x7f, 0x40,
    0x1, 0xff, 0xd5, 0xb, 0xff, 0xfe, 0x2f, 0xff,
    0xf8, 0x87, 0x2b, 0x1, 0x4, 0x4, 0x8, 0x10,
    0x10, 0x20, 0x40, 0x40, 0x1, 0x0, 0x0, 0x4,
    0x4, 0x0,
    /* U+004D "M" */
    0x0, 0x0, 0x0, 0x0, 0x3f, 0x80, 0x1f, 0xf0,
    0xbf, 0xe0, 0x1f, 0xf8, 0xbf, 0xf0, 0x3f, 0xf8,
    0xff, 0xf0, 0x7f, 0xf8, 0x7f, 0xf4, 0x7f, 0xf8,
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    0x0, 0x0, 0x0, 0x0,
    /* U+004E "N" */
    0x3d, 0x0, 0x3d, 0x2f, 0xf0, 0x1f, 0xc7, 0xfc,
    0x7, 0xf6, 0xff, 0xc2, 0xfc, 0xff, 0xf8, 0xbf,
    0x1f, 0xff, 0x7f, 0xdb, 0xff, 0xff, 0xf5, 0xfd,
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    0x0, 0x0, 0x0,
    /* U+004F "O" */
    0x0, 0x2f, 0x40, 0x0, 0xf, 0xff, 0xf4, 0x0,
    0xbf, 0xff, 0xf0, 0x3, 0xff, 0x7b, 0xf0, 0x1f,
    0xc0, 0x4f, 0xe1, 0xff, 0x1, 0x2f, 0x8b, 0xfc,
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    0x0, 0x0, 0x0, 0x0,
    /* U+0050 "P" */
    0x0, 0x0, 0x0, 0x3, 0xff, 0x40, 0x7, 0xff,
    0xff, 0x1, 0xff, 0xef, 0xf4, 0xbf, 0x91, 0xff,
    0x1f, 0xc0, 0x2f, 0xcb, 0xfc, 0x2f, 0xe2, 0xff,
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    0x0, 0x0, 0x0, 0x0, 0x0, 0x0,
    /* U+0051 "Q" */
    0x1, 0xbf, 0xe4, 0x0, 0x7f, 0xff, 0xc0, 0x1f,
    0xff, 0xff, 0x47, 0xf8, 0x2b, 0xfc, 0xbf, 0x41,
    0x2f, 0xdb, 0xf8, 0x12, 0xfd, 0xbf, 0x40, 0x2f,
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    0x80, 0x0, 0x0, 0x0, 0x0,
    /* U+0052 "R" */
    0x7, 0xe3, 0x40, 0xf, 0xff, 0xfd, 0x7, 0xff,
    0xff, 0xe1, 0xff, 0x87, 0xfc, 0xbf, 0x80, 0xfe,
    0x2f, 0xf0, 0x7f, 0x4b, 0xff, 0xff, 0xc0, 0xff,
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    0x0, 0x0, 0x0,
    /* U+0053 "S" */
    0x1, 0xff, 0x80, 0x1f, 0xff, 0xe0, 0x3f, 0xeb,
    0xfc, 0xbf, 0x40, 0xac, 0xbf, 0xd0, 0x44, 0x5f,
    0xff, 0xe0, 0x49, 0xbf, 0xf8, 0x0, 0x2f, 0xfc,
    0x28, 0x13, 0xfc, 0x7f, 0xaf, 0xfc, 0x6f, 0xff,
    0xf4, 0x2, 0xff, 0x60, 0x10, 0x41, 0x10, 0x10,
    0x1, 0x10, 0x10, 0x1, 0x0, 0x0, 0x1, 0x0,
    0x0, 0x0, 0x0,
    /* U+0054 "T" */
    0x7f, 0xff, 0xfd, 0x2f, 0xff, 0xff, 0xca, 0xbf,
    0xff, 0xd0, 0x43, 0xfc, 0x10, 0x10, 0xbf, 0x4,
    0x4, 0x3f, 0xc2, 0x1, 0xf, 0xf0, 0x40, 0x42,
    0xfc, 0x0, 0x0, 0xff, 0x0, 0x0, 0x7f, 0xc1,
    0x0, 0xb, 0xf0, 0x0, 0x1, 0xf8, 0x0, 0x0,
    0x14, 0x0, 0x0, 0x1, 0x0, 0x0, 0x0, 0x40,
    0x0, 0x0, 0x10, 0x0,
    /* U+0055 "U" */
    0x7f, 0x0, 0x78, 0x1f, 0xd0, 0x3f, 0xc7, 0xf4,
    0xb, 0xf2, 0xfc, 0x3, 0xfc, 0xbf, 0x0, 0xff,
    0x3f, 0xd0, 0x3f, 0xc7, 0xf0, 0x1f, 0xf1, 0xfc,
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    0x1, 0x0, 0x0, 0x0, 0x0, 0x0,
    /* U+0056 "V" */
    0x7e, 0x0, 0x78, 0x7f, 0x1, 0xfc, 0xbf, 0x2,
    0xfc, 0xbf, 0x42, 0xf8, 0x6f, 0x43, 0xf8, 0x2f,
    0xcb, 0xf8, 0x2f, 0xff, 0xe4, 0x1b, 0xff, 0xc0,
    0x13, 0xff, 0xc0, 0x3, 0xff, 0xc0, 0x3, 0xff,
    0x80, 0x2, 0xfe, 0x40, 0x0, 0x8, 0x0, 0x0,
    0x4, 0x0, 0x0, 0x4, 0x0, 0x0, 0x4, 0x40,
    /* U+0057 "W" */
    0x1c, 0x0, 0x0, 0x1c, 0x3f, 0x40, 0xfc, 0xf,
    0xcb, 0xe0, 0xff, 0x4b, 0xf2, 0xfc, 0x3f, 0xc1,
    0xfc, 0x7f, 0xf, 0xf4, 0xbe, 0xf, 0xd7, 0xff,
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    0x0,
    /* U+0058 "X" */
    0x3f, 0x0, 0xb0, 0xfd, 0x1f, 0xc2, 0xff, 0xff,
    0x4b, 0xff, 0xf5, 0x1b, 0xff, 0x80, 0x4b, 0xfd,
    0x0, 0x3f, 0xf0, 0x1, 0xff, 0xd0, 0xf, 0xff,
    0xc0, 0xff, 0xff, 0x8b, 0xf8, 0xbf, 0x6f, 0xc0,
    0x7d, 0x42, 0x0, 0x21, 0x8, 0x0, 0x40, 0x10,
    0x1, 0x0, 0x40, 0x4, 0x1, 0x0, 0x0, 0x8,
    0x0, 0x0,
    /* U+0059 "Y" */
    0x1d, 0x0, 0x74, 0xff, 0x3, 0xfc, 0x7f, 0xc3,
    0xfc, 0x2f, 0xff, 0xf4, 0xb, 0xff, 0xd4, 0xb,
    0xff, 0x44, 0xa, 0xff, 0x4, 0x5, 0xff, 0x0,
    0x6, 0xfe, 0x0, 0x2, 0xff, 0x0, 0x2, 0xff,
    0x0, 0x1, 0xfe, 0x0, 0x1, 0x75, 0x0, 0x0,
    0x11, 0x0, 0x0, 0x10, 0x0, 0x0, 0x10, 0x0,
    0x0, 0x10, 0x0, 0x0, 0x0, 0x0,
    /* U+005A "Z" */
    0x0, 0x0, 0x0, 0x2f, 0xff, 0xfc, 0xbf, 0xff,
    0xff, 0xf, 0xff, 0xfe, 0x4, 0xf, 0xf1, 0x4,
    0x2f, 0xe0, 0x4, 0xbf, 0xc1, 0x2, 0xfe, 0x0,
    0x7, 0xf5, 0x0, 0x2f, 0xf1, 0x0, 0x3f, 0xff,
    0xec, 0xbf, 0xff, 0xfe, 0x1f, 0xff, 0xfd, 0x8,
    0x2, 0x20, 0x8, 0x1, 0x10, 0x8, 0x1, 0x10,
    0x4, 0x1, 0x0, 0x4, 0x1, 0x0,
    /* U+005B "[" */
    0x1f, 0xc1, 0xff, 0xc7, 0xfa, 0x6f, 0xc0, 0x3f,
    0x0, 0xfc, 0xb, 0xf0, 0x2f, 0xd0, 0x3f, 0x41,
    0xfc, 0x7, 0xf0, 0xf, 0xc0, 0x7f, 0x1, 0xff,
    0x83, 0xff, 0x51, 0xd8, 0x0, 0x10, 0x0, 0x40,
    /* U+005C "\\" */
    0x60, 0x1, 0xc0, 0x3, 0x40, 0xd, 0x0, 0x1c,
    0x0, 0x70, 0x1, 0xa0, 0x4, 0xc0, 0x13, 0x80,
    0x4f, 0x0, 0xc, 0x0, 0x34, 0x0, 0xb0, 0x1,
    0x80, 0x1, 0x0, 0x4, 0x0, 0x10, 0x0, 0x0,
    /* U+005D "]" */
    0x6e, 0x4b, 0xfe, 0x6f, 0xe4, 0xbe, 0x47, 0xe4,
    0xfd, 0xf, 0xf0, 0xbe, 0xb, 0xd0, 0xff, 0xf,
    0xf0, 0xbd, 0xf, 0xe7, 0xff, 0xbf, 0x90, 0x21,
    0x1, 0x10, 0x10, 0x1, 0x0, 0x10, 0x1, 0x0,
    0x10, 0x1, 0x0, 0x10, 0x0, 0x0,
    /* U+005E "^" */
    0x6, 0xf4, 0x7, 0xff, 0x2, 0xeb, 0xf2, 0xe1,
    0x3e, 0x80, 0x44, 0x90, 0x11, 0x14, 0x4, 0x44,
    0x1, 0x1, 0x0, 0x40, 0x40, 0x20, 0x10, 0x0,
    0x0, 0x0, 0x0, 0x0, 0x0, 0x0,
    /* U+005F "_" */
    0x38, 0x1d, 0xb, 0xff, 0xfd, 0x72, 0xe3, 0x11,
    0x10, 0x10, 0x10, 0x1, 0x1, 0x0, 0x0, 0x10,
    0x0, 0x0,
    /* U+0061 "a" */
    0x2, 0xfe, 0xc0, 0x7f, 0xff, 0x82, 0xf6, 0xbf,
    0x40, 0x40, 0xfe, 0x6, 0xff, 0xf9, 0xff, 0xbf,
    0xdf, 0xf4, 0x7f, 0x6f, 0xd7, 0xfd, 0x7f, 0xfb,
    0xf9, 0x2d, 0x81, 0x14, 0x21, 0x0, 0x40, 0x44,
    0x1, 0x1, 0x10, 0x4, 0x4, 0x0, 0x0, 0x10,
    0x0, 0x0,
    /* U+0062 "b" */
    0x1c, 0x0, 0x2, 0xf8, 0x0, 0xf, 0xf0, 0x0,
    0x1f, 0xff, 0xf0, 0x7f, 0xff, 0xe1, 0xff, 0xff,
    0xdb, 0xf2, 0x3f, 0xbf, 0x84, 0xbe, 0xff, 0x3,
    0xf9, 0xff, 0xaf, 0xeb, 0xff, 0xff, 0x7, 0xab,
    0xd8, 0x4, 0x0, 0x10, 0x4, 0x0, 0x80, 0x10,
    0x2, 0x1, 0x40, 0x0, 0x0, 0x0, 0x0, 0x0,
    0x0, 0x0, 0x0, 0x1, 0x0,
    /* U+0063 "c" */
    0x0, 0xb8, 0x0, 0xff, 0xf4, 0x2f, 0xef, 0xe7,
    0xf0, 0x4b, 0x7f, 0x0, 0x1b, 0xf0, 0x0, 0xbf,
    0x1, 0x86, 0xfd, 0xbd, 0x4b, 0xff, 0xe4, 0x26,
    0x91, 0x1, 0x4, 0x10, 0x10, 0x41, 0x1, 0x4,
    0x0, 0x0, 0x40, 0x0, 0x4, 0x0,
    /* U+0064 "d" */
    0x0, 0x1, 0xf0, 0x0, 0xb, 0xe0, 0x0, 0x3f,
    0x41, 0xfb, 0xfd, 0x1f, 0xff, 0xf5, 0xff, 0xff,
    0xe7, 0xe1, 0x3f, 0xff, 0x80, 0xfd, 0xbe, 0x3,
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    0x0, 0x0, 0x0, 0x0, 0x0,
    /* U+0065 "e" */
    0x0, 0xb9, 0x0, 0x7f, 0xff, 0x7, 0xfe, 0xbe,
    0x2f, 0xd1, 0xfd, 0xff, 0xff, 0xf5, 0xfd, 0x29,
    0x47, 0xf0, 0x0, 0x1f, 0xfb, 0xf8, 0x4a, 0xff,
    0xe1, 0x11, 0x90, 0x4, 0x0, 0x0, 0x0, 0x0,
    0x0, 0x40, 0x0, 0x0, 0x0, 0x0, 0x0,
    /* U+0066 "f" */
    0x5, 0xfc, 0xb, 0xfd, 0xf, 0xe0, 0x2f, 0xf0,
    0xbf, 0xfd, 0x9f, 0xfa, 0x4f, 0xe1, 0x4f, 0xd1,
    0x4f, 0xd1, 0x4f, 0xd0, 0xf, 0xe0, 0xf, 0xd0,
    0xa, 0x50, 0x0, 0x50, 0x0, 0x40, 0x0, 0x40,
    0x0, 0x40, 0x0, 0x0,
    /* U+0067 "g" */
    0xb, 0xd2, 0xf0, 0xbf, 0xff, 0xe3, 0xff, 0xff,
    0x5f, 0xe0, 0xfe, 0x7e, 0x42, 0xfa, 0xfc, 0xb,
    0xef, 0xf9, 0xbf, 0xdb, 0xff, 0xff, 0x4b, 0xff,
    0xf5, 0x4, 0x8f, 0xe3, 0xe0, 0x7f, 0x8f, 0xe7,
    0xf8, 0x1b, 0xfa, 0x80, 0x16, 0x41, 0x0, 0x10,
    0x4, 0x0, 0x40, 0x10, 0x1, 0x0, 0x0, 0x0,
    0x1, 0x0,
    /* U+0068 "h" */
    0x0, 0x0, 0x0, 0x7e, 0x0, 0x0, 0xbf, 0x0,
    0x0, 0xbf, 0x40, 0x0, 0xbf, 0xff, 0xe0, 0x7f,
    0xff, 0xf0, 0x7f, 0xaf, 0xf8, 0xbf, 0x46, 0xfc,
    0x7f, 0x43, 0xf8, 0xbf, 0x43, 0xfc, 0xbf, 0x3,
    0xfc, 0x7f, 0x2, 0xf8, 0x3a, 0x40, 0xec, 0x11,
    0x0, 0x44, 0x10, 0x0, 0x44, 0x10, 0x0, 0x40,
    0x20, 0x0, 0x0,
    /* U+0069 "i" */
    0x3c, 0xf, 0x80, 0xd0, 0x20, 0x2f, 0xf, 0xcb,
    0xf2, 0xfc, 0x3f, 0x4f, 0xdb, 0xf3, 0xfc, 0x6f,
    0x42, 0x10, 0x44, 0x1, 0x0, 0x40,
    /* U+006A "j" */
    0x0, 0x80, 0x3f, 0x0, 0x78, 0x0, 0x20, 0x7,
    0xc0, 0x2f, 0xc0, 0xfe, 0x3, 0xf8, 0xb, 0xf0,
    0x1f, 0xc0, 0xbf, 0x2, 0xfc, 0xb, 0xf0, 0x3f,
    0x82, 0xff, 0x2f, 0xfc, 0x6d, 0x80, 0x11, 0x4,
    0x4, 0x0, 0x10, 0x0, 0x40, 0x1, 0x0, 0x4,
    0x0, 0x20, 0x0, 0x0,
    /* U+006B "k" */
    0xc, 0x0, 0x7, 0xe0, 0x0, 0xbf, 0x0, 0xb,
    0xf0, 0x74, 0xbf, 0xf, 0x47, 0xff, 0xf0, 0xbf,
    0xfe, 0xb, 0xff, 0xd0, 0x7f, 0xff, 0xb, 0xff,
    0xf4, 0xbf, 0xff, 0xcb, 0xf4, 0xfd, 0x7e, 0x47,
    0xc0, 0x44, 0x4, 0x0, 0x0, 0x40, 0x40, 0x4,
    0x4, 0x0, 0x40, 0x40, 0x0, 0x0, 0x0, 0x40,
    0x0, 0x0, 0x0, 0x0, 0x0,
    /* U+006C "l" */
    0x29, 0x1f, 0xcb, 0xe3, 0xfc, 0xbf, 0x6f, 0x8f,
    0xf2, 0xfc, 0xbf, 0x2f, 0xcf, 0xf2, 0xf8, 0x4c,
    0x12, 0x0, 0x40, 0x10, 0x8, 0x0,
    /* U+006D "m" */
    0x0, 0x0, 0x0, 0x0, 0x1d, 0x53, 0xe0, 0x4,
    0xf, 0xff, 0xff, 0xaf, 0xa2, 0xff, 0xff, 0xff,
    0xfc, 0xbf, 0xef, 0xfe, 0xbf, 0x5f, 0xe0, 0xfc,
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    0x0,
    /* U+006E "n" */
    0x2c, 0x1f, 0x82, 0xff, 0xff, 0x8b, 0xfe, 0xff,
    0x5f, 0xc2, 0xfc, 0x7f, 0x3, 0xfb, 0xfc, 0xf,
    0xeb, 0xf0, 0x7f, 0x9f, 0xc1, 0xfe, 0x7f, 0x45,
    0xf5, 0x4, 0x1, 0x54, 0x10, 0x1, 0x40, 0x40,
    0x0, 0x41, 0x0, 0x0, 0x0, 0x0, 0x0, 0x10,
    0x0, 0x0, 0x0, 0x0,
    /* U+006F "o" */
    0x7, 0xff, 0x40, 0x2f, 0xff, 0xf0, 0x2f, 0x63,
    0xf8, 0x3f, 0x13, 0xf8, 0x3f, 0x13, 0xfc, 0xff,
    0x13, 0xfc, 0xff, 0x53, 0xf8, 0x6f, 0x8f, 0xf0,
    0x4f, 0xff, 0xe0, 0x46, 0xfb, 0x10, 0x40, 0x21,
    0x10, 0x80, 0x10, 0x10, 0x0, 0x10, 0x10, 0x0,
    0x10, 0x10, 0x0, 0x10, 0x0, 0x40, 0x10, 0x0,
    0x0, 0x0, 0x0,
    /* U+0070 "p" */
    0x0, 0x0, 0x0, 0x10, 0x7f, 0x80, 0x7f, 0xff,
    0xe0, 0x7f, 0xff, 0xf8, 0xbf, 0x13, 0xf8, 0xbf,
    0x13, 0xfc, 0x7f, 0x43, 0xfc, 0x7f, 0xef, 0xf8,
    0xbf, 0xff, 0xf4, 0x7f, 0xff, 0xd4, 0xbf, 0x84,
    0x84, 0x7f, 0x4, 0x44, 0xbf, 0x4, 0x48, 0xae,
    0x4, 0x40, 0x41, 0x0, 0x44, 0x1, 0x0, 0x44,
    0x1, 0x0, 0x40, 0x0, 0x0, 0x0,
    /* U+0071 "q" */
    0xb, 0xff, 0xd0, 0x1f, 0xff, 0xf4, 0x7f, 0xdf,
    0xfc, 0xbf, 0x47, 0xf8, 0xfe, 0x47, 0xf4, 0xfe,
    0x7, 0xfc, 0xff, 0xef, 0xf8, 0xbf, 0xff, 0xf4,
    0x2f, 0xff, 0xf8, 0x15, 0x7f, 0xfc, 0x1, 0x3,
    0xf8, 0x1, 0x3, 0xf4, 0x1, 0x2, 0xd0, 0x1,
    0x0, 0x10, 0x1, 0x0, 0x10, 0x0, 0x0, 0x10,
    /* U+0072 "r" */
    0x0, 0x0, 0x2c, 0x6e, 0x7f, 0xff, 0xff, 0xfe,
    0xbf, 0xd5, 0x7f, 0x81, 0x7f, 0x1, 0xbf, 0x81,
    0xff, 0x1, 0x7b, 0x0, 0x10, 0x0, 0x10, 0x40,
    0x10, 0x40, 0x10, 0x40, 0x20, 0x40, 0x0, 0x0,
    0x20, 0x0,
    /* U+0073 "s" */
    0xb, 0xff, 0x41, 0xff, 0xfd, 0x3f, 0x80, 0x57,
    0xfd, 0x4, 0x1f, 0xff, 0xc0, 0x47, 0xff, 0x69,
    0xf, 0xef, 0xff, 0xfe, 0x5f, 0xfd, 0x10, 0x4,
    0x41, 0x0, 0x4, 0x10, 0x0, 0x41, 0x0, 0x4,
    0x0, 0x0, 0x40, 0x0, 0x0, 0x0, 0x0, 0x0,
    /* U+0074 "t" */
    0x3, 0x80, 0x0, 0xfc, 0x0, 0xff, 0x0, 0xbf,
    0xf8, 0xbf, 0xff, 0x17, 0xfd, 0x44, 0xff, 0x11,
    0x2f, 0xc4, 0x4b, 0xf0, 0x13, 0xfd, 0x4, 0xff,
    0xd0, 0x1f, 0xfc, 0x4, 0xb6, 0x1, 0x4, 0x40,
    0x41, 0x10, 0x0, 0x44, 0x0, 0x11, 0x0, 0x0,
    0x80,
    /* U+0075 "u" */
    0x38, 0x0, 0xe0, 0xbf, 0x3, 0xf0, 0xff, 0x7,
    0xf8, 0xbf, 0x7, 0xf8, 0x7f, 0x3, 0xf8, 0xbf,
    0x7, 0xfc, 0xbf, 0xdf, 0xf8, 0xbf, 0xff, 0xf8,
    0x4f, 0xff, 0xf4, 0x40, 0x80, 0x14, 0x40, 0x40,
    0x14, 0x40, 0x40, 0x0, 0x0, 0x40, 0x0, 0x0,
    0x40, 0x0, 0x0, 0x40, 0x0, 0x0, 0x0, 0x0,
    /* U+0076 "v" */
    0xb0, 0x6, 0xf, 0xc0, 0xfd, 0xbe, 0xf, 0xd7,
    0xf6, 0xf5, 0x3f, 0xff, 0x46, 0xff, 0xe0, 0x5f,
    0xfd, 0x14, 0xbf, 0xd0, 0xb, 0xf9, 0x0, 0x42,
    0x10, 0x4, 0x10, 0x0, 0x41, 0x0, 0x4, 0x10,
    0x0, 0x1, 0x0, 0x0, 0x10, 0x0, 0x0, 0x0,
    /* U+0077 "w" */
    0x0, 0x0, 0x0, 0x1, 0xc0, 0x2c, 0x2, 0x8f,
    0xc1, 0xfd, 0xf, 0xdf, 0x4b, 0xf8, 0x7f, 0xbf,
    0xbf, 0xfb, 0xf4, 0xff, 0xff, 0xff, 0xc2, 0xff,
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    0x4, 0x0, 0x0, 0x0,
    /* U+0078 "x" */
    0x38, 0x1d, 0x1f, 0x9f, 0xc7, 0xff, 0xf0, 0x7f,
    0xf8, 0xf, 0xf5, 0x3, 0xff, 0x87, 0xff, 0xd2,
    0xff, 0xfc, 0xbe, 0x5f, 0x21, 0x12, 0x80, 0x40,
    0x40, 0x10, 0x20, 0x44, 0x8, 0x0, 0x1, 0x0,
    0x0, 0x40, 0x0, 0x10,
    /* U+0079 "y" */
    0x74, 0xb, 0xcb, 0xd0, 0xfc, 0xbd, 0x1f, 0xcb,
    0xf3, 0xf8, 0x3f, 0xff, 0x82, 0xff, 0xe4, 0xf,
    0xff, 0x41, 0xff, 0xe0, 0x3, 0xfa, 0x0, 0x7f,
    0x50, 0x3f, 0xf1, 0x7, 0xfe, 0x10, 0x69, 0x50,
    0x0, 0x45, 0x0, 0x4, 0x50, 0x0, 0x45, 0x0,
    0x4, 0x40, 0x0, 0x4, 0x0, 0x0, 0x40, 0x0,
    0x4, 0x0,
    /* U+007A "z" */
    0xe, 0xbe, 0x41, 0xff, 0xff, 0x16, 0xff, 0xa0,
    0xb, 0xf1, 0x2, 0xf9, 0x10, 0xbf, 0x0, 0x1f,
    0xfd, 0x7, 0xff, 0xfd, 0x9f, 0xbf, 0xd4, 0x80,
    0x84, 0x44, 0x4, 0x40, 0x40, 0x4, 0x4, 0x4,
    0x40, 0x40, 0x4, 0x4, 0x0, 0x0, 0x80, 0x0,
    0x0, 0x0, 0x0,
    /* U+007B "{" */
    0x0, 0xf4, 0x1f, 0xe0, 0xbe, 0x82, 0xf1, 0x7,
    0xc4, 0x2f, 0x3, 0xfd, 0x2f, 0xc0, 0x7f, 0x80,
    0x6f, 0x0, 0x7c, 0x3, 0xf0, 0xf, 0xd0, 0x3f,
    0xd0, 0x6f, 0x80, 0x24, 0x0, 0x40, 0x0, 0x0,
    0x0, 0x0, 0x0, 0x0, 0x40, 0x0, 0x0,
    /* U+007C "|" */
    0x10, 0x78, 0xbc, 0xbc, 0xbc, 0xfc, 0xbc, 0xbc,
    0xbc, 0x7c, 0xbc, 0xbc, 0xbc, 0xbc, 0xbc, 0xbc,
    0x7c, 0x34, 0x24, 0x10, 0x10, 0x10,
    /* U+007D "}" */
    0x0, 0x0, 0x7d, 0x0, 0x7f, 0x80, 0x1f, 0xc0,
    0xf, 0xc0, 0xb, 0xd0, 0xf, 0xc0, 0xf, 0xc0,
    0x7, 0xfc, 0x3, 0xfc, 0x7, 0xd4, 0xf, 0xc4,
    0xf, 0xc4, 0xf, 0xc4, 0x1f, 0xc0, 0xbf, 0x80,
    0x3f, 0x0, 0x20, 0x0, 0x20, 0x0, 0x10, 0x0,
    0x10, 0x0, 0x0, 0x0,
    /* U+007E "~" */
    0x0, 0x0, 0x0, 0x7, 0xf8, 0x1, 0xcb, 0xff,
    0xff, 0xf0, 0xd0, 0x7f, 0xf8, 0x10, 0x4, 0x41,
    0x4, 0x1, 0x0, 0x40, 0x0, 0x40, 0x10, 0x0,
    0x10, 0x4, 0x0, 0x0, 0x0, 0x0,
    /* U+00C6 "Æ" */
    0x0, 0x3f, 0xff, 0xff, 0xe0, 0x3, 0xff, 0xff,
    0xff, 0xc0, 0xf, 0xff, 0xf8, 0x72, 0x0, 0x7f,
    0x3f, 0xe0, 0x4, 0x3, 0xf4, 0xbf, 0xea, 0x10,
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    0x0, 0x0, 0x0, 0x0, 0x0, 0x0, 0x0,
    /* U+00E6 "æ" */
    0x0, 0x0, 0x0, 0x0, 0x0, 0x39, 0x1, 0xf4,
    0x0, 0xbf, 0xea, 0xff, 0xc0, 0xff, 0xff, 0xff,
    0xf4, 0x1a, 0xb, 0xf5, 0x7f, 0x40, 0x3, 0xff,
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    0x0, 0x0, 0x0, 0x20, 0x0, 0x0, 0x0, 0x0,
    0x0
};
/*---------------------
 *  GLYPH DESCRIPTION
 *--------------------*/
static const lv_font_fmt_txt_glyph_dsc_t creepy_18_glyph_dsc[] = {
    {.bitmap_index = 0, .adv_w = 0, .box_w = 0, .box_h = 0, .ofs_x = 0, .ofs_y = 0} /* id = 0 reserved */,
    {.bitmap_index = 0, .adv_w = 115, .box_w = 0, .box_h = 0, .ofs_x = 0, .ofs_y = 0},
    {.bitmap_index = 0, .adv_w = 72, .box_w = 5, .box_h = 15, .ofs_x = 0, .ofs_y = -3},
    {.bitmap_index = 19, .adv_w = 103, .box_w = 7, .box_h = 9, .ofs_x = 0, .ofs_y = 3},
    {.bitmap_index = 35, .adv_w = 209, .box_w = 13, .box_h = 17, .ofs_x = 0, .ofs_y = -5},
    {.bitmap_index = 91, .adv_w = 179, .box_w = 12, .box_h = 19, .ofs_x = 0, .ofs_y = -6},
    {.bitmap_index = 148, .adv_w = 288, .box_w = 18, .box_h = 17, .ofs_x = 0, .ofs_y = -5},
    {.bitmap_index = 225, .adv_w = 200, .box_w = 13, .box_h = 18, .ofs_x = 0, .ofs_y = -6},
    {.bitmap_index = 284, .adv_w = 52, .box_w = 4, .box_h = 8, .ofs_x = 0, .ofs_y = 4},
    {.bitmap_index = 292, .adv_w = 85, .box_w = 6, .box_h = 20, .ofs_x = 0, .ofs_y = -8},
    {.bitmap_index = 322, .adv_w = 83, .box_w = 5, .box_h = 18, .ofs_x = 0, .ofs_y = -6},
    {.bitmap_index = 345, .adv_w = 118, .box_w = 8, .box_h = 11, .ofs_x = 0, .ofs_y = 1},
    {.bitmap_index = 367, .adv_w = 174, .box_w = 11, .box_h = 15, .ofs_x = 0, .ofs_y = -5},
    {.bitmap_index = 409, .adv_w = 77, .box_w = 5, .box_h = 10, .ofs_x = 0, .ofs_y = -7},
    {.bitmap_index = 422, .adv_w = 114, .box_w = 7, .box_h = 9, .ofs_x = 0, .ofs_y = -2},
    {.bitmap_index = 438, .adv_w = 68, .box_w = 5, .box_h = 7, .ofs_x = 0, .ofs_y = -3},
    {.bitmap_index = 447, .adv_w = 100, .box_w = 7, .box_h = 16, .ofs_x = 0, .ofs_y = -4},
    {.bitmap_index = 475, .adv_w = 188, .box_w = 12, .box_h = 18, .ofs_x = 0, .ofs_y = -6},
    {.bitmap_index = 529, .adv_w = 117, .box_w = 8, .box_h = 16, .ofs_x = 0, .ofs_y = -4},
    {.bitmap_index = 561, .adv_w = 176, .box_w = 11, .box_h = 18, .ofs_x = 0, .ofs_y = -6},
    {.bitmap_index = 611, .adv_w = 171, .box_w = 11, .box_h = 16, .ofs_x = 0, .ofs_y = -4},
    {.bitmap_index = 655, .adv_w = 189, .box_w = 12, .box_h = 17, .ofs_x = 0, .ofs_y = -5},
    {.bitmap_index = 706, .adv_w = 167, .box_w = 11, .box_h = 18, .ofs_x = 0, .ofs_y = -6},
    {.bitmap_index = 756, .adv_w = 187, .box_w = 12, .box_h = 17, .ofs_x = 0, .ofs_y = -5},
    {.bitmap_index = 807, .adv_w = 177, .box_w = 11, .box_h = 16, .ofs_x = 0, .ofs_y = -4},
    {.bitmap_index = 851, .adv_w = 183, .box_w = 12, .box_h = 18, .ofs_x = 0, .ofs_y = -6},
    {.bitmap_index = 905, .adv_w = 187, .box_w = 12, .box_h = 16, .ofs_x = 0, .ofs_y = -4},
    {.bitmap_index = 953, .adv_w = 65, .box_w = 4, .box_h = 13, .ofs_x = 0, .ofs_y = -4},
    {.bitmap_index = 966, .adv_w = 80, .box_w = 5, .box_h = 14, .ofs_x = 0, .ofs_y = -5},
    {.bitmap_index = 984, .adv_w = 176, .box_w = 11, .box_h = 15, .ofs_x = 0, .ofs_y = -4},
    {.bitmap_index = 1026, .adv_w = 185, .box_w = 12, .box_h = 12, .ofs_x = 0, .ofs_y = -4},
    {.bitmap_index = 1062, .adv_w = 178, .box_w = 11, .box_h = 13, .ofs_x = 0, .ofs_y = -4},
    {.bitmap_index = 1098, .adv_w = 163, .box_w = 11, .box_h = 18, .ofs_x = 0, .ofs_y = -6},
    {.bitmap_index = 1148, .adv_w = 273, .box_w = 17, .box_h = 20, .ofs_x = 0, .ofs_y = -8},
    {.bitmap_index = 1233, .adv_w = 196, .box_w = 13, .box_h = 18, .ofs_x = 0, .ofs_y = -5},
    {.bitmap_index = 1292, .adv_w = 194, .box_w = 12, .box_h = 18, .ofs_x = 0, .ofs_y = -6},
    {.bitmap_index = 1346, .adv_w = 209, .box_w = 13, .box_h = 18, .ofs_x = 0, .ofs_y = -6},
    {.bitmap_index = 1405, .adv_w = 205, .box_w = 13, .box_h = 18, .ofs_x = 0, .ofs_y = -6},
    {.bitmap_index = 1464, .adv_w = 176, .box_w = 11, .box_h = 18, .ofs_x = 0, .ofs_y = -6},
    {.bitmap_index = 1514, .adv_w = 160, .box_w = 10, .box_h = 17, .ofs_x = 0, .ofs_y = -5},
    {.bitmap_index = 1557, .adv_w = 213, .box_w = 14, .box_h = 18, .ofs_x = 0, .ofs_y = -6},
    {.bitmap_index = 1620, .adv_w = 210, .box_w = 13, .box_h = 17, .ofs_x = 0, .ofs_y = -5},
    {.bitmap_index = 1676, .adv_w = 83, .box_w = 5, .box_h = 18, .ofs_x = 0, .ofs_y = -6},
    {.bitmap_index = 1699, .adv_w = 168, .box_w = 11, .box_h = 19, .ofs_x = 0, .ofs_y = -7},
    {.bitmap_index = 1752, .adv_w = 195, .box_w = 12, .box_h = 18, .ofs_x = 0, .ofs_y = -6},
    {.bitmap_index = 1806, .adv_w = 163, .box_w = 11, .box_h = 18, .ofs_x = 0, .ofs_y = -6},
    {.bitmap_index = 1856, .adv_w = 245, .box_w = 16, .box_h = 19, .ofs_x = 0, .ofs_y = -6},
    {.bitmap_index = 1932, .adv_w = 200, .box_w = 13, .box_h = 18, .ofs_x = 0, .ofs_y = -6},
    {.bitmap_index = 1991, .adv_w = 233, .box_w = 15, .box_h = 18, .ofs_x = 0, .ofs_y = -6},
    {.bitmap_index = 2059, .adv_w = 196, .box_w = 13, .box_h = 19, .ofs_x = 0, .ofs_y = -6},
    {.bitmap_index = 2121, .adv_w = 218, .box_w = 14, .box_h = 22, .ofs_x = 0, .ofs_y = -10},
    {.bitmap_index = 2198, .adv_w = 202, .box_w = 13, .box_h = 18, .ofs_x = 0, .ofs_y = -6},
    {.bitmap_index = 2257, .adv_w = 182, .box_w = 12, .box_h = 17, .ofs_x = 0, .ofs_y = -5},
    {.bitmap_index = 2308, .adv_w = 198, .box_w = 13, .box_h = 16, .ofs_x = 0, .ofs_y = -4},
    {.bitmap_index = 2360, .adv_w = 198, .box_w = 13, .box_h = 19, .ofs_x = 0, .ofs_y = -7},
    {.bitmap_index = 2422, .adv_w = 182, .box_w = 12, .box_h = 16, .ofs_x = 0, .ofs_y = -4},
    {.bitmap_index = 2470, .adv_w = 264, .box_w = 17, .box_h = 17, .ofs_x = 0, .ofs_y = -5},
    {.bitmap_index = 2543, .adv_w = 171, .box_w = 11, .box_h = 18, .ofs_x = 0, .ofs_y = -6},
    {.bitmap_index = 2593, .adv_w = 182, .box_w = 12, .box_h = 18, .ofs_x = 0, .ofs_y = -6},
    {.bitmap_index = 2647, .adv_w = 194, .box_w = 12, .box_h = 18, .ofs_x = 0, .ofs_y = -5},
    {.bitmap_index = 2701, .adv_w = 107, .box_w = 7, .box_h = 18, .ofs_x = 0, .ofs_y = -6},
    {.bitmap_index = 2733, .adv_w = 99, .box_w = 7, .box_h = 18, .ofs_x = 0, .ofs_y = -6},
    {.bitmap_index = 2765, .adv_w = 98, .box_w = 6, .box_h = 25, .ofs_x = 0, .ofs_y = -13},
    {.bitmap_index = 2803, .adv_w = 142, .box_w = 9, .box_h = 13, .ofs_x = 0, .ofs_y = -1},
    {.bitmap_index = 2833, .adv_w = 153, .box_w = 10, .box_h = 7, .ofs_x = 0, .ofs_y = -8},
    {.bitmap_index = 2851, .adv_w = 174, .box_w = 11, .box_h = 15, .ofs_x = 0, .ofs_y = -6},
    {.bitmap_index = 2893, .adv_w = 175, .box_w = 11, .box_h = 19, .ofs_x = 0, .ofs_y = -7},
    {.bitmap_index = 2946, .adv_w = 162, .box_w = 10, .box_h = 15, .ofs_x = 0, .ofs_y = -6},
    {.bitmap_index = 2984, .adv_w = 178, .box_w = 11, .box_h = 22, .ofs_x = 0, .ofs_y = -10},
    {.bitmap_index = 3045, .adv_w = 168, .box_w = 11, .box_h = 14, .ofs_x = 0, .ofs_y = -5},
    {.bitmap_index = 3084, .adv_w = 127, .box_w = 8, .box_h = 18, .ofs_x = 0, .ofs_y = -6},
    {.bitmap_index = 3120, .adv_w = 177, .box_w = 11, .box_h = 18, .ofs_x = 0, .ofs_y = -9},
    {.bitmap_index = 3170, .adv_w = 179, .box_w = 12, .box_h = 17, .ofs_x = 0, .ofs_y = -4},
    {.bitmap_index = 3221, .adv_w = 78, .box_w = 5, .box_h = 17, .ofs_x = 0, .ofs_y = -5},
    {.bitmap_index = 3243, .adv_w = 100, .box_w = 7, .box_h = 25, .ofs_x = 0, .ofs_y = -12},
    {.bitmap_index = 3287, .adv_w = 155, .box_w = 10, .box_h = 21, .ofs_x = 0, .ofs_y = -9},
    {.bitmap_index = 3340, .adv_w = 71, .box_w = 5, .box_h = 17, .ofs_x = 0, .ofs_y = -5},
    {.bitmap_index = 3362, .adv_w = 270, .box_w = 17, .box_h = 19, .ofs_x = 0, .ofs_y = -9},
    {.bitmap_index = 3443, .adv_w = 174, .box_w = 11, .box_h = 16, .ofs_x = 0, .ofs_y = -7},
    {.bitmap_index = 3487, .adv_w = 179, .box_w = 12, .box_h = 17, .ofs_x = 0, .ofs_y = -8},
    {.bitmap_index = 3538, .adv_w = 183, .box_w = 12, .box_h = 18, .ofs_x = 0, .ofs_y = -8},
    {.bitmap_index = 3592, .adv_w = 179, .box_w = 12, .box_h = 16, .ofs_x = 0, .ofs_y = -7},
    {.bitmap_index = 3640, .adv_w = 129, .box_w = 8, .box_h = 17, .ofs_x = 0, .ofs_y = -7},
    {.bitmap_index = 3674, .adv_w = 161, .box_w = 10, .box_h = 16, .ofs_x = 0, .ofs_y = -7},
    {.bitmap_index = 3714, .adv_w = 133, .box_w = 9, .box_h = 18, .ofs_x = 0, .ofs_y = -6},
    {.bitmap_index = 3755, .adv_w = 179, .box_w = 12, .box_h = 16, .ofs_x = 0, .ofs_y = -7},
    {.bitmap_index = 3803, .adv_w = 154, .box_w = 10, .box_h = 16, .ofs_x = 0, .ofs_y = -7},
    {.bitmap_index = 3843, .adv_w = 240, .box_w = 15, .box_h = 18, .ofs_x = 0, .ofs_y = -8},
    {.bitmap_index = 3911, .adv_w = 136, .box_w = 9, .box_h = 16, .ofs_x = 0, .ofs_y = -7},
    {.bitmap_index = 3947, .adv_w = 150, .box_w = 10, .box_h = 20, .ofs_x = 0, .ofs_y = -11},
    {.bitmap_index = 3997, .adv_w = 162, .box_w = 10, .box_h = 17, .ofs_x = 0, .ofs_y = -8},
    {.bitmap_index = 4040, .adv_w = 113, .box_w = 7, .box_h = 22, .ofs_x = 0, .ofs_y = -10},
    {.bitmap_index = 4079, .adv_w = 55, .box_w = 4, .box_h = 22, .ofs_x = 0, .ofs_y = -9},
    {.bitmap_index = 4101, .adv_w = 117, .box_w = 8, .box_h = 22, .ofs_x = 0, .ofs_y = -9},
    {.bitmap_index = 4145, .adv_w = 198, .box_w = 13, .box_h = 9, .ofs_x = 0, .ofs_y = -2},
    {.bitmap_index = 4175, .adv_w = 296, .box_w = 19, .box_h = 20, .ofs_x = 0, .ofs_y = -8},
    {.bitmap_index = 4270, .adv_w = 268, .box_w = 17, .box_h = 17, .ofs_x = 0, .ofs_y = -7}
};
/*---------------------
 *  CHARACTER MAPPING
 *--------------------*/
static const uint16_t creepy_18_unicode_list_2[] = {
    0x0, 0x20
};
/*Collect the unicode lists and glyph_id offsets*/
static const lv_font_fmt_txt_cmap_t creepy_18_cmaps[] =
{
    {
        .range_start = 32, .range_length = 64, .glyph_id_start = 1,
        .unicode_list = NULL, .glyph_id_ofs_list = NULL, .list_length = 0, .type = LV_FONT_FMT_TXT_CMAP_FORMAT0_TINY
    },
    {
        .range_start = 97, .range_length = 30, .glyph_id_start = 65,
        .unicode_list = NULL, .glyph_id_ofs_list = NULL, .list_length = 0, .type = LV_FONT_FMT_TXT_CMAP_FORMAT0_TINY
    },
    {
        .range_start = 198, .range_length = 33, .glyph_id_start = 95,
        .unicode_list = creepy_18_unicode_list_2, .glyph_id_ofs_list = NULL, .list_length = 2, .type = LV_FONT_FMT_TXT_CMAP_SPARSE_TINY
    }
};
/*-----------------
 *    KERNING
 *----------------*/
/*Pair left and right glyphs for kerning*/
static const uint8_t creepy_18_kern_pair_glyph_ids[] =
{
    2, 4,
    2, 12,
    2, 14,
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    96, 96
};
/* Kerning between the respective left and right glyphs
 * 4.4 format which needs to scaled with `kern_scale`*/
static const int8_t creepy_18_kern_pair_values[] =
{
    -10, -9, -10, -8, -9, -4, -4, -6,
    -4, -8, -26, -7, -13, -6, -10, -21,
    -12, -9, -16, -12, -17, -13, -35, -8,
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    -9, -22, -13, -7
};
/*Collect the kern pair's data in one place*/
static const lv_font_fmt_txt_kern_pair_t creepy_18_kern_pairs =
{
    .glyph_ids = creepy_18_kern_pair_glyph_ids,
    .values = creepy_18_kern_pair_values,
    .pair_cnt = 2732,
    .glyph_ids_size = 0
};
/*--------------------
 *  ALL CUSTOM DATA
 *--------------------*/
/*Store all the custom data of the font*/
static lv_font_fmt_txt_glyph_cache_t creepy_18_cache;
static const lv_font_fmt_txt_dsc_t creepy_18_font_dsc = {
    .glyph_bitmap = creepy_18_glyph_bitmap,
    .glyph_dsc = creepy_18_glyph_dsc,
    .cmaps = creepy_18_cmaps,
    .kern_dsc = &creepy_18_kern_pairs,
    .kern_scale = 16,
    .cmap_num = 3,
    .bpp = 2,
    .kern_classes = 0,
    .bitmap_format = 0,
    .cache = &creepy_18_cache
};
/*-----------------
 *  PUBLIC FONT
 *----------------*/
/*Initialize a public general font descriptor*/
const lv_font_t creepy_18 = {
    .get_glyph_dsc = lv_font_get_glyph_dsc_fmt_txt,    /*Function pointer to get glyph's data*/
    .get_glyph_bitmap = lv_font_get_bitmap_fmt_txt,    /*Function pointer to get glyph's bitmap*/
    .line_height = 26,          /*The maximum line height required by the font*/
    .base_line = 13,             /*Baseline measured from the bottom of the line*/

    .subpx = LV_FONT_SUBPX_NONE,
    .underline_position = -1,
    .underline_thickness = 1,
    .dsc = &creepy_18_font_dsc,          /*The custom font data. Will be accessed by `get_glyph_bitmap/dsc` */
};
#endif

/*******************************************************************************
 * Size: 18 px
 * Bpp: 2
 ******************************************************************************/


#ifdef __has_include

    #if __has_include("lvgl.h")
         #ifndef LV_LVGL_H_INCLUDE_SIMPLE
             #define LV_LVGL_H_INCLUDE_SIMPLE
         #endif
     #endif
 #endif

 #ifdef LV_LVGL_H_INCLUDE_SIMPLE
     #include "lvgl.h"
 #else
     #include "../lvgl-8.3.11/lvgl.h"
 #endif

 #ifndef ALADIN
 #define ALADIN 1
 #endif

 #if ALADIN

/*-----------------
 *    BITMAPS
 *----------------*/
/*Store the image of the glyphs*/
static LV_ATTRIBUTE_LARGE_CONST const uint8_t aladin_glyph_bitmap[] = {
    /* U+0020 " " */
    /* U+0021 "!" */
    0x2d, 0x3c, 0x3c, 0x2c, 0x2c, 0x2c, 0x28, 0x28,
    0x18, 0x0, 0x38, 0x3c,
    /* U+0022 "\"" */
    0x36, 0xc3, 0x5c, 0x20, 0x80, 0x0,
    /* U+0023 "#" */
    0x2, 0x46, 0x0, 0x34, 0xa0, 0x3f, 0xff, 0xf0,
    0x34, 0xa0, 0x3, 0x4a, 0x3, 0xff, 0xff, 0x3,
    0x4a, 0x0, 0x34, 0xa0, 0x2, 0x5, 0x0,
    /* U+0024 "$" */
    0x0, 0x90, 0x0, 0x9, 0x0, 0x6, 0xfe, 0x2,
    0xed, 0xf4, 0x3c, 0x97, 0x3, 0xed, 0x0, 0x2f,
    0xf4, 0x0, 0x7f, 0xe0, 0x0, 0xbf, 0x83, 0xe9,
    0xbc, 0xbc, 0x97, 0xcb, 0xc9, 0xb8, 0x3e, 0xff,
    0x0, 0xbf, 0x80, 0x0, 0x90, 0x0,
    /* U+0025 "%" */
    0x2f, 0x0, 0xa3, 0x28, 0x1c, 0x71, 0xc3, 0x7,
    0x1c, 0xa0, 0x32, 0x9c, 0x1, 0xa3, 0x0, 0x0,
    0x96, 0x80, 0x1c, 0xca, 0x3, 0x1c, 0x70, 0x91,
    0xc7, 0x18, 0x1c, 0xa3, 0x0, 0xac,
    /* U+0026 "&" */
    0x1, 0xf8, 0x0, 0xd, 0x70, 0x0, 0x76, 0x80,
    0x0, 0xf8, 0x0, 0x3, 0xe0, 0x0, 0x37, 0xc1,
    0x3, 0xc7, 0x8f, 0xe, 0xf, 0x38, 0x78, 0x1f,
    0xd1, 0xf0, 0x3f, 0x3, 0xfa, 0xfd, 0x1, 0xfe,
    0xbc,
    /* U+0027 "'" */
    0x34, 0xd2, 0x0,
    /* U+0028 "(" */
    0x0, 0x0, 0xc0, 0xa0, 0x70, 0x2c, 0xe, 0x3,
    0x80, 0xe0, 0x34, 0xe, 0x3, 0x80, 0xf0, 0x2c,
    0x3, 0x40, 0x70, 0x5,
    /* U+0029 ")" */
    0x0, 0xc, 0x2, 0xc0, 0x34, 0xf, 0x2, 0xc0,
    0xb0, 0x1d, 0x7, 0x41, 0xd0, 0xb0, 0x2c, 0xe,
    0x7, 0x2, 0x41, 0x80,
    /* U+002A "*" */
    0x55, 0x2d, 0x69, 0x0,
    /* U+002B "+" */
    0x0, 0x0, 0x0, 0x30, 0x0, 0xc, 0x0, 0x3,
    0x0, 0x7f, 0xff, 0x80, 0x34, 0x0, 0xc, 0x0,
    0x3, 0x0, 0x0, 0xc0, 0x0,
    /* U+002C "," */
    0x28, 0xf0, 0x80,
    /* U+002D "-" */
    0x3f, 0xfe, 0x0, 0x0,
    /* U+002E "." */
    0x28, 0xf0,
    /* U+002F "/" */
    0x0, 0x0, 0x10, 0x0, 0x2, 0x80, 0x0, 0xc,
    0x0, 0x0, 0xd0, 0x0, 0x7, 0x0, 0x0, 0x30,
    0x0, 0x2, 0x80, 0x0, 0x1c, 0x0, 0x0, 0xd0,
    0x0, 0xa, 0x0, 0x0, 0x30, 0x0, 0x2, 0x40,
    0x0, 0x1c, 0x0, 0x0, 0xc0, 0x0, 0xa, 0x0,
    0x0, 0x0,
    /* U+0030 "0" */
    0x7, 0xf8, 0x1, 0xf5, 0xf0, 0x3d, 0xb, 0x83,
    0xc0, 0x7c, 0x7c, 0x7, 0xc7, 0xc0, 0x7c, 0x7c,
    0x7, 0xc7, 0xc0, 0x7c, 0x7c, 0x7, 0xc3, 0xd0,
    0xb8, 0x2f, 0x5f, 0x0, 0x7f, 0x80,
    /* U+0031 "1" */
    0xb, 0x7f, 0x7f, 0x1f, 0xf, 0xf, 0xf, 0x1f,
    0x1f, 0x1f, 0x1f, 0x2e,
    /* U+0032 "2" */
    0x7, 0xf8, 0xb, 0x4b, 0xc3, 0xc0, 0xf0, 0xf8,
    0x7c, 0x18, 0x3e, 0x0, 0x2e, 0x0, 0x2d, 0x0,
    0x1d, 0x0, 0x1d, 0x0, 0xf, 0x1, 0x87, 0xff,
    0xf2, 0xff, 0xf4,
    /* U+0033 "3" */
    0xb, 0xf8, 0xf, 0x4b, 0x83, 0xc1, 0xf0, 0x1,
    0xf8, 0xb, 0xf8, 0x0, 0x6d, 0x0, 0x1, 0xe0,
    0xb4, 0x3c, 0x7c, 0xf, 0x1f, 0x7, 0xc3, 0xd7,
    0xe0, 0x7f, 0xd0,
    /* U+0034 "4" */
    0x0, 0x1e, 0x0, 0x1f, 0x40, 0xf, 0xd0, 0xd,
    0xb4, 0xa, 0x2d, 0x7, 0xb, 0x43, 0x82, 0xd2,
    0xff, 0xfd, 0xff, 0xfe, 0x0, 0xf, 0x40, 0x3,
    0xd0, 0x0, 0xf4,
    /* U+0035 "5" */
    0x1f, 0xff, 0x7, 0xff, 0x42, 0xc0, 0x0, 0xb0,
    0x0, 0x3f, 0xf8, 0xf, 0x5f, 0x81, 0x1, 0xf0,
    0x50, 0x3c, 0x7c, 0xf, 0x2f, 0x7, 0xc7, 0xd7,
    0xd0, 0x7f, 0xd0,
    /* U+0036 "6" */
    0x2, 0xfd, 0x3, 0xc3, 0xc2, 0xd0, 0xf0, 0xf0,
    0x0, 0x3e, 0xf8, 0x1f, 0xdf, 0xc7, 0xc0, 0xf5,
    0xf0, 0x3d, 0x7c, 0xf, 0x4f, 0x3, 0xc2, 0xe2,
    0xd0, 0x2f, 0xd0,
    /* U+0037 "7" */
    0x3f, 0xfc, 0x7f, 0xfc, 0x50, 0x38, 0x0, 0xb0,
    0x0, 0xd0, 0x2, 0xc0, 0x3, 0x80, 0xb, 0x0,
    0xf, 0x0, 0x1f, 0x0, 0x2f, 0x0, 0x2f, 0x0,
    /* U+0038 "8" */
    0xb, 0xf8, 0xb, 0x47, 0xc3, 0xc0, 0xf0, 0xfc,
    0x78, 0xf, 0xf8, 0x2, 0xff, 0x3, 0xd2, 0xf1,
    0xf0, 0x3e, 0xbc, 0xb, 0xaf, 0x3, 0xd3, 0xe6,
    0xf0, 0x2f, 0xe0,
    /* U+0039 "9" */
    0xb, 0xf8, 0xb, 0x8b, 0x83, 0xc0, 0xf1, 0xf0,
    0x3d, 0x7c, 0xf, 0x4f, 0x8b, 0xd1, 0xff, 0xf4,
    0x0, 0x3c, 0x24, 0xf, 0x1f, 0x7, 0x87, 0xc3,
    0xc0, 0x7f, 0x80,
    /* U+003A ":" */
    0x3c, 0xb0, 0x0, 0x0, 0x2, 0x8f,
    /* U+003B ";" */
    0x3c, 0xb0, 0x0, 0x0, 0x2, 0x8f, 0x8, 0x0,
    /* U+003C "<" */
    0x0, 0x4, 0x0, 0x3c, 0x1, 0xd0, 0xa, 0x0,
    0x38, 0x0, 0x3d, 0x0, 0x7, 0xc0, 0x0, 0xb4,
    0x0, 0x18,
    /* U+003D "=" */
    0x7f, 0xff, 0x40, 0x0, 0x0, 0x0, 0x1, 0xff,
    0xfd, 0x0, 0x0, 0x0,
    /* U+003E ">" */
    0x0, 0x0, 0x74, 0x0, 0xb, 0x0, 0x1, 0xd0,
    0x0, 0x38, 0x0, 0xb8, 0x7, 0xc0, 0x3d, 0x0,
    0x60, 0x0,
    /* U+003F "?" */
    0xb, 0xf4, 0x3c, 0x3c, 0x74, 0x2d, 0x34, 0x2d,
    0x14, 0x3c, 0x0, 0xf0, 0x3, 0x80, 0xb, 0x0,
    0x3, 0x40, 0x0, 0x0, 0xa, 0x0, 0x7, 0x40,
    /* U+0040 "@" */
    0x0, 0x1b, 0xfe, 0x0, 0x1, 0xf4, 0x7, 0xd0,
    0x7, 0x80, 0x0, 0xb4, 0xe, 0xb, 0xf4, 0x3c,
    0x2c, 0x2e, 0x3c, 0x1d, 0x3c, 0x8, 0x3c, 0xe,
    0x38, 0x7, 0xfc, 0xe, 0x38, 0x2d, 0x2c, 0xe,
    0x3c, 0x3c, 0x3c, 0xd, 0x3c, 0x3f, 0x7c, 0x1c,
    0x3d, 0x2f, 0x2d, 0x34, 0x1f, 0x0, 0xf, 0xd0,
    0xb, 0xd0, 0x0, 0x0, 0x1, 0xbf, 0x0, 0x0,
    /* U+0041 "A" */
    0x0, 0x1e, 0x0, 0x1, 0xfc, 0x0, 0x1c, 0xf0,
    0x0, 0xc3, 0xd0, 0xd, 0xb, 0x42, 0xff, 0xfe,
    0x3, 0xc0, 0x7c, 0xe, 0x0, 0xf0, 0x78, 0x3,
    0xc1, 0xf4, 0xf, 0x47, 0xf0, 0x2f, 0xb, 0x40,
    0x7c,
    /* U+0042 "B" */
    0x6f, 0xf9, 0x7, 0xe1, 0xf4, 0x3c, 0xf, 0x43,
    0xc1, 0xf4, 0x3d, 0xfd, 0x3, 0xc1, 0xd0, 0x3c,
    0x7, 0x83, 0xc0, 0x3c, 0x3d, 0x43, 0xc3, 0xfc,
    0x7c, 0x3f, 0xff, 0x87, 0x5f, 0xd0,
    /* U+0043 "C" */
    0x1, 0xfd, 0x2, 0xd3, 0xd1, 0xe0, 0xb8, 0xf4,
    0x7e, 0x3c, 0xf, 0x1f, 0x0, 0x7, 0xc0, 0x1,
    0xf0, 0x0, 0x7c, 0x0, 0xf, 0x80, 0x63, 0xf9,
    0xb4, 0x7f, 0xfc, 0x7, 0xf8, 0x0, 0x0, 0x0,
    /* U+0044 "D" */
    0x2f, 0xf8, 0x3, 0xe2, 0xf0, 0x3d, 0xb, 0x83,
    0xd0, 0x7c, 0x3d, 0x3, 0xc3, 0xd0, 0x3c, 0x3d,
    0x3, 0xc3, 0xd0, 0x7c, 0x3d, 0xb, 0xc3, 0xe2,
    0xf4, 0x3f, 0xff, 0x7, 0x6f, 0x80,
    /* U+0045 "E" */
    0x0, 0x2f, 0xc0, 0x2f, 0x94, 0x7, 0xc0, 0x0,
    0xf4, 0x0, 0x3f, 0xff, 0x1, 0xf5, 0x40, 0xf,
    0x0, 0x0, 0xf4, 0x0, 0xf, 0x80, 0x0, 0xbe,
    0x59, 0x3, 0xff, 0xc0, 0xb, 0xf4,
    /* U+0046 "F" */
    0x2b, 0xfe, 0x3f, 0x50, 0x2e, 0x0, 0x2e, 0x0,
    0xbf, 0xf4, 0x2e, 0x40, 0x2e, 0x0, 0x2e, 0x0,
    0x2e, 0x0, 0x3e, 0x0, 0x3e, 0x0, 0x38, 0x0,
    /* U+0047 "G" */
    0x2, 0xfe, 0x0, 0xf4, 0x7c, 0x2e, 0xb, 0xc3,
    0xd0, 0x60, 0x7c, 0x0, 0x7, 0xc3, 0xfc, 0xbc,
    0x7, 0xc7, 0xc0, 0x3c, 0x7d, 0x3, 0xc3, 0xf0,
    0x3c, 0x1f, 0xef, 0xc0, 0x2f, 0xe4,
    /* U+0048 "H" */
    0x2f, 0x3, 0xd2, 0xe0, 0x7c, 0x2e, 0x3, 0xc2,
    0xe0, 0x3c, 0x7f, 0xff, 0xc2, 0xe5, 0x7c, 0x2e,
    0x7, 0xc2, 0xe0, 0x7c, 0x2e, 0x7, 0xc2, 0xe0,
    0x7c, 0x2f, 0x7, 0xc3, 0xd0, 0x7c,
    /* U+0049 "I" */
    0x2e, 0x3e, 0x3d, 0x2d, 0x2d, 0x2d, 0x2d, 0x2d,
    0x2d, 0x2e, 0x3e, 0x3d,
    /* U+004A "J" */
    0xb, 0x83, 0xe0, 0xb8, 0x2e, 0xb, 0x42, 0xe0,
    0xb8, 0x2e, 0xb, 0x82, 0xe0, 0xf8, 0x3e, 0xf,
    0x8b, 0xc3, 0x80,
    /* U+004B "K" */
    0x7d, 0x7, 0xc3, 0xd1, 0xe0, 0x3c, 0x78, 0x3,
    0xde, 0x0, 0x3f, 0xe0, 0x3, 0xe2, 0xc0, 0x3c,
    0xf, 0x3, 0xc0, 0xf0, 0x3c, 0xf, 0x3, 0xc0,
    0xf4, 0x3d, 0xf, 0x83, 0x80, 0xf8,
    /* U+004C "L" */
    0x7d, 0x0, 0x7c, 0x0, 0x3c, 0x0, 0x3c, 0x0,
    0x3c, 0x0, 0x3c, 0x0, 0x3c, 0x0, 0x3c, 0x8,
    0x3c, 0xe, 0x3c, 0xf, 0x3e, 0x6f, 0x7f, 0xfe,
    /* U+004D "M" */
    0x2f, 0x40, 0x3f, 0xf, 0xe0, 0x2f, 0xc3, 0xfc,
    0xf, 0xf0, 0xef, 0x3, 0xb8, 0x37, 0xd2, 0x9e,
    0xd, 0xb8, 0xdb, 0x83, 0x5f, 0x72, 0xe0, 0xd3,
    0xf8, 0xb8, 0x34, 0xbd, 0x2e, 0xd, 0x1f, 0xb,
    0x83, 0x43, 0x82, 0xf1, 0xd0, 0xd0, 0xb8,
    /* U+004E "N" */
    0x2f, 0x2, 0xc3, 0xf4, 0x3c, 0x3f, 0x82, 0x83,
    0xfc, 0x28, 0x37, 0xe2, 0x83, 0x5f, 0x28, 0x34,
    0xf6, 0x83, 0x4b, 0xe8, 0x34, 0x7f, 0x83, 0x43,
    0xf8, 0x38, 0x1f, 0xc7, 0x40, 0xf8,
    /* U+004F "O" */
    0x1, 0xfe, 0x0, 0x79, 0xf8, 0xe, 0x3, 0xc3,
    0xd0, 0x3d, 0x7e, 0x2, 0xe7, 0xf0, 0x2e, 0xbc,
    0x2, 0xeb, 0xc0, 0x2e, 0x7c, 0x3, 0xd3, 0xd0,
    0x7c, 0x2f, 0xaf, 0x0, 0x7f, 0x80,
    /* U+0050 "P" */
    0x2f, 0xf9, 0x3, 0xe5, 0xf4, 0x3d, 0x7, 0xc3,
    0xc0, 0x7c, 0x3c, 0xf, 0xc3, 0xcf, 0xf4, 0x3c,
    0x7d, 0x3, 0xc0, 0x0, 0x3c, 0x0, 0x3, 0xd0,
    0x0, 0x3d, 0x0, 0x3, 0xc0, 0x0,
    /* U+0051 "Q" */
    0x1, 0xfd, 0x0, 0x7a, 0xf8, 0xe, 0x7, 0xc3,
    0xd0, 0x3d, 0x7e, 0x2, 0xeb, 0xf0, 0x2e, 0xbd,
    0x2, 0xeb, 0xc0, 0x2e, 0xbc, 0x3, 0xd3, 0xc2,
    0xfc, 0x2f, 0x5f, 0x0, 0xbf, 0xfd, 0x0, 0x1,
    0x40,
    /* U+0052 "R" */
    0x2f, 0xfd, 0x3, 0xe1, 0xf8, 0x3d, 0x7, 0xc3,
    0xd0, 0xfc, 0x3d, 0xff, 0x83, 0xc6, 0xc0, 0x3c,
    0xe, 0x3, 0xc0, 0xf0, 0x3d, 0xf, 0x43, 0xd0,
    0xf8, 0x3d, 0xf, 0xc3, 0xc0, 0x7d,
    /* U+0053 "S" */
    0x7, 0xfd, 0xb, 0x97, 0xd3, 0xc0, 0xb0, 0xf4,
    0x0, 0x3f, 0x90, 0x3, 0xff, 0x40, 0xb, 0xf4,
    0xb4, 0x3f, 0xbc, 0xb, 0xef, 0x2, 0xe7, 0xe6,
    0xf0, 0x6f, 0xe0,
    /* U+0054 "T" */
    0x2f, 0xff, 0xa, 0xfe, 0x0, 0x2d, 0x0, 0xb,
    0x40, 0x2, 0xd0, 0x0, 0xb4, 0x0, 0x2d, 0x0,
    0xf, 0x40, 0x3, 0xd0, 0x0, 0xf4, 0x0, 0x3e,
    0x0, 0xf, 0x40,
    /* U+0055 "U" */
    0x3d, 0x3, 0xd3, 0xd0, 0x7c, 0x3d, 0x7, 0xc3,
    0xd0, 0x7c, 0x3c, 0x7, 0xc3, 0xc0, 0x7c, 0x3c,
    0x7, 0xc3, 0xc0, 0x7c, 0x3c, 0xb, 0xc3, 0xe1,
    0xfc, 0x2f, 0xfb, 0xc0, 0xbd, 0x3c,
    /* U+0056 "V" */
    0x3e, 0x1, 0xb8, 0xbc, 0x7, 0xe0, 0xf4, 0xf,
    0x42, 0xe0, 0x2c, 0x7, 0xc0, 0xf0, 0xf, 0x3,
    0x40, 0x3d, 0x1c, 0x0, 0xb8, 0xd0, 0x1, 0xfb,
    0x0, 0x3, 0xf0, 0x0, 0xb, 0x80, 0x0, 0xc,
    0x0,
    /* U+0057 "W" */
    0x2e, 0x3, 0xd0, 0x2f, 0xb, 0xc0, 0xf8, 0xf,
    0xc0, 0xf0, 0x1f, 0x0, 0xf0, 0x3d, 0x3, 0xc0,
    0x38, 0xb, 0x80, 0xf4, 0xc, 0x0, 0xf0, 0x3e,
    0xb, 0x0, 0x3d, 0x2b, 0xc3, 0x40, 0xb, 0x8c,
    0xf5, 0xc0, 0x1, 0xf9, 0x2e, 0xd0, 0x0, 0x3f,
    0x7, 0xf0, 0x0, 0xf, 0x40, 0xf0, 0x0, 0x1,
    0x80, 0x24, 0x0,
    /* U+0058 "X" */
    0x7, 0xd0, 0x3d, 0x3, 0xf0, 0x78, 0x0, 0xf0,
    0xe0, 0x0, 0xba, 0xc0, 0x0, 0x3f, 0x0, 0x0,
    0x2f, 0x0, 0x0, 0x3f, 0x0, 0x0, 0xa7, 0x80,
    0x1, 0xc3, 0xd0, 0x3, 0x82, 0xf0, 0xb, 0x40,
    0xfc, 0x2e, 0x0, 0x7d,
    /* U+0059 "Y" */
    0x2e, 0x0, 0xfc, 0x2f, 0x0, 0xf0, 0xf, 0x81,
    0xd0, 0x3, 0xc2, 0xc0, 0x2, 0xe3, 0x0, 0x0,
    0xfe, 0x0, 0x0, 0xfc, 0x0, 0x0, 0xb8, 0x0,
    0x0, 0x78, 0x0, 0x0, 0xbc, 0x0, 0x0, 0xbc,
    0x0, 0x0, 0xb4, 0x0,
    /* U+005A "Z" */
    0xf, 0xff, 0xf0, 0x3d, 0x1f, 0x80, 0xc0, 0xbc,
    0x0, 0x3, 0xd0, 0x0, 0x3f, 0x0, 0x1, 0xf0,
    0x0, 0xf, 0x80, 0x0, 0xbc, 0xbc, 0x7, 0xd1,
    0xf0, 0x3f, 0x2, 0xc2, 0xf8, 0x1f, 0xf, 0xff,
    0xf4,
    /* U+005B "[" */
    0x8, 0x38, 0x38, 0x34, 0x34, 0x34, 0x34, 0x34,
    0x34, 0x34, 0x34, 0x34, 0x34, 0x38, 0x2c, 0x0,
    /* U+005C "\\" */
    0x40, 0x0, 0x1, 0xc0, 0x0, 0x2, 0x40, 0x0,
    0x3, 0x0, 0x0, 0x6, 0x0, 0x0, 0xd, 0x0,
    0x0, 0xc, 0x0, 0x0, 0x28, 0x0, 0x0, 0x30,
    0x0, 0x0, 0x70, 0x0, 0x0, 0x90, 0x0, 0x0,
    0xc0, 0x0, 0x2, 0x80, 0x0, 0x3, 0x40, 0x0,
    0x7, 0x0,
    /* U+005D "]" */
    0x10, 0x2c, 0x1d, 0xd, 0xd, 0xd, 0xd, 0xd,
    0xd, 0xd, 0xd, 0xd, 0xd, 0x1d, 0x1d, 0x24,
    /* U+005E "^" */
    0x1f, 0x8, 0x50,
    /* U+005F "_" */
    0x3f, 0xfe, 0x0, 0x0,
    /* U+0061 "a" */
    0x1f, 0xe0, 0x3c, 0x74, 0x14, 0x78, 0xb, 0xf8,
    0x78, 0x78, 0xb4, 0x78, 0xbf, 0x78, 0x3e, 0x3c,
    /* U+0062 "b" */
    0x78, 0x0, 0x7c, 0x0, 0x3c, 0x0, 0x3c, 0x0,
    0x3c, 0xf4, 0x3d, 0xfc, 0x3c, 0x3c, 0x3c, 0x2c,
    0x3c, 0x2c, 0x3c, 0x3c, 0x3c, 0xb0, 0x3f, 0x80,
    /* U+0063 "c" */
    0xb, 0xe0, 0xb1, 0xd3, 0x8b, 0x5d, 0x0, 0xb4,
    0x1, 0xf0, 0x53, 0xff, 0x7, 0xf4,
    /* U+0064 "d" */
    0x0, 0x7c, 0x0, 0x7c, 0x0, 0x3c, 0x0, 0x3c,
    0xb, 0xfc, 0x2d, 0x3c, 0x38, 0x3c, 0x74, 0x3c,
    0xb4, 0x3c, 0x78, 0x3c, 0x3f, 0x7c, 0x2f, 0x3c,
    /* U+0065 "e" */
    0xb, 0xe0, 0xf2, 0xd7, 0x4b, 0x2d, 0x78, 0xbe,
    0x41, 0xe0, 0x43, 0xff, 0x7, 0xf0,
    /* U+0066 "f" */
    0x2, 0x80, 0xf0, 0xf, 0x0, 0xf0, 0x2f, 0xc0,
    0xf0, 0xf, 0x0, 0xf0, 0xf, 0x0, 0xf0, 0xf,
    0x0, 0xf0, 0x1e, 0x2, 0xc0, 0x34, 0x0,
    /* U+0067 "g" */
    0xb, 0xfc, 0xb5, 0xe7, 0x83, 0xad, 0xe, 0xb4,
    0x3a, 0xe0, 0xe7, 0xf7, 0x8b, 0x9e, 0x0, 0x78,
    0x2, 0xe0, 0xf, 0x40, 0x3c, 0x3, 0x80,
    /* U+0068 "h" */
    0x7c, 0x0, 0x7c, 0x0, 0x3c, 0x0, 0x3c, 0x0,
    0x3f, 0xf4, 0x3d, 0x3c, 0x3c, 0x3c, 0x3c, 0x3c,
    0x3c, 0x3c, 0x3c, 0x7c, 0x3c, 0x7c, 0x74, 0x3c,
    /* U+0069 "i" */
    0x28, 0x3c, 0x0, 0x0, 0x2c, 0x3c, 0x3c, 0x3c,
    0x3c, 0x3c, 0x3c, 0x3c,
    /* U+006A "j" */
    0x2, 0x80, 0x3c, 0x0, 0x0, 0x0, 0x2, 0xc0,
    0x3c, 0x3, 0xc0, 0x2c, 0x2, 0xc0, 0x2c, 0x2,
    0xc0, 0x3c, 0x3, 0xc0, 0x3c, 0x7, 0x80, 0xf4,
    0x2d, 0x0,
    /* U+006B "k" */
    0x7c, 0x0, 0x7c, 0x0, 0x3c, 0x0, 0x3c, 0x0,
    0x3c, 0x74, 0x3d, 0xd0, 0x3f, 0x80, 0x3c, 0xb0,
    0x38, 0x74, 0x38, 0x74, 0x3c, 0x78, 0x74, 0x3c,
    /* U+006C "l" */
    0x7c, 0x3c, 0x3c, 0x3c, 0x3c, 0x3c, 0x3c, 0x3c,
    0x3c, 0x3c, 0x3c, 0x2c,
    /* U+006D "m" */
    0x3b, 0xe7, 0xf0, 0x3d, 0xbc, 0x78, 0x38, 0x38,
    0x38, 0x38, 0x38, 0x38, 0x38, 0x38, 0x78, 0x38,
    0x38, 0xb8, 0x78, 0x38, 0xb8, 0x74, 0x74, 0x3c,
    /* U+006E "n" */
    0x3b, 0xe0, 0x3c, 0x78, 0x38, 0x3c, 0x38, 0x38,
    0x38, 0x78, 0x38, 0xb8, 0x7c, 0xb8, 0x74, 0x3c,
    /* U+006F "o" */
    0xb, 0xf8, 0x6, 0xf0, 0x28, 0x3c, 0x74, 0x3c,
    0xb0, 0x2c, 0xb4, 0x3c, 0x78, 0x74, 0x1f, 0xd0,
    /* U+0070 "p" */
    0x7b, 0xe1, 0xf1, 0xd7, 0x83, 0xde, 0xf, 0x74,
    0x3d, 0xd1, 0xf7, 0x7f, 0x5d, 0xb8, 0x74, 0x1,
    0xd0, 0xb, 0x80, 0x2e, 0x0, 0xa0, 0x0,
    /* U+0071 "q" */
    0xb, 0xec, 0x2d, 0x3c, 0x38, 0x3c, 0x74, 0x3c,
    0xb4, 0x3c, 0x78, 0x3c, 0x3f, 0x3d, 0x2f, 0x3c,
    0x0, 0xb8, 0x0, 0x3c, 0x0, 0x3c, 0x0, 0x3c,
    0x0, 0x1c,
    /* U+0072 "r" */
    0x3b, 0xd0, 0xf7, 0xc3, 0x8b, 0xe, 0x2c, 0x38,
    0x0, 0xe0, 0x7, 0x80, 0x1d, 0x0,
    /* U+0073 "s" */
    0x1f, 0xe0, 0xf0, 0x43, 0xc0, 0xb, 0xe0, 0x7,
    0xf2, 0xc3, 0xcb, 0x5e, 0xf, 0xe0,
    /* U+0074 "t" */
    0x1c, 0xf, 0x3, 0xc2, 0xfc, 0x3c, 0xf, 0x3,
    0xc0, 0xf0, 0x3c, 0xf, 0x3, 0xc0,
    /* U+0075 "u" */
    0x78, 0x3c, 0xf1, 0xf3, 0xc3, 0x8e, 0xe, 0x74,
    0x39, 0xd1, 0xe7, 0xdf, 0x8b, 0xde,
    /* U+0076 "v" */
    0x2d, 0x2e, 0x2e, 0x1f, 0xf, 0xe, 0xf, 0xd,
    0xb, 0x5c, 0x7, 0xb4, 0x3, 0xe0, 0x2, 0x80,
    /* U+0077 "w" */
    0x2d, 0x2d, 0x1f, 0x2e, 0x1e, 0x1f, 0xf, 0xf,
    0xf, 0xf, 0xf, 0xe, 0xb, 0xf, 0x4c, 0x7,
    0xab, 0xa8, 0x3, 0xe3, 0xe0, 0x2, 0x82, 0x80,
    /* U+0078 "x" */
    0x7c, 0x2c, 0x3e, 0x70, 0xf, 0xd0, 0x7, 0xc0,
    0x7, 0xd0, 0xe, 0xf0, 0xf8, 0xb8, 0xf0, 0x3d,
    /* U+0079 "y" */
    0x2c, 0x1f, 0xb, 0x83, 0xc0, 0xf0, 0xf0, 0x3c,
    0x34, 0x7, 0x9c, 0x0, 0xfd, 0x0, 0x2f, 0x0,
    0x7, 0x40, 0x1, 0xc0, 0x0, 0xe0, 0x0, 0x38,
    0x0, 0x2d, 0x0, 0x2, 0x80, 0x0,
    /* U+007A "z" */
    0x3f, 0xf9, 0x83, 0xc0, 0x2d, 0x1, 0xf0, 0xf,
    0x0, 0xb8, 0xe7, 0xc7, 0xff, 0xfc,
    /* U+007B "{" */
    0x9, 0x2c, 0x3c, 0x3c, 0x2c, 0x3c, 0x38, 0xb0,
    0x34, 0x3c, 0x2c, 0x2c, 0x3c, 0x3c, 0x1c, 0x0,
    /* U+007C "|" */
    0x4d, 0xdd, 0xdd, 0xdd, 0xdd, 0xdd, 0xdd, 0xc0,
    /* U+007D "}" */
    0x10, 0xb, 0x1, 0xd0, 0x74, 0x1d, 0x7, 0x40,
    0xd0, 0x28, 0x7, 0x3, 0x41, 0xd0, 0x74, 0x1d,
    0x7, 0x41, 0xc0, 0x90,
    /* U+007E "~" */
    0x2a, 0x40, 0x0,
    /* U+00C0 "À" */
    0x0, 0x24, 0x0, 0x0, 0xb0, 0x0, 0x0, 0x50,
    0x0, 0x0, 0x0, 0x0, 0x1e, 0x0, 0x1, 0xbc,
    0x0, 0x18, 0xf0, 0x0, 0xc2, 0xd0, 0xd, 0xb,
    0x42, 0xff, 0xfe, 0x3, 0xc0, 0x7c, 0xe, 0x0,
    0xf0, 0x78, 0x3, 0xc1, 0xf4, 0xf, 0x47, 0xf0,
    0x2f, 0xb, 0x40, 0x7c,
    /* U+00C2 "Â" */
    0x0, 0x18, 0x0, 0x0, 0xf8, 0x0, 0x6, 0x30,
    0x0, 0x0, 0x0, 0x0, 0x1e, 0x0, 0x1, 0x7c,
    0x0, 0x14, 0xf0, 0x0, 0xc2, 0xd0, 0xd, 0xb,
    0x42, 0xff, 0xfe, 0x3, 0xc0, 0x7c, 0xe, 0x0,
    0xf0, 0x78, 0x3, 0xc1, 0xf4, 0xf, 0x47, 0xf0,
    0x2f, 0xb, 0x40, 0x7c,
    /* U+00C4 "Ä" */
    0x0, 0x0, 0x0, 0x2, 0xcb, 0x0, 0x1, 0x4,
    0x0, 0x0, 0x0, 0x0, 0x0, 0x0, 0x0, 0x78,
    0x0, 0x7, 0xf0, 0x0, 0x73, 0xc0, 0x3, 0xf,
    0x40, 0x34, 0x2d, 0xb, 0xff, 0xf8, 0xf, 0x1,
    0xf0, 0x38, 0x3, 0xc1, 0xe0, 0xf, 0x7, 0xd0,
    0x3d, 0x1f, 0xc0, 0xbc, 0x2d, 0x1, 0xf0,
    /* U+00C6 "Æ" */
    0x0, 0x7, 0x42, 0xfc, 0x0, 0x2f, 0xdf, 0x98,
    0x0, 0xb3, 0xfc, 0x0, 0x1, 0xc3, 0xf4, 0x0,
    0x3, 0x42, 0xff, 0xf0, 0x3f, 0xff, 0xf5, 0x40,
    0xe, 0x2, 0xf0, 0x0, 0xd, 0x1, 0xf0, 0x0,
    0x1d, 0x0, 0xf8, 0x0, 0x2f, 0x0, 0xfe, 0x8,
    0x1f, 0xc0, 0xff, 0xfc, 0xf, 0x40, 0xbf, 0xf0,
    /* U+00C7 "Ç" */
    0x1, 0xfd, 0x3, 0xd3, 0xd1, 0xe0, 0xb8, 0xf0,
    0x7e, 0x3c, 0xf, 0x1f, 0x0, 0x7, 0xc0, 0x1,
    0xf0, 0x0, 0x7c, 0x0, 0x4f, 0xc0, 0xa3, 0xff,
    0xf4, 0x3f, 0xf8, 0x1, 0xe4, 0x0, 0x24, 0x0,
    0x9, 0x0,
    /* U+00C8 "È" */
    0x0, 0x1c, 0x0, 0x0, 0x90, 0x0, 0x1, 0x0,
    0x0, 0x0, 0x0, 0x2f, 0xc0, 0x2f, 0x94, 0x7,
    0xc0, 0x0, 0xf4, 0x0, 0x3f, 0xff, 0x1, 0xf5,
    0x40, 0xf, 0x0, 0x0, 0xf4, 0x0, 0xf, 0x80,
    0x0, 0xbe, 0x59, 0x3, 0xff, 0xc0, 0xb, 0xf4,
    /* U+00C9 "É" */
    0x0, 0x1, 0x0, 0x0, 0x70, 0x0, 0x4, 0x0,
    0x0, 0x0, 0x0, 0x2f, 0xc0, 0x2f, 0x94, 0x7,
    0xc0, 0x0, 0xf4, 0x0, 0x3f, 0xff, 0x1, 0xf5,
    0x40, 0xf, 0x0, 0x0, 0xf4, 0x0, 0xf, 0x80,
    0x0, 0xbe, 0x59, 0x3, 0xff, 0xc0, 0xb, 0xf4,
    /* U+00CA "Ê" */
    0x0, 0x5, 0x0, 0x2, 0xb4, 0x0, 0x10, 0x40,
    0x0, 0x0, 0x0, 0x2f, 0xc0, 0x2f, 0x94, 0x7,
    0xc0, 0x0, 0xf4, 0x0, 0x3f, 0xff, 0x1, 0xf5,
    0x40, 0xf, 0x0, 0x0, 0xf4, 0x0, 0xf, 0x80,
    0x0, 0xbe, 0x59, 0x3, 0xff, 0xc0, 0xb, 0xf4,
    /* U+00CB "Ë" */
    0x0, 0x0, 0x0, 0xe, 0x38, 0x0, 0x40, 0x40,
    0x0, 0x0, 0x0, 0x2f, 0xc0, 0x2f, 0x94, 0x7,
    0xc0, 0x0, 0xf4, 0x0, 0x3f, 0xff, 0x1, 0xf5,
    0x40, 0xf, 0x0, 0x0, 0xf4, 0x0, 0xf, 0x80,
    0x0, 0xbe, 0x59, 0x3, 0xff, 0xc0, 0xb, 0xf4,
    /* U+00CE "Î" */
    0x4, 0xe, 0xc0, 0x0, 0x0, 0x2e, 0xf, 0x83,
    0xd0, 0xb4, 0x2d, 0xb, 0x42, 0xd0, 0xb4, 0x2d,
    0xb, 0x83, 0xe0, 0xf4,
    /* U+00CF "Ï" */
    0x0, 0x3, 0x4e, 0x14, 0x10, 0x0, 0xb, 0x80,
    0xf8, 0xf, 0x40, 0xb4, 0xb, 0x40, 0xb4, 0xb,
    0x40, 0xb4, 0xb, 0x40, 0xb8, 0xf, 0x80, 0xf4,
    /* U+00D4 "Ô" */
    0x0, 0x50, 0x0, 0xe, 0xc0, 0x0, 0x0, 0x0,
    0x0, 0x0, 0x1, 0xfe, 0x0, 0x79, 0xf8, 0xe,
    0x3, 0xc3, 0xd0, 0x3d, 0x7e, 0x2, 0xe7, 0xf0,
    0x2e, 0xbc, 0x2, 0xeb, 0xc0, 0x2e, 0x7c, 0x3,
    0xd3, 0xd0, 0x7c, 0x2f, 0xaf, 0x0, 0x7f, 0x80,
    /* U+00D6 "Ö" */
    0x0, 0x0, 0x0, 0x38, 0xe0, 0x1, 0x1, 0x0,
    0x0, 0x0, 0x1, 0xfe, 0x0, 0x79, 0xf8, 0xe,
    0x3, 0xc3, 0xd0, 0x3d, 0x7e, 0x2, 0xe7, 0xf0,
    0x2e, 0xbc, 0x2, 0xeb, 0xc0, 0x2e, 0x7c, 0x3,
    0xd3, 0xd0, 0x7c, 0x2f, 0xaf, 0x0, 0x7f, 0x80,
    /* U+00DB "Û" */
    0x0, 0x50, 0x0, 0x1e, 0x80, 0x1, 0x4, 0x0,
    0x0, 0x0, 0x3d, 0x3, 0xd3, 0xd0, 0x7c, 0x3d,
    0x7, 0xc3, 0xd0, 0x7c, 0x3c, 0x7, 0xc3, 0xc0,
    0x7c, 0x3c, 0x7, 0xc3, 0xc0, 0x7c, 0x3c, 0xb,
    0xc3, 0xe1, 0xfc, 0x2f, 0xfb, 0xc0, 0xbd, 0x3c,
    /* U+00DC "Ü" */
    0x0, 0x0, 0x0, 0x74, 0xd0, 0x1, 0x5, 0x0,
    0x0, 0x0, 0x3d, 0x3, 0xd3, 0xd0, 0x7c, 0x3d,
    0x7, 0xc3, 0xd0, 0x7c, 0x3c, 0x7, 0xc3, 0xc0,
    0x7c, 0x3c, 0x7, 0xc3, 0xc0, 0x7c, 0x3c, 0xb,
    0xc3, 0xe1, 0xfc, 0x2f, 0xfb, 0xc0, 0xbd, 0x3c,
    /* U+00E0 "à" */
    0x1, 0x0, 0x2, 0x80, 0x0, 0x0, 0x0, 0x0,
    0x1f, 0xe0, 0x3c, 0x74, 0x14, 0x78, 0xb, 0xf8,
    0x78, 0x78, 0xb4, 0x78, 0xbf, 0x78, 0x3e, 0x3c,
    /* U+00E2 "â" */
    0x1, 0x40, 0x7, 0xa0, 0x4, 0x10, 0x0, 0x0,
    0x1f, 0xe0, 0x3c, 0x74, 0x14, 0x78, 0xb, 0xf8,
    0x78, 0x78, 0xb4, 0x78, 0xbf, 0x78, 0x3e, 0x3c,
    /* U+00E4 "ä" */
    0x0, 0x0, 0x2c, 0x70, 0x4, 0x10, 0x0, 0x0,
    0x1f, 0xe0, 0x3c, 0x74, 0x14, 0x78, 0xb, 0xf8,
    0x78, 0x78, 0xb4, 0x78, 0xbf, 0x78, 0x3e, 0x3c,
    /* U+00E6 "æ" */
    0x1f, 0xeb, 0xf0, 0xf1, 0xf0, 0xe1, 0x47, 0xc7,
    0x82, 0xff, 0x7c, 0x78, 0x7e, 0x42, 0xd1, 0xf0,
    0x1b, 0xf7, 0xfb, 0x4f, 0x8f, 0xf4,
    /* U+00E7 "ç" */
    0xb, 0xe0, 0xb1, 0xd3, 0x8b, 0x5d, 0x0, 0xb4,
    0x1, 0xf0, 0x53, 0xff, 0x7, 0xf4, 0x2, 0x0,
    0x4, 0x0,
    /* U+00E8 "è" */
    0x0, 0x0, 0x1c, 0x0, 0x0, 0x0, 0x0, 0xb,
    0xe0, 0xf2, 0xd7, 0x4b, 0x2d, 0x78, 0xbe, 0x41,
    0xe0, 0x43, 0xff, 0x7, 0xf0,
    /* U+00E9 "é" */
    0x0, 0x40, 0xa, 0x0, 0x0, 0x0, 0x0, 0xb,
    0xe0, 0xf2, 0xd7, 0x4b, 0x2d, 0x78, 0xbe, 0x41,
    0xe0, 0x43, 0xff, 0x7, 0xf0,
    /* U+00EA "ê" */
    0x1, 0x0, 0x2f, 0x0, 0x85, 0x0, 0x0, 0xb,
    0xe0, 0xf2, 0xd7, 0x4b, 0x2d, 0x78, 0xbe, 0x41,
    0xe0, 0x43, 0xff, 0x7, 0xf0,
    /* U+00EB "ë" */
    0x0, 0x0, 0xe3, 0xc0, 0x41, 0x0, 0x0, 0xb,
    0xe0, 0xf2, 0xd7, 0x4b, 0x2d, 0x78, 0xbe, 0x41,
    0xe0, 0x43, 0xff, 0x7, 0xf0,
    /* U+00EE "î" */
    0x5, 0xa, 0xd1, 0x4, 0x0, 0xb, 0x3, 0xc0,
    0xf0, 0x3c, 0xf, 0x3, 0xc0, 0xf0, 0x3c,
    /* U+00EF "ï" */
    0x0, 0x7, 0x1c, 0x10, 0x40, 0x0, 0xb, 0x0,
    0xf0, 0xf, 0x0, 0xf0, 0xf, 0x0, 0xf0, 0xf,
    0x0, 0xf0,
    /* U+00F4 "ô" */
    0x1, 0x40, 0x3, 0xa0, 0x4, 0x0, 0x0, 0x0,
    0xb, 0xf8, 0x6, 0xf0, 0x28, 0x3c, 0x74, 0x3c,
    0xb0, 0x2c, 0xb4, 0x3c, 0x78, 0x74, 0x1f, 0xd0,
    /* U+00F6 "ö" */
    0x0, 0x0, 0x1c, 0x34, 0x4, 0x10, 0x0, 0x0,
    0xb, 0xf8, 0x6, 0xf0, 0x28, 0x3c, 0x74, 0x3c,
    0xb0, 0x2c, 0xb4, 0x3c, 0x78, 0x74, 0x1f, 0xd0,
    /* U+00FB "û" */
    0x1, 0x40, 0x1f, 0x40, 0x41, 0x0, 0x0, 0x78,
    0x3c, 0xf1, 0xf3, 0xc3, 0x8e, 0xe, 0x74, 0x39,
    0xd1, 0xe7, 0xdf, 0x8b, 0xde,
    /* U+00FC "ü" */
    0x0, 0x0, 0xb2, 0xc0, 0x41, 0x0, 0x0, 0x78,
    0x3c, 0xf1, 0xf3, 0xc3, 0x8e, 0xe, 0x74, 0x39,
    0xd1, 0xe7, 0xdf, 0x8b, 0xde,
    /* U+00FF "ÿ" */
    0x0, 0x0, 0x3, 0x8b, 0x0, 0x10, 0x40, 0x0,
    0x0, 0x2c, 0x1f, 0xb, 0x83, 0xc0, 0xf0, 0xf0,
    0x3c, 0x34, 0x7, 0x9c, 0x0, 0xfd, 0x0, 0x2f,
    0x0, 0x7, 0x40, 0x1, 0xc0, 0x0, 0xe0, 0x0,
    0x38, 0x0, 0x2d, 0x0, 0x2, 0x80, 0x0,
    /* U+0152 "Œ" */
    0x1, 0xfd, 0x7, 0xf8, 0x1d, 0x7e, 0xf9, 0x51,
    0xe0, 0x7f, 0x80, 0xf, 0x40, 0xfc, 0x0, 0x7f,
    0x3, 0xff, 0xe2, 0xf8, 0xb, 0x94, 0xb, 0xc0,
    0x2e, 0x0, 0x2f, 0x0, 0xfc, 0x0, 0x7c, 0x3,
    0xf4, 0x0, 0xf4, 0x1f, 0xf5, 0x62, 0xfa, 0xfb,
    0xff, 0x81, 0xfe, 0x7, 0xf8,
    /* U+0153 "œ" */
    0x7, 0xfe, 0xf8, 0x6, 0xff, 0x1e, 0x28, 0x3e,
    0x1d, 0x34, 0x3f, 0x7c, 0x74, 0x3f, 0x90, 0x74,
    0x3f, 0x1, 0x3c, 0x7f, 0xec, 0x1f, 0xe3, 0xf4,
    /* U+0178 "Ÿ" */
    0x0, 0x0, 0x0, 0x1, 0xc7, 0x40, 0x0, 0x41,
    0x0, 0x0, 0x0, 0x0, 0x0, 0x0, 0x0, 0x2e,
    0x0, 0xfc, 0x2f, 0x0, 0xf0, 0xf, 0x81, 0xd0,
    0x3, 0xc2, 0xc0, 0x2, 0xe3, 0x0, 0x0, 0xfe,
    0x0, 0x0, 0xfc, 0x0, 0x0, 0xb8, 0x0, 0x0,
    0x78, 0x0, 0x0, 0xbc, 0x0, 0x0, 0xbc, 0x0,
    0x0, 0xb4, 0x0
};
/*---------------------
 *  GLYPH DESCRIPTION
 *--------------------*/
static const lv_font_fmt_txt_glyph_dsc_t aladin_glyph_dsc[] = {
    {.bitmap_index = 0, .adv_w = 0, .box_w = 0, .box_h = 0, .ofs_x = 0, .ofs_y = 0} /* id = 0 reserved */,
    {.bitmap_index = 0, .adv_w = 52, .box_w = 0, .box_h = 0, .ofs_x = 0, .ofs_y = 0},
    {.bitmap_index = 0, .adv_w = 69, .box_w = 4, .box_h = 12, .ofs_x = 0, .ofs_y = 0},
    {.bitmap_index = 12, .adv_w = 79, .box_w = 6, .box_h = 4, .ofs_x = 0, .ofs_y = 8},
    {.bitmap_index = 18, .adv_w = 170, .box_w = 10, .box_h = 9, .ofs_x = 0, .ofs_y = 1},
    {.bitmap_index = 41, .adv_w = 149, .box_w = 10, .box_h = 15, .ofs_x = 0, .ofs_y = -1},
    {.bitmap_index = 79, .adv_w = 167, .box_w = 10, .box_h = 12, .ofs_x = 0, .ofs_y = 0},
    {.bitmap_index = 109, .adv_w = 166, .box_w = 11, .box_h = 12, .ofs_x = 0, .ofs_y = 0},
    {.bitmap_index = 142, .adv_w = 40, .box_w = 3, .box_h = 4, .ofs_x = 0, .ofs_y = 8},
    {.bitmap_index = 145, .adv_w = 63, .box_w = 5, .box_h = 16, .ofs_x = 0, .ofs_y = -2},
    {.bitmap_index = 165, .adv_w = 63, .box_w = 5, .box_h = 16, .ofs_x = -1, .ofs_y = -2},
    {.bitmap_index = 185, .adv_w = 68, .box_w = 4, .box_h = 4, .ofs_x = 0, .ofs_y = 8},
    {.bitmap_index = 189, .adv_w = 149, .box_w = 9, .box_h = 9, .ofs_x = 0, .ofs_y = 2},
    {.bitmap_index = 210, .adv_w = 62, .box_w = 3, .box_h = 4, .ofs_x = 0, .ofs_y = -2},
    {.bitmap_index = 213, .adv_w = 138, .box_w = 8, .box_h = 2, .ofs_x = 0, .ofs_y = 3},
    {.bitmap_index = 217, .adv_w = 63, .box_w = 3, .box_h = 2, .ofs_x = 0, .ofs_y = 0},
    {.bitmap_index = 219, .adv_w = 111, .box_w = 11, .box_h = 15, .ofs_x = -2, .ofs_y = -1},
    {.bitmap_index = 261, .adv_w = 154, .box_w = 10, .box_h = 12, .ofs_x = 0, .ofs_y = 0},
    {.bitmap_index = 291, .adv_w = 78, .box_w = 4, .box_h = 12, .ofs_x = 0, .ofs_y = 0},
    {.bitmap_index = 303, .adv_w = 139, .box_w = 9, .box_h = 12, .ofs_x = 0, .ofs_y = 0},
    {.bitmap_index = 330, .adv_w = 137, .box_w = 9, .box_h = 12, .ofs_x = 0, .ofs_y = 0},
    {.bitmap_index = 357, .adv_w = 139, .box_w = 9, .box_h = 12, .ofs_x = 0, .ofs_y = 0},
    {.bitmap_index = 384, .adv_w = 139, .box_w = 9, .box_h = 12, .ofs_x = 0, .ofs_y = 0},
    {.bitmap_index = 411, .adv_w = 141, .box_w = 9, .box_h = 12, .ofs_x = 0, .ofs_y = 0},
    {.bitmap_index = 438, .adv_w = 116, .box_w = 8, .box_h = 12, .ofs_x = 0, .ofs_y = 0},
    {.bitmap_index = 462, .adv_w = 143, .box_w = 9, .box_h = 12, .ofs_x = 0, .ofs_y = 0},
    {.bitmap_index = 489, .adv_w = 143, .box_w = 9, .box_h = 12, .ofs_x = 0, .ofs_y = 0},
    {.bitmap_index = 516, .adv_w = 62, .box_w = 3, .box_h = 8, .ofs_x = 0, .ofs_y = 0},
    {.bitmap_index = 522, .adv_w = 62, .box_w = 3, .box_h = 10, .ofs_x = 0, .ofs_y = -2},
    {.bitmap_index = 530, .adv_w = 121, .box_w = 8, .box_h = 9, .ofs_x = 0, .ofs_y = 1},
    {.bitmap_index = 548, .adv_w = 144, .box_w = 9, .box_h = 5, .ofs_x = 0, .ofs_y = 3},
    {.bitmap_index = 560, .adv_w = 121, .box_w = 8, .box_h = 9, .ofs_x = 0, .ofs_y = 1},
    {.bitmap_index = 578, .adv_w = 124, .box_w = 8, .box_h = 12, .ofs_x = 0, .ofs_y = 0},
    {.bitmap_index = 602, .adv_w = 263, .box_w = 16, .box_h = 14, .ofs_x = 0, .ofs_y = -3},
    {.bitmap_index = 658, .adv_w = 165, .box_w = 11, .box_h = 12, .ofs_x = 0, .ofs_y = 0},
    {.bitmap_index = 691, .adv_w = 150, .box_w = 10, .box_h = 12, .ofs_x = 0, .ofs_y = 0},
    {.bitmap_index = 721, .adv_w = 146, .box_w = 9, .box_h = 14, .ofs_x = 0, .ofs_y = -2},
    {.bitmap_index = 753, .adv_w = 151, .box_w = 10, .box_h = 12, .ofs_x = 0, .ofs_y = 0},
    {.bitmap_index = 783, .adv_w = 138, .box_w = 10, .box_h = 12, .ofs_x = -1, .ofs_y = 0},
    {.bitmap_index = 813, .adv_w = 117, .box_w = 8, .box_h = 12, .ofs_x = 0, .ofs_y = 0},
    {.bitmap_index = 837, .adv_w = 155, .box_w = 10, .box_h = 12, .ofs_x = 0, .ofs_y = 0},
    {.bitmap_index = 867, .adv_w = 158, .box_w = 10, .box_h = 12, .ofs_x = 0, .ofs_y = 0},
    {.bitmap_index = 897, .adv_w = 71, .box_w = 4, .box_h = 12, .ofs_x = 0, .ofs_y = 0},
    {.bitmap_index = 909, .adv_w = 71, .box_w = 5, .box_h = 15, .ofs_x = -1, .ofs_y = -3},
    {.bitmap_index = 928, .adv_w = 143, .box_w = 10, .box_h = 12, .ofs_x = 0, .ofs_y = 0},
    {.bitmap_index = 958, .adv_w = 128, .box_w = 8, .box_h = 12, .ofs_x = 0, .ofs_y = 0},
    {.bitmap_index = 982, .adv_w = 200, .box_w = 13, .box_h = 12, .ofs_x = 0, .ofs_y = 0},
    {.bitmap_index = 1021, .adv_w = 153, .box_w = 10, .box_h = 12, .ofs_x = 0, .ofs_y = 0},
    {.bitmap_index = 1051, .adv_w = 162, .box_w = 10, .box_h = 12, .ofs_x = 0, .ofs_y = 0},
    {.bitmap_index = 1081, .adv_w = 143, .box_w = 10, .box_h = 12, .ofs_x = 0, .ofs_y = 0},
    {.bitmap_index = 1111, .adv_w = 162, .box_w = 10, .box_h = 13, .ofs_x = 0, .ofs_y = -1},
    {.bitmap_index = 1144, .adv_w = 152, .box_w = 10, .box_h = 12, .ofs_x = 0, .ofs_y = 0},
    {.bitmap_index = 1174, .adv_w = 147, .box_w = 9, .box_h = 12, .ofs_x = 0, .ofs_y = 0},
    {.bitmap_index = 1201, .adv_w = 115, .box_w = 9, .box_h = 12, .ofs_x = -1, .ofs_y = 0},
    {.bitmap_index = 1228, .adv_w = 157, .box_w = 10, .box_h = 12, .ofs_x = 0, .ofs_y = 0},
    {.bitmap_index = 1258, .adv_w = 150, .box_w = 11, .box_h = 12, .ofs_x = -1, .ofs_y = 0},
    {.bitmap_index = 1291, .adv_w = 240, .box_w = 17, .box_h = 12, .ofs_x = -1, .ofs_y = 0},
    {.bitmap_index = 1342, .adv_w = 170, .box_w = 12, .box_h = 12, .ofs_x = -1, .ofs_y = 0},
    {.bitmap_index = 1378, .adv_w = 152, .box_w = 12, .box_h = 12, .ofs_x = -1, .ofs_y = 0},
    {.bitmap_index = 1414, .adv_w = 156, .box_w = 11, .box_h = 12, .ofs_x = -1, .ofs_y = 0},
    {.bitmap_index = 1447, .adv_w = 54, .box_w = 4, .box_h = 16, .ofs_x = 0, .ofs_y = -2},
    {.bitmap_index = 1463, .adv_w = 168, .box_w = 11, .box_h = 15, .ofs_x = -1, .ofs_y = -1},
    {.bitmap_index = 1505, .adv_w = 53, .box_w = 4, .box_h = 16, .ofs_x = -1, .ofs_y = -2},
    {.bitmap_index = 1521, .adv_w = 87, .box_w = 5, .box_h = 2, .ofs_x = 0, .ofs_y = 3},
    {.bitmap_index = 1524, .adv_w = 138, .box_w = 8, .box_h = 2, .ofs_x = 0, .ofs_y = -2},
    {.bitmap_index = 1528, .adv_w = 114, .box_w = 8, .box_h = 8, .ofs_x = 0, .ofs_y = 0},
    {.bitmap_index = 1544, .adv_w = 121, .box_w = 8, .box_h = 12, .ofs_x = 0, .ofs_y = 0},
    {.bitmap_index = 1568, .adv_w = 109, .box_w = 7, .box_h = 8, .ofs_x = 0, .ofs_y = 0},
    {.bitmap_index = 1582, .adv_w = 119, .box_w = 8, .box_h = 12, .ofs_x = 0, .ofs_y = 0},
    {.bitmap_index = 1606, .adv_w = 106, .box_w = 7, .box_h = 8, .ofs_x = 0, .ofs_y = 0},
    {.bitmap_index = 1620, .adv_w = 64, .box_w = 6, .box_h = 15, .ofs_x = -1, .ofs_y = -3},
    {.bitmap_index = 1643, .adv_w = 115, .box_w = 7, .box_h = 13, .ofs_x = 0, .ofs_y = -5},
    {.bitmap_index = 1666, .adv_w = 119, .box_w = 8, .box_h = 12, .ofs_x = 0, .ofs_y = 0},
    {.bitmap_index = 1690, .adv_w = 60, .box_w = 4, .box_h = 12, .ofs_x = 0, .ofs_y = 0},
    {.bitmap_index = 1702, .adv_w = 60, .box_w = 6, .box_h = 17, .ofs_x = -2, .ofs_y = -5},
    {.bitmap_index = 1728, .adv_w = 114, .box_w = 8, .box_h = 12, .ofs_x = 0, .ofs_y = 0},
    {.bitmap_index = 1752, .adv_w = 58, .box_w = 4, .box_h = 12, .ofs_x = 0, .ofs_y = 0},
    {.bitmap_index = 1764, .adv_w = 178, .box_w = 12, .box_h = 8, .ofs_x = 0, .ofs_y = 0},
    {.bitmap_index = 1788, .adv_w = 115, .box_w = 8, .box_h = 8, .ofs_x = 0, .ofs_y = 0},
    {.bitmap_index = 1804, .adv_w = 121, .box_w = 8, .box_h = 8, .ofs_x = 0, .ofs_y = 0},
    {.bitmap_index = 1820, .adv_w = 118, .box_w = 7, .box_h = 13, .ofs_x = 0, .ofs_y = -5},
    {.bitmap_index = 1843, .adv_w = 124, .box_w = 8, .box_h = 13, .ofs_x = 0, .ofs_y = -5},
    {.bitmap_index = 1869, .adv_w = 102, .box_w = 7, .box_h = 8, .ofs_x = 0, .ofs_y = 0},
    {.bitmap_index = 1883, .adv_w = 99, .box_w = 7, .box_h = 8, .ofs_x = 0, .ofs_y = 0},
    {.bitmap_index = 1897, .adv_w = 65, .box_w = 5, .box_h = 11, .ofs_x = 0, .ofs_y = 0},
    {.bitmap_index = 1911, .adv_w = 116, .box_w = 7, .box_h = 8, .ofs_x = 0, .ofs_y = 0},
    {.bitmap_index = 1925, .adv_w = 111, .box_w = 8, .box_h = 8, .ofs_x = -1, .ofs_y = 0},
    {.bitmap_index = 1941, .adv_w = 176, .box_w = 12, .box_h = 8, .ofs_x = -1, .ofs_y = 0},
    {.bitmap_index = 1965, .adv_w = 119, .box_w = 8, .box_h = 8, .ofs_x = 0, .ofs_y = 0},
    {.bitmap_index = 1981, .adv_w = 112, .box_w = 9, .box_h = 13, .ofs_x = -1, .ofs_y = -5},
    {.bitmap_index = 2011, .adv_w = 110, .box_w = 7, .box_h = 8, .ofs_x = 0, .ofs_y = 0},
    {.bitmap_index = 2025, .adv_w = 56, .box_w = 4, .box_h = 16, .ofs_x = 0, .ofs_y = -2},
    {.bitmap_index = 2041, .adv_w = 51, .box_w = 2, .box_h = 15, .ofs_x = 1, .ofs_y = -1},
    {.bitmap_index = 2049, .adv_w = 56, .box_w = 5, .box_h = 16, .ofs_x = -1, .ofs_y = -2},
    {.bitmap_index = 2069, .adv_w = 92, .box_w = 5, .box_h = 2, .ofs_x = 0, .ofs_y = 3},
    {.bitmap_index = 2072, .adv_w = 165, .box_w = 11, .box_h = 16, .ofs_x = 0, .ofs_y = 0},
    {.bitmap_index = 2116, .adv_w = 165, .box_w = 11, .box_h = 16, .ofs_x = 0, .ofs_y = 0},
    {.bitmap_index = 2160, .adv_w = 165, .box_w = 11, .box_h = 17, .ofs_x = 0, .ofs_y = 0},
    {.bitmap_index = 2207, .adv_w = 247, .box_w = 16, .box_h = 12, .ofs_x = 0, .ofs_y = 0},
    {.bitmap_index = 2255, .adv_w = 146, .box_w = 9, .box_h = 15, .ofs_x = 0, .ofs_y = -3},
    {.bitmap_index = 2289, .adv_w = 138, .box_w = 10, .box_h = 16, .ofs_x = -1, .ofs_y = 0},
    {.bitmap_index = 2329, .adv_w = 138, .box_w = 10, .box_h = 16, .ofs_x = -1, .ofs_y = 0},
    {.bitmap_index = 2369, .adv_w = 138, .box_w = 10, .box_h = 16, .ofs_x = -1, .ofs_y = 0},
    {.bitmap_index = 2409, .adv_w = 138, .box_w = 10, .box_h = 16, .ofs_x = -1, .ofs_y = 0},
    {.bitmap_index = 2449, .adv_w = 71, .box_w = 5, .box_h = 16, .ofs_x = 0, .ofs_y = 0},
    {.bitmap_index = 2469, .adv_w = 71, .box_w = 6, .box_h = 16, .ofs_x = -1, .ofs_y = 0},
    {.bitmap_index = 2493, .adv_w = 162, .box_w = 10, .box_h = 16, .ofs_x = 0, .ofs_y = 0},
    {.bitmap_index = 2533, .adv_w = 162, .box_w = 10, .box_h = 16, .ofs_x = 0, .ofs_y = 0},
    {.bitmap_index = 2573, .adv_w = 157, .box_w = 10, .box_h = 16, .ofs_x = 0, .ofs_y = 0},
    {.bitmap_index = 2613, .adv_w = 157, .box_w = 10, .box_h = 16, .ofs_x = 0, .ofs_y = 0},
    {.bitmap_index = 2653, .adv_w = 114, .box_w = 8, .box_h = 12, .ofs_x = 0, .ofs_y = 0},
    {.bitmap_index = 2677, .adv_w = 114, .box_w = 8, .box_h = 12, .ofs_x = 0, .ofs_y = 0},
    {.bitmap_index = 2701, .adv_w = 114, .box_w = 8, .box_h = 12, .ofs_x = 0, .ofs_y = 0},
    {.bitmap_index = 2725, .adv_w = 176, .box_w = 11, .box_h = 8, .ofs_x = 0, .ofs_y = 0},
    {.bitmap_index = 2747, .adv_w = 109, .box_w = 7, .box_h = 10, .ofs_x = 0, .ofs_y = -2},
    {.bitmap_index = 2765, .adv_w = 107, .box_w = 7, .box_h = 12, .ofs_x = 0, .ofs_y = 0},
    {.bitmap_index = 2786, .adv_w = 106, .box_w = 7, .box_h = 12, .ofs_x = 0, .ofs_y = 0},
    {.bitmap_index = 2807, .adv_w = 106, .box_w = 7, .box_h = 12, .ofs_x = 0, .ofs_y = 0},
    {.bitmap_index = 2828, .adv_w = 106, .box_w = 7, .box_h = 12, .ofs_x = 0, .ofs_y = 0},
    {.bitmap_index = 2849, .adv_w = 60, .box_w = 5, .box_h = 12, .ofs_x = -1, .ofs_y = 0},
    {.bitmap_index = 2864, .adv_w = 60, .box_w = 6, .box_h = 12, .ofs_x = -1, .ofs_y = 0},
    {.bitmap_index = 2882, .adv_w = 121, .box_w = 8, .box_h = 12, .ofs_x = 0, .ofs_y = 0},
    {.bitmap_index = 2906, .adv_w = 121, .box_w = 8, .box_h = 12, .ofs_x = 0, .ofs_y = 0},
    {.bitmap_index = 2930, .adv_w = 116, .box_w = 7, .box_h = 12, .ofs_x = 0, .ofs_y = 0},
    {.bitmap_index = 2951, .adv_w = 116, .box_w = 7, .box_h = 12, .ofs_x = 0, .ofs_y = 0},
    {.bitmap_index = 2972, .adv_w = 112, .box_w = 9, .box_h = 17, .ofs_x = -1, .ofs_y = -5},
    {.bitmap_index = 3011, .adv_w = 243, .box_w = 15, .box_h = 12, .ofs_x = 0, .ofs_y = 0},
    {.bitmap_index = 3056, .adv_w = 190, .box_w = 12, .box_h = 8, .ofs_x = 0, .ofs_y = 0},
    {.bitmap_index = 3080, .adv_w = 152, .box_w = 12, .box_h = 17, .ofs_x = -1, .ofs_y = 0}
};
/*---------------------
 *  CHARACTER MAPPING
 *--------------------*/
static const uint16_t aladin_unicode_list_2[] = {
    0x0, 0x2, 0x4, 0x6, 0x7, 0x8, 0x9, 0xa,
    0xb, 0xe, 0xf, 0x14, 0x16, 0x1b, 0x1c, 0x20,
    0x22, 0x24, 0x26, 0x27, 0x28, 0x29, 0x2a, 0x2b,
    0x2e, 0x2f, 0x34, 0x36, 0x3b, 0x3c, 0x3f, 0x92,
    0x93, 0xb8
};
/*Collect the unicode lists and glyph_id offsets*/
static const lv_font_fmt_txt_cmap_t aladin_cmaps[] =
{
    {
        .range_start = 32, .range_length = 64, .glyph_id_start = 1,
        .unicode_list = NULL, .glyph_id_ofs_list = NULL, .list_length = 0, .type = LV_FONT_FMT_TXT_CMAP_FORMAT0_TINY
    },
    {
        .range_start = 97, .range_length = 30, .glyph_id_start = 65,
        .unicode_list = NULL, .glyph_id_ofs_list = NULL, .list_length = 0, .type = LV_FONT_FMT_TXT_CMAP_FORMAT0_TINY
    },
    {
        .range_start = 192, .range_length = 185, .glyph_id_start = 95,
        .unicode_list = aladin_unicode_list_2, .glyph_id_ofs_list = NULL, .list_length = 34, .type = LV_FONT_FMT_TXT_CMAP_SPARSE_TINY
    }
};
/*-----------------
 *    KERNING
 *----------------*/
/*Pair left and right glyphs for kerning*/
static const uint8_t aladin_kern_pair_glyph_ids[] =
{
    8, 21,
    8, 83,
    16, 35,
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    89, 83
};
/* Kerning between the respective left and right glyphs
 * 4.4 format which needs to scaled with `kern_scale`*/
static const int8_t aladin_kern_pair_values[] =
{
    -10, -9, 15, 21, 19, 13, 15, 9,
    21, 13, 26, 21, 26, -6, -9, -9,
    -3, -3, -9, -3, -14, -9, -3, -6,
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    -6, -3
};
/*Collect the kern pair's data in one place*/
static const lv_font_fmt_txt_kern_pair_t aladin_kern_pairs =
{
    .glyph_ids = aladin_kern_pair_glyph_ids,
    .values = aladin_kern_pair_values,
    .pair_cnt = 338,
    .glyph_ids_size = 0
};
/*--------------------
 *  ALL CUSTOM DATA
 *--------------------*/
/*Store all the custom data of the font*/
static lv_font_fmt_txt_glyph_cache_t aladin_cache;
static const lv_font_fmt_txt_dsc_t aladin_font_dsc = {
    .glyph_bitmap = aladin_glyph_bitmap,
    .glyph_dsc = aladin_glyph_dsc,
    .cmaps = aladin_cmaps,
    .kern_dsc = &aladin_kern_pairs,
    .kern_scale = 16,
    .cmap_num = 3,
    .bpp = 2,
    .kern_classes = 0,
    .bitmap_format = 0,
    .cache = &aladin_cache
};
/*-----------------
 *  PUBLIC FONT
 *----------------*/
/*Initialize a public general font descriptor*/
const lv_font_t aladin = {
    .get_glyph_dsc = lv_font_get_glyph_dsc_fmt_txt,    /*Function pointer to get glyph's data*/
    .get_glyph_bitmap = lv_font_get_bitmap_fmt_txt,    /*Function pointer to get glyph's bitmap*/
    .line_height = 22,          /*The maximum line height required by the font*/
    .base_line = 5,             /*Baseline measured from the bottom of the line*/

    .subpx = LV_FONT_SUBPX_NONE,
    .underline_position = -1,
    .underline_thickness = 1,
    .dsc = &aladin_font_dsc,          /*The custom font data. Will be accessed by `get_glyph_bitmap/dsc` */
};
#endif

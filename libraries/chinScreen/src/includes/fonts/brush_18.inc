/*******************************************************************************
 * Size: 18 px
 * Bpp: 2
 ******************************************************************************/


#ifdef __has_include

    #if __has_include("lvgl.h")
         #ifndef LV_LVGL_H_INCLUDE_SIMPLE
             #define LV_LVGL_H_INCLUDE_SIMPLE
         #endif
     #endif
 #endif

 #ifdef LV_LVGL_H_INCLUDE_SIMPLE
     #include "lvgl.h"
 #else
     #include "../lvgl-8.3.11/lvgl.h"
 #endif

 #ifndef BRUSH_18
 #define BRUSH_18 1
 #endif

 #if BRUSH_18

/*-----------------
 *    BITMAPS
 *----------------*/
/*Store the image of the glyphs*/
static LV_ATTRIBUTE_LARGE_CONST const uint8_t brush_18_glyph_bitmap[] = {
    /* U+0020 " " */
    /* U+0021 "!" */
    0x18, 0x93, 0xc, 0x31, 0xc6, 0x14, 0x0, 0xd,
    0x0,
    /* U+0022 "\"" */
    0x0, 0x0, 0xc2, 0x30, 0xcc, 0x20, 0x0, 0x0,
    /* U+0023 "#" */
    0x0, 0x0, 0x0, 0x0, 0x10, 0x0, 0x0, 0x9,
    0xa, 0x0, 0x2, 0x42, 0x90, 0xb, 0xff, 0xfe,
    0x5, 0x78, 0x28, 0x0, 0xd, 0xa, 0x0, 0x3,
    0x42, 0x80, 0x0, 0xe5, 0xf9, 0x1, 0xff, 0xb8,
    0x0, 0x9, 0xa, 0x0, 0x1, 0x40, 0x40, 0x0,
    0x0, 0x0, 0x0,
    /* U+0024 "$" */
    0x0, 0x0, 0x0, 0x5, 0x0, 0x0, 0x60, 0x0,
    0xa, 0x0, 0xb, 0xfe, 0x1, 0xca, 0x10, 0xd,
    0xa0, 0x0, 0x6f, 0x90, 0x0, 0x65, 0x81, 0x6,
    0x4, 0x3f, 0xfe, 0x0, 0x7, 0x0, 0x0, 0x30,
    0x0, 0x1, 0x0,
    /* U+0025 "%" */
    0x0, 0x1, 0x0, 0x40, 0x80, 0x6c, 0x18, 0x8,
    0x83, 0x0, 0xa4, 0xa0, 0x5, 0xc, 0x29, 0x2,
    0x82, 0x90, 0x34, 0x24, 0x3, 0x0, 0x0, 0x50,
    0x0, 0x0, 0x0, 0x0,
    /* U+0026 "&" */
    0x2f, 0x40, 0x18, 0x20, 0xc, 0x8, 0x3, 0x3,
    0x0, 0x91, 0x80, 0xc, 0xc0, 0x1, 0xe0, 0x0,
    0x78, 0x1d, 0x37, 0x9c, 0x18, 0x3c, 0x6, 0xf7,
    0x80, 0x40, 0x10,
    /* U+0027 "'" */
    0x3, 0x76, 0x10,
    /* U+0028 "(" */
    0x2, 0x3, 0x42, 0x80, 0xc0, 0x30, 0x1c, 0x3,
    0x0, 0xd0, 0x1e, 0x1, 0x40,
    /* U+0029 ")" */
    0x74, 0xc, 0x6, 0x2, 0x3, 0x3, 0x3, 0xa,
    0xc, 0x0,
    /* U+002A "*" */
    0x0, 0x0, 0x48, 0x0, 0xf8, 0x6, 0xf4, 0xb,
    0x0, 0x4, 0x0,
    /* U+002B "+" */
    0x0, 0x40, 0x0, 0x20, 0x0, 0x8, 0x0, 0x3,
    0x59, 0x3f, 0xe9, 0x0, 0x20, 0x0, 0x8, 0x0,
    0x1, 0x0, 0x0, 0x0, 0x0,
    /* U+002C "," */
    0xa, 0x65, 0x0,
    /* U+002D "-" */
    0x1, 0x54, 0xff, 0xe4,
    /* U+002E "." */
    0x0, 0xc2, 0x0,
    /* U+002F "/" */
    0x2, 0x1, 0xc0, 0xe0, 0x30, 0x2c, 0xe, 0x7,
    0x2, 0xc0, 0x90, 0x0, 0x0,
    /* U+0030 "0" */
    0x0, 0x0, 0x7c, 0xc, 0xd1, 0x8a, 0x20, 0x63,
    0x6, 0x30, 0xc3, 0x28, 0x2e, 0x0,
    /* U+0031 "1" */
    0x5, 0x66, 0x77, 0x77, 0x32, 0x0,
    /* U+0032 "2" */
    0x0, 0x0, 0x3f, 0x0, 0x2, 0x0, 0x5, 0x0,
    0x8, 0x0, 0x30, 0x68, 0x7f, 0x90, 0x10, 0x0,
    /* U+0033 "3" */
    0x0, 0x0, 0xbd, 0x1, 0x14, 0x0, 0x80, 0x5,
    0x0, 0x2b, 0xc0, 0xe7, 0x0, 0x28, 0x0, 0xc0,
    0x5, 0x0, 0x0, 0x0,
    /* U+0034 "4" */
    0x0, 0x0, 0x0, 0xa, 0x0, 0x3, 0x30, 0x0,
    0x93, 0x0, 0x1c, 0x30, 0x3, 0x3, 0xb8, 0x7b,
    0xf4, 0x6, 0x93, 0x0, 0x0, 0x30, 0x0, 0x1,
    0x0, 0x0, 0x0, 0x0,
    /* U+0035 "5" */
    0x0, 0x0, 0x40, 0x3, 0xa9, 0x1e, 0x50, 0x20,
    0x0, 0xea, 0x1, 0x1, 0x0, 0x8, 0x0, 0x80,
    0xa, 0x1, 0xe0, 0x0, 0x0,
    /* U+0036 "6" */
    0x1, 0x40, 0x70, 0xc, 0x1, 0x80, 0x2e, 0x83,
    0x4d, 0x30, 0x53, 0xc, 0x37, 0x42, 0xd0, 0x0,
    0x0,
    /* U+0037 "7" */
    0x1b, 0xc0, 0x19, 0x24, 0x0, 0x9, 0x0, 0x3,
    0xfc, 0xb, 0xd0, 0x0, 0x30, 0x0, 0x1c, 0x0,
    0x6, 0x0, 0x2, 0x40, 0x0, 0x40, 0x0, 0x0,
    0x0,
    /* U+0038 "8" */
    0x0, 0x0, 0x70, 0x12, 0x42, 0x24, 0x33, 0x2,
    0xe0, 0xa, 0x82, 0x4d, 0x30, 0xc3, 0xb4, 0x3c,
    0x0,
    /* U+0039 "9" */
    0x0, 0x0, 0x68, 0xc, 0xc2, 0x5c, 0x33, 0xd3,
    0xed, 0x38, 0x90, 0x9, 0x0, 0x90, 0x9, 0x0,
    0x90, 0x4,
    /* U+003A ":" */
    0x0, 0xd0, 0x40, 0x1, 0x82, 0x40,
    /* U+003B ";" */
    0x0, 0xd0, 0x40, 0x0, 0x60, 0xc6, 0x20,
    /* U+003C "<" */
    0x0, 0x0, 0x1d, 0x7, 0x40, 0xd0, 0x28, 0x7,
    0x0, 0xa0, 0x3, 0x80, 0xb, 0x0, 0x28, 0x0,
    0x90, 0x0,
    /* U+003D "=" */
    0x2f, 0xff, 0x1, 0x40, 0x0, 0x0, 0x54, 0x2f,
    0xf8, 0x0, 0x0, 0x0,
    /* U+003E ">" */
    0x0, 0x0, 0x3d, 0x0, 0x2, 0xe0, 0x0, 0x1c,
    0x0, 0x9, 0x0, 0xc, 0x0, 0x30, 0x0, 0x90,
    0x0, 0x80, 0x1, 0x0, 0x0, 0x0,
    /* U+003F "?" */
    0x1f, 0x47, 0x9c, 0xd0, 0xc4, 0xc, 0x1, 0x40,
    0x30, 0x9, 0x0, 0x80, 0xc, 0x0, 0x0, 0x6,
    0x0, 0x70, 0x0, 0x0,
    /* U+0040 "@" */
    0x0, 0x68, 0x0, 0xfa, 0xd0, 0xd0, 0x18, 0x53,
    0x82, 0x33, 0x24, 0x8d, 0x8d, 0x13, 0x96, 0x70,
    0xdd, 0x78, 0x1d, 0x7c, 0x1, 0xb8, 0x0,
    /* U+0041 "A" */
    0x0, 0xa0, 0x0, 0x9c, 0x0, 0x23, 0x40, 0x24,
    0x60, 0xc, 0xc, 0x2, 0x3, 0x3, 0xff, 0xe0,
    0x80, 0x2c, 0x20, 0x3, 0x8, 0x0, 0xc3, 0x0,
    0x20, 0x0, 0x5, 0x0, 0x0, 0x0,
    /* U+0042 "B" */
    0x3f, 0xe0, 0x1, 0xca, 0x0, 0x70, 0x80, 0x1c,
    0xa0, 0x7, 0x70, 0x1, 0xff, 0x80, 0x74, 0x14,
    0xc, 0x8, 0x3, 0x9, 0x0, 0x4a, 0x0, 0x6,
    0x0, 0x0, 0x0,
    /* U+0043 "C" */
    0x0, 0x40, 0xf, 0x80, 0xd0, 0xa, 0x0, 0x30,
    0x0, 0xc0, 0x3, 0x0, 0xb, 0x5, 0xb, 0xd0,
    /* U+0044 "D" */
    0x0, 0x1, 0xff, 0x7, 0x2, 0xc, 0x4, 0x30,
    0x20, 0xd0, 0xc2, 0x46, 0x6, 0x70, 0xf, 0x40,
    0x34, 0x0,
    /* U+0045 "E" */
    0x7f, 0xe0, 0xa, 0x50, 0x2, 0x40, 0x0, 0x90,
    0x0, 0x79, 0x54, 0x9, 0x0, 0x42, 0x46, 0xd0,
    0xbf, 0x80, 0x9, 0x0, 0x0,
    /* U+0046 "F" */
    0x2f, 0xe4, 0x1, 0x94, 0x0, 0x20, 0x0, 0x8,
    0x0, 0x3, 0x5, 0x0, 0xbe, 0x40, 0x20, 0x0,
    0x5, 0x0, 0x0, 0x40, 0x0, 0x10, 0x0, 0x0,
    0x0,
    /* U+0047 "G" */
    0x7, 0xf4, 0x2, 0xd1, 0xc0, 0x30, 0x0, 0x6,
    0x6, 0xf8, 0x22, 0x98, 0x3, 0x0, 0xc0, 0x28,
    0x2c, 0x0, 0xbe, 0x50, 0x0, 0x2, 0x0, 0x0,
    0x0,
    /* U+0048 "H" */
    0x0, 0x0, 0x20, 0x4, 0x30, 0xc, 0x30, 0xc,
    0x30, 0xbc, 0x3f, 0xdc, 0x34, 0x8, 0x20, 0x9,
    0x4, 0x5, 0x0, 0x0,
    /* U+0049 "I" */
    0x1, 0x45, 0x18, 0x61, 0xc3, 0xc, 0x30, 0x80,
    0x0,
    /* U+004A "J" */
    0x2f, 0xf8, 0x1, 0x50, 0x0, 0x10, 0x0, 0x20,
    0x0, 0x20, 0x0, 0x24, 0x0, 0x24, 0x50, 0x30,
    0xbf, 0xf0, 0x1a, 0x80,
    /* U+004B "K" */
    0x0, 0x0, 0x1, 0x0, 0x0, 0x20, 0x1e, 0x3,
    0x7, 0x40, 0x31, 0xd0, 0x3, 0x38, 0x0, 0x3b,
    0x80, 0x2, 0x5f, 0x80, 0x24, 0xb, 0x40, 0x80,
    0x9, 0x0, 0x0, 0x0,
    /* U+004C "L" */
    0x40, 0x0, 0xc0, 0x0, 0xc0, 0x0, 0xc0, 0x0,
    0xc0, 0x0, 0xc0, 0x0, 0xc0, 0x1a, 0xeb, 0xf8,
    0xbe, 0x40, 0x0, 0x0,
    /* U+004D "M" */
    0x0, 0x0, 0x2, 0x0, 0xc, 0x3c, 0x3, 0xd3,
    0x70, 0xd9, 0x31, 0xac, 0x93, 0x7, 0x5, 0x30,
    0x0, 0x52, 0x0, 0x5, 0x0, 0x0, 0x10, 0x0,
    0x0,
    /* U+004E "N" */
    0x0, 0x0, 0x24, 0x2, 0x3d, 0x3, 0x36, 0x86,
    0x30, 0xd9, 0x30, 0x39, 0x30, 0x2c, 0x30, 0xd,
    0x30, 0xa, 0x10, 0x0, 0x0, 0x0,
    /* U+004F "O" */
    0x0, 0x0, 0x2d, 0x2, 0x8b, 0xc, 0x9, 0x20,
    0x14, 0xc0, 0x53, 0x43, 0x7, 0xb4, 0x7, 0x40,
    0x0, 0x0,
    /* U+0050 "P" */
    0x0, 0x0, 0x0, 0x7f, 0x81, 0xf8, 0x24, 0x8d,
    0x9, 0x3, 0x43, 0x0, 0xd2, 0xc0, 0x2f, 0xc0,
    0xa, 0x0, 0x1, 0x40, 0x0, 0x10, 0x0, 0x0,
    0x0,
    /* U+0051 "Q" */
    0x2, 0x80, 0x3, 0xb8, 0x2, 0x83, 0x40, 0xc0,
    0x60, 0x20, 0x8, 0x18, 0x42, 0x5, 0xe, 0x80,
    0x80, 0xf4, 0x2e, 0x87, 0x0, 0x0, 0x0,
    /* U+0052 "R" */
    0x7, 0xfe, 0x0, 0xf9, 0xc, 0x0, 0x10, 0x70,
    0x1, 0x43, 0x40, 0x2, 0x34, 0x0, 0xa, 0xf9,
    0x0, 0x20, 0x6f, 0x0, 0x40, 0xb, 0x0, 0x0,
    0x0, 0x0, 0x0, 0x0,
    /* U+0053 "S" */
    0xb, 0xf4, 0xd, 0x1, 0x5, 0x0, 0x1, 0xc0,
    0x0, 0x2f, 0xf8, 0x0, 0x0, 0x80, 0x0, 0x20,
    0x20, 0x18, 0xb, 0xf8, 0x0, 0x50, 0x0,
    /* U+0054 "T" */
    0x1b, 0xfe, 0x2e, 0x54, 0x0, 0x4, 0x0, 0x1,
    0x0, 0x0, 0x40, 0x0, 0x10, 0x0, 0x0, 0x0,
    0x0, 0x0, 0x0, 0x0, 0x0,
    /* U+0055 "U" */
    0x0, 0x0, 0x8, 0x0, 0x14, 0x1, 0x30, 0x1,
    0x30, 0x1, 0x30, 0x8, 0x70, 0x8, 0x30, 0x70,
    0x3f, 0xc0, 0x4, 0x0,
    /* U+0056 "V" */
    0x40, 0x1, 0x40, 0x12, 0x2, 0xc, 0xc, 0x24,
    0xa0, 0x63, 0x0, 0xe8, 0x2, 0xd0, 0x2, 0x0,
    /* U+0057 "W" */
    0x0, 0x0, 0x0, 0x0, 0x0, 0x5, 0x60, 0xc,
    0xc, 0x30, 0x2d, 0x18, 0x24, 0x3a, 0x34, 0x18,
    0x97, 0x70, 0xc, 0xc3, 0xa0, 0xa, 0x83, 0xd0,
    0x7, 0x42, 0xc0, 0x2, 0x0, 0x40,
    /* U+0058 "X" */
    0x0, 0x2, 0x94, 0x3, 0x82, 0xd2, 0xc0, 0x1f,
    0xc0, 0x1, 0xf0, 0x0, 0xae, 0x0, 0x30, 0xc0,
    0x24, 0x8, 0x4, 0x0, 0x0, 0x0, 0x0,
    /* U+0059 "Y" */
    0x0, 0x0, 0x0, 0x0, 0x86, 0x0, 0xa0, 0xa0,
    0x70, 0xa, 0x34, 0x0, 0xf8, 0x0, 0xc, 0x0,
    0x3, 0x0, 0x0, 0xc0, 0x0, 0x24, 0x0, 0x9,
    0x0, 0x0, 0x0,
    /* U+005A "Z" */
    0x2f, 0xe0, 0x0, 0x2, 0x40, 0x0, 0x70, 0x0,
    0xe, 0xa4, 0x1f, 0xe9, 0x0, 0xa0, 0x0, 0x1c,
    0x1, 0x43, 0x5f, 0xd0, 0x3e, 0x40, 0x0, 0x0,
    0x0,
    /* U+005B "[" */
    0x7e, 0x8, 0x7, 0x1, 0xc0, 0x70, 0x1c, 0x7,
    0x0, 0xc0, 0x20, 0x8, 0x2, 0x0, 0xfd, 0x0,
    0x0,
    /* U+005C "\\" */
    0x0, 0x0, 0x0, 0x0, 0x0, 0x0, 0x4, 0xc,
    0x1, 0x1, 0x40, 0x90, 0x38, 0x30, 0x2, 0xe,
    0xcb, 0x1, 0xbf, 0xff, 0xf8, 0x2, 0x74, 0xbc,
    0x0, 0x1f, 0xb, 0xc0, 0x0, 0xf0, 0x38, 0x0,
    0x5, 0x2, 0x0,
    /* U+005D "]" */
    0x7f, 0x0, 0xc0, 0x30, 0xc, 0x3, 0x0, 0xc0,
    0x30, 0xc, 0x3, 0x0, 0xcb, 0xf0, 0x0,
    /* U+005E "^" */
    0x0, 0x0, 0xf, 0x0, 0xdd, 0xa, 0x1c, 0x30,
    0x30, 0x40, 0x0,
    /* U+005F "_" */
    0x2b, 0xff, 0x81, 0x54, 0x0,
    /* U+0061 "a" */
    0x0, 0x0, 0xb4, 0x35, 0xc4, 0x6, 0xb, 0xf1,
    0xb, 0x21, 0xe2, 0xd0, 0x0, 0x0,
    /* U+0062 "b" */
    0x10, 0x5, 0x0, 0x60, 0x6, 0xa4, 0x74, 0x83,
    0x8, 0x32, 0x43, 0xd0, 0x10, 0x0,
    /* U+0063 "c" */
    0x1f, 0x3, 0x24, 0x60, 0xa, 0x4, 0x76, 0x41,
    0x40,
    /* U+0064 "d" */
    0x0, 0x0, 0x10, 0x2, 0x40, 0x24, 0x1, 0x80,
    0x1c, 0x2f, 0xc2, 0x2c, 0x40, 0xca, 0xc, 0x3f,
    0x40, 0x0,
    /* U+0065 "e" */
    0xb, 0x80, 0x93, 0x2, 0x1c, 0x1f, 0xd0, 0x60,
    0x50, 0xfd, 0x0, 0x0, 0x0,
    /* U+0066 "f" */
    0x4, 0x0, 0xf4, 0x15, 0xc2, 0x40, 0x18, 0x1,
    0xc0, 0x1d, 0x46, 0xe4, 0x9, 0x0, 0x50, 0x5,
    0x0, 0x40,
    /* U+0067 "g" */
    0x9, 0x2, 0xf0, 0x33, 0x3, 0x24, 0x62, 0x83,
    0x2c, 0x38, 0xc0, 0xc, 0x0, 0xc0, 0x1c, 0x7,
    0x40, 0xd0, 0x0, 0x0,
    /* U+0068 "h" */
    0x0, 0x0, 0xc0, 0x3, 0x0, 0x1c, 0x0, 0x70,
    0x1, 0xc0, 0x3, 0x29, 0xf, 0x8, 0x38, 0x14,
    0xa0, 0x11, 0x40, 0x0, 0x0,
    /* U+0069 "i" */
    0x78, 0x0, 0xa, 0x28, 0xb1, 0x40,
    /* U+006A "j" */
    0x1e, 0x0, 0x0, 0x0, 0x0, 0x34, 0x1, 0xc0,
    0xc, 0x0, 0xc0, 0xc, 0x0, 0xc0, 0x28, 0x2e,
    0x0,
    /* U+006B "k" */
    0x40, 0x0, 0x90, 0x0, 0x60, 0x40, 0x72, 0x0,
    0x35, 0x0, 0x3e, 0x80, 0x38, 0xb0, 0x24, 0x2c,
    0x0, 0x4,
    /* U+006C "l" */
    0x0, 0x30, 0x30, 0x34, 0x38, 0x38, 0x28, 0x1c,
    0xc, 0x8,
    /* U+006D "m" */
    0x0, 0x0, 0x4, 0x1d, 0x3c, 0x44, 0xad, 0xc5,
    0x47, 0x8d, 0x70, 0x30, 0x92, 0x1, 0x0,
    /* U+006E "n" */
    0x40, 0x2, 0x86, 0xc7, 0x63, 0xf, 0x9, 0x38,
    0x18, 0x40, 0x0,
    /* U+006F "o" */
    0x0, 0x3, 0xc1, 0x24, 0x46, 0x52, 0x5a, 0x81,
    0x40,
    /* U+0070 "p" */
    0x0, 0x0, 0x7f, 0xd2, 0x90, 0x82, 0x4a, 0xb,
    0xf0, 0x1d, 0x0, 0x70, 0x0, 0xc0, 0x3, 0x0,
    0xc, 0x0, 0x20, 0x0, 0x0,
    /* U+0071 "q" */
    0x0, 0x2, 0xcc, 0x30, 0xc6, 0xc, 0x93, 0xc6,
    0x8d, 0x0, 0xd0, 0x9, 0x0, 0x90, 0x5, 0x0,
    0x0,
    /* U+0072 "r" */
    0x0, 0x12, 0x46, 0x87, 0x60, 0xf, 0x0, 0x38,
    0x0, 0x70, 0x0, 0xc0, 0x0, 0x0,
    /* U+0073 "s" */
    0xa, 0x42, 0x5c, 0x20, 0x0, 0x90, 0x1, 0xd9,
    0xe, 0x3f, 0x40, 0x0,
    /* U+0074 "t" */
    0x0, 0x0, 0x1, 0x80, 0x2, 0x40, 0x3, 0x40,
    0x3, 0x0, 0x3, 0x0, 0x7f, 0xe4, 0x3, 0x0,
    0x3, 0x4, 0x3, 0xa0, 0x1, 0x40,
    /* U+0075 "u" */
    0x20, 0x82, 0x9, 0x60, 0xd6, 0x1d, 0x37, 0x93,
    0xc5, 0x0, 0x0,
    /* U+0076 "v" */
    0x0, 0x20, 0x16, 0x24, 0xcc, 0x3a, 0x7, 0x0,
    0x0,
    /* U+0077 "w" */
    0x0, 0x0, 0x5, 0x0, 0x4, 0x90, 0xb0, 0x86,
    0x1f, 0x24, 0x33, 0x33, 0x3, 0x92, 0xb0, 0x18,
    0x2d, 0x0, 0x1, 0x80,
    /* U+0078 "x" */
    0x0, 0x31, 0xc3, 0x41, 0xf4, 0x2, 0xc0, 0xe,
    0x80, 0xd2, 0x3, 0x0, 0x0, 0x0,
    /* U+0079 "y" */
    0x0, 0x9, 0x5, 0x70, 0xd3, 0x3c, 0x3d, 0x81,
    0x48, 0x0, 0x80, 0xc, 0x0, 0x80, 0x24, 0x1e,
    0x0, 0x0,
    /* U+007A "z" */
    0x0, 0x0, 0x39, 0xc0, 0x2, 0x80, 0x2b, 0xe4,
    0x1d, 0x0, 0x8, 0x15, 0x26, 0x90, 0x0, 0x0,
    /* U+007B "{" */
    0x6, 0x0, 0x30, 0x0, 0xc0, 0x2, 0x0, 0xc,
    0x0, 0x30, 0x0, 0xd0, 0xf, 0xc0, 0x11, 0x0,
    0x4, 0x0, 0x10, 0x0, 0x8, 0x3, 0x80,
    /* U+007C "|" */
    0x5, 0x66, 0x66, 0x33, 0x33, 0x32,
    /* U+007D "}" */
    0x19, 0x2, 0x30, 0x2, 0x0, 0x20, 0x2, 0x0,
    0x39, 0x3, 0x40, 0x20, 0x2, 0x0, 0x30, 0x13,
    0x3, 0xe0, 0x18, 0x0,
    /* U+007E "~" */
    0x1, 0x0, 0x0, 0xfc, 0x1, 0x28, 0xf0, 0x81,
    0x2, 0xe0
};
/*---------------------
 *  GLYPH DESCRIPTION
 *--------------------*/
static const lv_font_fmt_txt_glyph_dsc_t brush_18_glyph_dsc[] = {
    {.bitmap_index = 0, .adv_w = 0, .box_w = 0, .box_h = 0, .ofs_x = 0, .ofs_y = 0} /* id = 0 reserved */,
    {.bitmap_index = 0, .adv_w = 81, .box_w = 0, .box_h = 0, .ofs_x = 0, .ofs_y = 0},
    {.bitmap_index = 0, .adv_w = 75, .box_w = 3, .box_h = 12, .ofs_x = 1, .ofs_y = 0},
    {.bitmap_index = 9, .adv_w = 81, .box_w = 5, .box_h = 6, .ofs_x = 0, .ofs_y = 9},
    {.bitmap_index = 17, .adv_w = 213, .box_w = 13, .box_h = 13, .ofs_x = 0, .ofs_y = 1},
    {.bitmap_index = 60, .adv_w = 159, .box_w = 10, .box_h = 14, .ofs_x = 0, .ofs_y = 0},
    {.bitmap_index = 95, .adv_w = 187, .box_w = 10, .box_h = 11, .ofs_x = 1, .ofs_y = 1},
    {.bitmap_index = 123, .adv_w = 160, .box_w = 9, .box_h = 12, .ofs_x = 1, .ofs_y = 0},
    {.bitmap_index = 150, .adv_w = 71, .box_w = 2, .box_h = 6, .ofs_x = 1, .ofs_y = 9},
    {.bitmap_index = 153, .adv_w = 101, .box_w = 5, .box_h = 10, .ofs_x = 1, .ofs_y = 1},
    {.bitmap_index = 166, .adv_w = 101, .box_w = 4, .box_h = 10, .ofs_x = 1, .ofs_y = 1},
    {.bitmap_index = 176, .adv_w = 109, .box_w = 7, .box_h = 6, .ofs_x = 0, .ofs_y = 7},
    {.bitmap_index = 187, .adv_w = 153, .box_w = 9, .box_h = 9, .ofs_x = 0, .ofs_y = 2},
    {.bitmap_index = 208, .adv_w = 66, .box_w = 2, .box_h = 5, .ofs_x = 1, .ofs_y = -3},
    {.bitmap_index = 211, .adv_w = 153, .box_w = 8, .box_h = 2, .ofs_x = 1, .ofs_y = 6},
    {.bitmap_index = 215, .adv_w = 58, .box_w = 3, .box_h = 4, .ofs_x = 0, .ofs_y = -3},
    {.bitmap_index = 218, .adv_w = 98, .box_w = 5, .box_h = 10, .ofs_x = 1, .ofs_y = 1},
    {.bitmap_index = 231, .adv_w = 107, .box_w = 6, .box_h = 9, .ofs_x = 0, .ofs_y = 2},
    {.bitmap_index = 245, .adv_w = 70, .box_w = 2, .box_h = 11, .ofs_x = 1, .ofs_y = 1},
    {.bitmap_index = 251, .adv_w = 109, .box_w = 8, .box_h = 8, .ofs_x = 0, .ofs_y = 3},
    {.bitmap_index = 267, .adv_w = 105, .box_w = 7, .box_h = 11, .ofs_x = 0, .ofs_y = 1},
    {.bitmap_index = 287, .adv_w = 150, .box_w = 10, .box_h = 11, .ofs_x = 0, .ofs_y = 1},
    {.bitmap_index = 315, .adv_w = 109, .box_w = 7, .box_h = 12, .ofs_x = 0, .ofs_y = 1},
    {.bitmap_index = 336, .adv_w = 104, .box_w = 6, .box_h = 11, .ofs_x = 0, .ofs_y = 2},
    {.bitmap_index = 353, .adv_w = 135, .box_w = 9, .box_h = 11, .ofs_x = 0, .ofs_y = 0},
    {.bitmap_index = 378, .adv_w = 95, .box_w = 6, .box_h = 11, .ofs_x = 0, .ofs_y = 2},
    {.bitmap_index = 395, .adv_w = 107, .box_w = 6, .box_h = 12, .ofs_x = 0, .ofs_y = 1},
    {.bitmap_index = 413, .adv_w = 87, .box_w = 3, .box_h = 7, .ofs_x = 1, .ofs_y = 4},
    {.bitmap_index = 419, .adv_w = 87, .box_w = 3, .box_h = 9, .ofs_x = 1, .ofs_y = 2},
    {.bitmap_index = 426, .adv_w = 130, .box_w = 6, .box_h = 12, .ofs_x = 1, .ofs_y = 0},
    {.bitmap_index = 444, .adv_w = 153, .box_w = 9, .box_h = 5, .ofs_x = 0, .ofs_y = 4},
    {.bitmap_index = 456, .adv_w = 130, .box_w = 8, .box_h = 11, .ofs_x = 0, .ofs_y = 1},
    {.bitmap_index = 478, .adv_w = 115, .box_w = 6, .box_h = 13, .ofs_x = 1, .ofs_y = -1},
    {.bitmap_index = 498, .adv_w = 158, .box_w = 9, .box_h = 10, .ofs_x = 0, .ofs_y = 2},
    {.bitmap_index = 521, .adv_w = 144, .box_w = 9, .box_h = 13, .ofs_x = 0, .ofs_y = 0},
    {.bitmap_index = 551, .adv_w = 132, .box_w = 9, .box_h = 12, .ofs_x = -1, .ofs_y = 0},
    {.bitmap_index = 578, .adv_w = 119, .box_w = 7, .box_h = 9, .ofs_x = 0, .ofs_y = 3},
    {.bitmap_index = 594, .adv_w = 109, .box_w = 7, .box_h = 10, .ofs_x = 0, .ofs_y = 2},
    {.bitmap_index = 612, .adv_w = 132, .box_w = 9, .box_h = 9, .ofs_x = 0, .ofs_y = 2},
    {.bitmap_index = 633, .adv_w = 124, .box_w = 9, .box_h = 11, .ofs_x = -1, .ofs_y = 1},
    {.bitmap_index = 658, .adv_w = 153, .box_w = 10, .box_h = 10, .ofs_x = 0, .ofs_y = 1},
    {.bitmap_index = 683, .adv_w = 130, .box_w = 8, .box_h = 10, .ofs_x = 0, .ofs_y = 3},
    {.bitmap_index = 703, .adv_w = 74, .box_w = 3, .box_h = 11, .ofs_x = 1, .ofs_y = 2},
    {.bitmap_index = 712, .adv_w = 124, .box_w = 8, .box_h = 10, .ofs_x = 0, .ofs_y = 2},
    {.bitmap_index = 732, .adv_w = 153, .box_w = 10, .box_h = 11, .ofs_x = 0, .ofs_y = 1},
    {.bitmap_index = 760, .adv_w = 144, .box_w = 8, .box_h = 10, .ofs_x = 1, .ofs_y = 1},
    {.bitmap_index = 780, .adv_w = 164, .box_w = 10, .box_h = 10, .ofs_x = 0, .ofs_y = 2},
    {.bitmap_index = 805, .adv_w = 138, .box_w = 8, .box_h = 11, .ofs_x = 0, .ofs_y = 0},
    {.bitmap_index = 827, .adv_w = 118, .box_w = 7, .box_h = 10, .ofs_x = 0, .ofs_y = 1},
    {.bitmap_index = 845, .adv_w = 130, .box_w = 9, .box_h = 11, .ofs_x = -1, .ofs_y = 1},
    {.bitmap_index = 870, .adv_w = 124, .box_w = 9, .box_h = 10, .ofs_x = 0, .ofs_y = 1},
    {.bitmap_index = 893, .adv_w = 153, .box_w = 11, .box_h = 10, .ofs_x = -1, .ofs_y = 1},
    {.bitmap_index = 921, .adv_w = 135, .box_w = 9, .box_h = 10, .ofs_x = 0, .ofs_y = 1},
    {.bitmap_index = 944, .adv_w = 141, .box_w = 9, .box_h = 9, .ofs_x = 0, .ofs_y = 2},
    {.bitmap_index = 965, .adv_w = 129, .box_w = 8, .box_h = 10, .ofs_x = 0, .ofs_y = 2},
    {.bitmap_index = 985, .adv_w = 112, .box_w = 7, .box_h = 9, .ofs_x = 0, .ofs_y = 2},
    {.bitmap_index = 1001, .adv_w = 197, .box_w = 12, .box_h = 10, .ofs_x = 0, .ofs_y = 2},
    {.bitmap_index = 1031, .adv_w = 144, .box_w = 9, .box_h = 10, .ofs_x = 0, .ofs_y = 1},
    {.bitmap_index = 1054, .adv_w = 138, .box_w = 9, .box_h = 12, .ofs_x = 0, .ofs_y = 0},
    {.bitmap_index = 1081, .adv_w = 150, .box_w = 10, .box_h = 10, .ofs_x = 0, .ofs_y = 1},
    {.bitmap_index = 1106, .adv_w = 107, .box_w = 5, .box_h = 13, .ofs_x = 1, .ofs_y = -1},
    {.bitmap_index = 1123, .adv_w = 233, .box_w = 14, .box_h = 10, .ofs_x = 0, .ofs_y = 2},
    {.bitmap_index = 1158, .adv_w = 107, .box_w = 5, .box_h = 12, .ofs_x = 1, .ofs_y = 0},
    {.bitmap_index = 1173, .adv_w = 115, .box_w = 7, .box_h = 6, .ofs_x = 0, .ofs_y = 9},
    {.bitmap_index = 1184, .adv_w = 157, .box_w = 10, .box_h = 2, .ofs_x = 0, .ofs_y = -3},
    {.bitmap_index = 1189, .adv_w = 104, .box_w = 6, .box_h = 9, .ofs_x = 0, .ofs_y = 2},
    {.bitmap_index = 1203, .adv_w = 89, .box_w = 6, .box_h = 9, .ofs_x = 0, .ofs_y = 3},
    {.bitmap_index = 1217, .adv_w = 89, .box_w = 6, .box_h = 6, .ofs_x = 0, .ofs_y = 3},
    {.bitmap_index = 1226, .adv_w = 92, .box_w = 6, .box_h = 12, .ofs_x = 0, .ofs_y = 2},
    {.bitmap_index = 1244, .adv_w = 95, .box_w = 7, .box_h = 7, .ofs_x = 0, .ofs_y = 2},
    {.bitmap_index = 1257, .adv_w = 98, .box_w = 6, .box_h = 12, .ofs_x = 0, .ofs_y = 2},
    {.bitmap_index = 1275, .adv_w = 92, .box_w = 6, .box_h = 13, .ofs_x = 0, .ofs_y = -3},
    {.bitmap_index = 1295, .adv_w = 104, .box_w = 7, .box_h = 12, .ofs_x = 0, .ofs_y = 2},
    {.bitmap_index = 1316, .adv_w = 61, .box_w = 3, .box_h = 7, .ofs_x = 0, .ofs_y = 3},
    {.bitmap_index = 1322, .adv_w = 74, .box_w = 6, .box_h = 11, .ofs_x = -1, .ofs_y = -1},
    {.bitmap_index = 1339, .adv_w = 118, .box_w = 8, .box_h = 9, .ofs_x = 0, .ofs_y = 3},
    {.bitmap_index = 1357, .adv_w = 64, .box_w = 4, .box_h = 10, .ofs_x = 0, .ofs_y = 3},
    {.bitmap_index = 1367, .adv_w = 158, .box_w = 10, .box_h = 6, .ofs_x = 0, .ofs_y = 3},
    {.bitmap_index = 1382, .adv_w = 115, .box_w = 7, .box_h = 6, .ofs_x = 0, .ofs_y = 3},
    {.bitmap_index = 1393, .adv_w = 84, .box_w = 5, .box_h = 7, .ofs_x = 0, .ofs_y = 2},
    {.bitmap_index = 1402, .adv_w = 101, .box_w = 7, .box_h = 12, .ofs_x = -1, .ofs_y = -2},
    {.bitmap_index = 1423, .adv_w = 98, .box_w = 6, .box_h = 11, .ofs_x = 0, .ofs_y = -1},
    {.bitmap_index = 1440, .adv_w = 104, .box_w = 7, .box_h = 8, .ofs_x = 0, .ofs_y = 2},
    {.bitmap_index = 1454, .adv_w = 98, .box_w = 6, .box_h = 8, .ofs_x = 0, .ofs_y = 2},
    {.bitmap_index = 1466, .adv_w = 118, .box_w = 8, .box_h = 11, .ofs_x = 0, .ofs_y = 2},
    {.bitmap_index = 1488, .adv_w = 98, .box_w = 6, .box_h = 7, .ofs_x = 0, .ofs_y = 2},
    {.bitmap_index = 1499, .adv_w = 81, .box_w = 5, .box_h = 7, .ofs_x = 0, .ofs_y = 2},
    {.bitmap_index = 1508, .adv_w = 150, .box_w = 10, .box_h = 8, .ofs_x = 0, .ofs_y = 2},
    {.bitmap_index = 1528, .adv_w = 109, .box_w = 7, .box_h = 8, .ofs_x = 0, .ofs_y = 1},
    {.bitmap_index = 1542, .adv_w = 95, .box_w = 6, .box_h = 12, .ofs_x = 0, .ofs_y = -2},
    {.bitmap_index = 1560, .adv_w = 124, .box_w = 8, .box_h = 8, .ofs_x = 0, .ofs_y = 2},
    {.bitmap_index = 1576, .adv_w = 105, .box_w = 7, .box_h = 13, .ofs_x = 0, .ofs_y = -1},
    {.bitmap_index = 1599, .adv_w = 70, .box_w = 2, .box_h = 12, .ofs_x = 1, .ofs_y = 1},
    {.bitmap_index = 1605, .adv_w = 96, .box_w = 6, .box_h = 13, .ofs_x = 0, .ofs_y = -1},
    {.bitmap_index = 1625, .adv_w = 169, .box_w = 10, .box_h = 4, .ofs_x = 0, .ofs_y = 5}
};
/*---------------------
 *  CHARACTER MAPPING
 *--------------------*/
/*Collect the unicode lists and glyph_id offsets*/
static const lv_font_fmt_txt_cmap_t brush_18_cmaps[] =
{
    {
        .range_start = 32, .range_length = 64, .glyph_id_start = 1,
        .unicode_list = NULL, .glyph_id_ofs_list = NULL, .list_length = 0, .type = LV_FONT_FMT_TXT_CMAP_FORMAT0_TINY
    },
    {
        .range_start = 97, .range_length = 30, .glyph_id_start = 65,
        .unicode_list = NULL, .glyph_id_ofs_list = NULL, .list_length = 0, .type = LV_FONT_FMT_TXT_CMAP_FORMAT0_TINY
    }
};
/*--------------------
 *  ALL CUSTOM DATA
 *--------------------*/
/*Store all the custom data of the font*/
static lv_font_fmt_txt_glyph_cache_t brush_18_cache;
static const lv_font_fmt_txt_dsc_t brush_18_font_dsc = {
    .glyph_bitmap = brush_18_glyph_bitmap,
    .glyph_dsc = brush_18_glyph_dsc,
    .cmaps = brush_18_cmaps,
    .kern_dsc = NULL,
    .kern_scale = 0,
    .cmap_num = 2,
    .bpp = 2,
    .kern_classes = 0,
    .bitmap_format = 0,
    .cache = &brush_18_cache
};
/*-----------------
 *  PUBLIC FONT
 *----------------*/
/*Initialize a public general font descriptor*/
const lv_font_t brush_18 = {
    .get_glyph_dsc = lv_font_get_glyph_dsc_fmt_txt,    /*Function pointer to get glyph's data*/
    .get_glyph_bitmap = lv_font_get_bitmap_fmt_txt,    /*Function pointer to get glyph's bitmap*/
    .line_height = 18,          /*The maximum line height required by the font*/
    .base_line = 3,             /*Baseline measured from the bottom of the line*/

    .subpx = LV_FONT_SUBPX_NONE,
    .underline_position = -1,
    .underline_thickness = 1,
    .dsc = &brush_18_font_dsc,          /*The custom font data. Will be accessed by `get_glyph_bitmap/dsc` */
};
#endif
